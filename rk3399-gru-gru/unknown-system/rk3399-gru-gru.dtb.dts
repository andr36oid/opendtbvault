/dts-v1/;

/ {
	compatible = "google,gru-rev15\0google,gru-rev14\0google,gru-rev13\0google,gru-rev12\0google,gru-rev11\0google,gru-rev10\0google,gru-rev9\0google,gru-rev8\0google,gru-rev7\0google,gru-rev6\0google,gru-rev5\0google,gru-rev4\0google,gru-rev3\0google,gru-rev2\0google,gru-rev1\0google,gru-rev0\0google,gru\0rockchip,rk3399";
	interrupt-parent = <0x01>;
	#address-cells = <0x02>;
	#size-cells = <0x02>;
	model = "Google Gru";

	ddr_timing {
		compatible = "rockchip,ddr-timing";
		ddr3_speed_bin = <0x15>;
		pd_idle = <0x00>;
		sr_idle = <0x00>;
		sr_mc_gate_idle = <0x00>;
		srpd_lite_idle = <0x00>;
		standby_idle = <0x00>;
		auto_lp_dis_freq = <0x29a>;
		ddr3_dll_dis_freq = <0x12c>;
		phy_dll_dis_freq = <0x104>;
		ddr3_odt_dis_freq = <0x29a>;
		ddr3_drv = <0x28>;
		ddr3_odt = <0x78>;
		phy_ddr3_ca_drv = <0x28>;
		phy_ddr3_dq_drv = <0x28>;
		phy_ddr3_odt = <0xf0>;
		lpddr3_odt_dis_freq = <0x29a>;
		lpddr3_drv = <0x22>;
		lpddr3_odt = <0xf0>;
		phy_lpddr3_ca_drv = <0x22>;
		phy_lpddr3_dq_drv = <0x22>;
		phy_lpddr3_odt = <0xf0>;
		lpddr4_odt_dis_freq = <0x320>;
		lpddr4_drv = <0xf0>;
		lpddr4_dq_odt = <0x28>;
		lpddr4_ca_odt = <0x00>;
		phy_lpddr4_ca_drv = <0x28>;
		phy_lpddr4_ck_cs_drv = <0x28>;
		phy_lpddr4_dq_drv = <0x3c>;
		phy_lpddr4_odt = <0x28>;
		phandle = <0x83>;
	};

	aliases {
		dsi0 = "/dsi@ff960000";
		dsi1 = "/dsi@ff968000";
		ethernet0 = "/ethernet@fe300000";
		i2c0 = "/i2c@ff3c0000";
		i2c1 = "/i2c@ff110000";
		i2c2 = "/i2c@ff120000";
		i2c3 = "/i2c@ff130000";
		i2c4 = "/i2c@ff3d0000";
		i2c5 = "/i2c@ff140000";
		i2c6 = "/i2c@ff150000";
		i2c7 = "/i2c@ff160000";
		i2c8 = "/i2c@ff3e0000";
		serial0 = "/serial@ff180000";
		serial1 = "/serial@ff190000";
		serial2 = "/serial@ff1a0000";
		serial3 = "/serial@ff1b0000";
		serial4 = "/serial@ff370000";
	};

	cpus {
		#address-cells = <0x02>;
		#size-cells = <0x00>;

		cpu-map {

			cluster0 {

				core0 {
					cpu = <0x02>;
				};

				core1 {
					cpu = <0x03>;
				};

				core2 {
					cpu = <0x04>;
				};

				core3 {
					cpu = <0x05>;
				};
			};

			cluster1 {

				core0 {
					cpu = <0x06>;
				};

				core1 {
					cpu = <0x07>;
				};
			};
		};

		cpu@0 {
			device_type = "cpu";
			compatible = "arm,cortex-a53\0arm,armv8";
			reg = <0x00 0x00>;
			enable-method = "psci";
			#cooling-cells = <0x02>;
			clocks = <0x08 0x08>;
			cpu-idle-states = <0x09 0x0a>;
			dynamic-power-coefficient = <0x64>;
			cpu-supply = <0x0b>;
			phandle = <0x02>;
		};

		cpu@1 {
			device_type = "cpu";
			compatible = "arm,cortex-a53\0arm,armv8";
			reg = <0x00 0x01>;
			enable-method = "psci";
			clocks = <0x08 0x08>;
			cpu-idle-states = <0x09 0x0a>;
			dynamic-power-coefficient = <0x64>;
			cpu-supply = <0x0b>;
			phandle = <0x03>;
		};

		cpu@2 {
			device_type = "cpu";
			compatible = "arm,cortex-a53\0arm,armv8";
			reg = <0x00 0x02>;
			enable-method = "psci";
			clocks = <0x08 0x08>;
			cpu-idle-states = <0x09 0x0a>;
			dynamic-power-coefficient = <0x64>;
			cpu-supply = <0x0b>;
			phandle = <0x04>;
		};

		cpu@3 {
			device_type = "cpu";
			compatible = "arm,cortex-a53\0arm,armv8";
			reg = <0x00 0x03>;
			enable-method = "psci";
			clocks = <0x08 0x08>;
			cpu-idle-states = <0x09 0x0a>;
			dynamic-power-coefficient = <0x64>;
			cpu-supply = <0x0b>;
			phandle = <0x05>;
		};

		cpu@100 {
			device_type = "cpu";
			compatible = "arm,cortex-a72\0arm,armv8";
			reg = <0x00 0x100>;
			enable-method = "psci";
			#cooling-cells = <0x02>;
			clocks = <0x08 0x09>;
			cpu-idle-states = <0x09 0x0a>;
			dynamic-power-coefficient = <0x1b4>;
			cpu-supply = <0x0c>;
			phandle = <0x06>;
		};

		cpu@101 {
			device_type = "cpu";
			compatible = "arm,cortex-a72\0arm,armv8";
			reg = <0x00 0x101>;
			enable-method = "psci";
			clocks = <0x08 0x09>;
			cpu-idle-states = <0x09 0x0a>;
			dynamic-power-coefficient = <0x1b4>;
			cpu-supply = <0x0c>;
			phandle = <0x07>;
		};

		idle-states {
			entry-method = "psci";

			cpu-sleep {
				compatible = "arm,idle-state";
				local-timer-stop;
				arm,psci-suspend-param = <0x10000>;
				entry-latency-us = <0x78>;
				exit-latency-us = <0xfa>;
				min-residency-us = <0x384>;
				phandle = <0x09>;
			};

			cluster-sleep {
				compatible = "arm,idle-state";
				local-timer-stop;
				arm,psci-suspend-param = <0x1010000>;
				entry-latency-us = <0x190>;
				exit-latency-us = <0x1f4>;
				min-residency-us = <0x7d0>;
				phandle = <0x0a>;
			};
		};
	};

	cpuinfo {
		compatible = "rockchip,cpuinfo";
		nvmem-cells = <0x0d>;
		nvmem-cell-names = "id";
	};

	pmu_a53 {
		compatible = "arm,cortex-a53-pmu";
		interrupts = <0x01 0x07 0x08 0x0e>;
	};

	pmu_a72 {
		compatible = "arm,cortex-a72-pmu";
		interrupts = <0x01 0x07 0x08 0x0f>;
	};

	psci {
		compatible = "arm,psci-1.0";
		method = "smc";
	};

	timer {
		compatible = "arm,armv8-timer";
		interrupts = <0x01 0x0d 0x08 0x00 0x01 0x0e 0x08 0x00 0x01 0x0b 0x08 0x00 0x01 0x0a 0x08 0x00>;
		arm,no-tick-in-suspend;
	};

	xin24m {
		compatible = "fixed-clock";
		clock-frequency = <0x16e3600>;
		clock-output-names = "xin24m";
		#clock-cells = <0x00>;
		phandle = <0xc5>;
	};

	dummy_cpll {
		compatible = "fixed-clock";
		clock-frequency = <0x00>;
		clock-output-names = "dummy_cpll";
		#clock-cells = <0x00>;
		phandle = <0xc6>;
	};

	dummy_vpll {
		compatible = "fixed-clock";
		clock-frequency = <0x00>;
		clock-output-names = "dummy_vpll";
		#clock-cells = <0x00>;
		phandle = <0xc7>;
	};

	amba {
		compatible = "simple-bus";
		#address-cells = <0x02>;
		#size-cells = <0x02>;
		ranges;

		dma-controller@ff6d0000 {
			compatible = "arm,pl330\0arm,primecell";
			reg = <0x00 0xff6d0000 0x00 0x4000>;
			interrupts = <0x00 0x05 0x04 0x00 0x00 0x06 0x04 0x00>;
			#dma-cells = <0x01>;
			clocks = <0x08 0xd3>;
			clock-names = "apb_pclk";
			peripherals-req-type-burst;
			phandle = <0x4a>;
		};

		dma-controller@ff6e0000 {
			compatible = "arm,pl330\0arm,primecell";
			reg = <0x00 0xff6e0000 0x00 0x4000>;
			interrupts = <0x00 0x07 0x04 0x00 0x00 0x08 0x04 0x00>;
			#dma-cells = <0x01>;
			clocks = <0x08 0xd4>;
			clock-names = "apb_pclk";
			peripherals-req-type-burst;
			phandle = <0x39>;
		};
	};

	ethernet@fe300000 {
		compatible = "rockchip,rk3399-gmac";
		reg = <0x00 0xfe300000 0x00 0x10000>;
		interrupts = <0x00 0x0c 0x04 0x00>;
		interrupt-names = "macirq";
		clocks = <0x08 0x69 0x08 0x67 0x08 0x68 0x08 0x66 0x08 0x6a 0x08 0xd5 0x08 0x166>;
		clock-names = "stmmaceth\0mac_clk_rx\0mac_clk_tx\0clk_mac_ref\0clk_mac_refout\0aclk_mac\0pclk_mac";
		power-domains = <0x10 0x16>;
		resets = <0x08 0x89>;
		reset-names = "stmmaceth";
		rockchip,grf = <0x11>;
		status = "disabled";
		phandle = <0xc8>;
	};

	dwmmc@fe310000 {
		compatible = "rockchip,rk3399-dw-mshc\0rockchip,rk3288-dw-mshc";
		reg = <0x00 0xfe310000 0x00 0x4000>;
		interrupts = <0x00 0x40 0x04 0x00>;
		max-frequency = <0x8f0d180>;
		clocks = <0x08 0x1ee 0x08 0x4d 0x08 0x9c 0x08 0x9d>;
		clock-names = "biu\0ciu\0ciu-drive\0ciu-sample";
		fifo-depth = <0x100>;
		power-domains = <0x10 0x1c>;
		resets = <0x08 0x79>;
		reset-names = "reset";
		status = "disabled";
		phandle = <0xc9>;
	};

	dwmmc@fe320000 {
		compatible = "rockchip,rk3399-dw-mshc\0rockchip,rk3288-dw-mshc";
		reg = <0x00 0xfe320000 0x00 0x4000>;
		interrupts = <0x00 0x41 0x04 0x00>;
		max-frequency = <0x8f0d180>;
		assigned-clocks = <0x08 0x1cd>;
		assigned-clock-rates = <0xbebc200>;
		clocks = <0x08 0x1ce 0x08 0x4c 0x08 0x9a 0x08 0x9b>;
		clock-names = "biu\0ciu\0ciu-drive\0ciu-sample";
		fifo-depth = <0x100>;
		power-domains = <0x10 0x1b>;
		resets = <0x08 0x7a>;
		reset-names = "reset";
		status = "okay";
		pinctrl-names = "default";
		pinctrl-0 = <0x12 0x13 0x14 0x15 0x16>;
		supports-sd;
		clock-frequency = <0x23c3460>;
		clock-freq-min-max = <0x61a80 0x23c3460>;
		bus-width = <0x04>;
		cd-gpios = <0x17 0x18 0x01>;
		disable-wp;
		cap-mmc-highspeed;
		cap-sd-highspeed;
		vmmc-supply = <0x18>;
		vqmmc-supply = <0x19>;
		phandle = <0xca>;
	};

	sdhci@fe330000 {
		compatible = "rockchip,rk3399-sdhci-5.1\0arasan,sdhci-5.1";
		reg = <0x00 0xfe330000 0x00 0x10000>;
		interrupts = <0x00 0x0b 0x04 0x00>;
		arasan,soc-ctl-syscon = <0x11>;
		assigned-clocks = <0x08 0x4e>;
		assigned-clock-rates = <0xbebc200>;
		clocks = <0x08 0x4e 0x08 0xf0>;
		clock-names = "clk_xin\0clk_ahb";
		clock-output-names = "emmc_cardclock";
		#clock-cells = <0x00>;
		phys = <0x1a>;
		phy-names = "phy_arasan";
		power-domains = <0x10 0x17>;
		status = "okay";
		bus-width = <0x08>;
		mmc-hs400-1_8v;
		supports-emmc;
		non-removable;
		phandle = <0x89>;
	};

	usb@fe340000 {
		compatible = "generic-ehci";
		reg = <0x00 0xfe340000 0x00 0x30000>;
		interrupts = <0x00 0x21 0x04 0x00>;
		clocks = <0x08 0x1cc 0x08 0x79 0x08 0x154>;
		clock-names = "hclk_hsic\0clk_hsicphy\0pclk_hsicphy";
		rockchip-has-usic;
		status = "disabled";
		phandle = <0xcb>;
	};

	usb@fe380000 {
		compatible = "generic-ehci";
		reg = <0x00 0xfe380000 0x00 0x20000>;
		interrupts = <0x00 0x1a 0x04 0x00>;
		clocks = <0x08 0x1c8 0x08 0x1c9 0x08 0xa8>;
		clock-names = "hclk_host0\0hclk_host0_arb\0usbphy0_480m";
		phys = <0x1b>;
		phy-names = "usb";
		power-domains = <0x10 0x0e>;
		status = "okay";
		phandle = <0xcc>;
	};

	usb@fe3a0000 {
		compatible = "generic-ohci";
		reg = <0x00 0xfe3a0000 0x00 0x20000>;
		interrupts = <0x00 0x1c 0x04 0x00>;
		clocks = <0x08 0x1c8 0x08 0x1c9 0x08 0xa8>;
		clock-names = "hclk_host0\0hclk_host0_arb\0usbphy0_480m";
		phys = <0x1b>;
		phy-names = "usb";
		power-domains = <0x10 0x0e>;
		status = "okay";
		phandle = <0xcd>;
	};

	usb@fe3c0000 {
		compatible = "generic-ehci";
		reg = <0x00 0xfe3c0000 0x00 0x20000>;
		interrupts = <0x00 0x1e 0x04 0x00>;
		clocks = <0x08 0x1ca 0x08 0x1cb 0x08 0xa9>;
		clock-names = "hclk_host1\0hclk_host1_arb\0usbphy1_480m";
		phys = <0x1c>;
		phy-names = "usb";
		power-domains = <0x10 0x0e>;
		status = "okay";
		phandle = <0xce>;
	};

	usb@fe3e0000 {
		compatible = "generic-ohci";
		reg = <0x00 0xfe3e0000 0x00 0x20000>;
		interrupts = <0x00 0x20 0x04 0x00>;
		clocks = <0x08 0x1ca 0x08 0x1cb 0x08 0xa9>;
		clock-names = "hclk_host1\0hclk_host1_arb\0usbphy1_480m";
		phys = <0x1c>;
		phy-names = "usb";
		power-domains = <0x10 0x0e>;
		status = "okay";
		phandle = <0xcf>;
	};

	usb0 {
		compatible = "rockchip,rk3399-dwc3";
		clocks = <0x08 0x81 0x08 0x83 0x08 0xf6 0x08 0xf9>;
		clock-names = "ref_clk\0suspend_clk\0bus_clk\0grf_clk";
		power-domains = <0x10 0x18>;
		resets = <0x08 0x125>;
		reset-names = "usb3-otg";
		#address-cells = <0x02>;
		#size-cells = <0x02>;
		ranges;
		status = "okay";
		phandle = <0xd0>;

		dwc3@fe800000 {
			compatible = "snps,dwc3";
			reg = <0x00 0xfe800000 0x00 0x100000>;
			interrupts = <0x00 0x69 0x04 0x00>;
			dr_mode = "host";
			phys = <0x1d 0x1e>;
			phy-names = "usb2-phy\0usb3-phy";
			phy_type = "utmi_wide";
			snps,dis_enblslpm_quirk;
			snps,dis-u2-freeclk-exists-quirk;
			snps,dis_u2_susphy_quirk;
			snps,dis-del-phy-power-chg-quirk;
			snps,tx-ipgap-linecheck-dis-quirk;
			snps,xhci-slow-suspend-quirk;
			snps,xhci-trb-ent-quirk;
			snps,usb3-warm-reset-on-resume-quirk;
			status = "okay";
			phandle = <0xd1>;
		};
	};

	usb1 {
		compatible = "rockchip,rk3399-dwc3";
		clocks = <0x08 0x82 0x08 0x84 0x08 0xf7 0x08 0xf9>;
		clock-names = "ref_clk\0suspend_clk\0bus_clk\0grf_clk";
		power-domains = <0x10 0x18>;
		resets = <0x08 0x126>;
		reset-names = "usb3-otg";
		#address-cells = <0x02>;
		#size-cells = <0x02>;
		ranges;
		status = "okay";
		phandle = <0xd2>;

		dwc3@fe900000 {
			compatible = "snps,dwc3";
			reg = <0x00 0xfe900000 0x00 0x100000>;
			interrupts = <0x00 0x6e 0x04 0x00>;
			dr_mode = "host";
			phys = <0x1f 0x20>;
			phy-names = "usb2-phy\0usb3-phy";
			phy_type = "utmi_wide";
			snps,dis_enblslpm_quirk;
			snps,dis-u2-freeclk-exists-quirk;
			snps,dis_u2_susphy_quirk;
			snps,dis-del-phy-power-chg-quirk;
			snps,tx-ipgap-linecheck-dis-quirk;
			snps,xhci-slow-suspend-quirk;
			snps,xhci-trb-ent-quirk;
			snps,usb3-warm-reset-on-resume-quirk;
			status = "okay";
			phandle = <0xd3>;
		};
	};

	dp@fec00000 {
		compatible = "rockchip,rk3399-cdn-dp";
		reg = <0x00 0xfec00000 0x00 0x100000>;
		interrupts = <0x00 0x09 0x04 0x00>;
		assigned-clocks = <0x08 0x72 0x08 0xa1>;
		assigned-clock-rates = <0x5f5e100 0xbebc200>;
		clocks = <0x08 0x72 0x08 0x175 0x08 0xa1 0x08 0x16f>;
		clock-names = "core-clk\0pclk\0spdif\0grf";
		power-domains = <0x10 0x15>;
		phys = <0x21 0x22>;
		resets = <0x08 0x103 0x08 0x148 0x08 0x14a 0x08 0xfd>;
		reset-names = "spdif\0dptx\0apb\0core";
		rockchip,grf = <0x11>;
		#address-cells = <0x01>;
		#size-cells = <0x00>;
		#sound-dai-cells = <0x01>;
		status = "disabled";
		phandle = <0xd4>;

		ports {
			#address-cells = <0x01>;
			#size-cells = <0x00>;

			port {
				#address-cells = <0x01>;
				#size-cells = <0x00>;
				phandle = <0xd5>;

				endpoint@0 {
					reg = <0x00>;
					remote-endpoint = <0x23>;
					phandle = <0x99>;
				};

				endpoint@1 {
					reg = <0x01>;
					remote-endpoint = <0x24>;
					phandle = <0x92>;
				};
			};
		};
	};

	interrupt-controller@fee00000 {
		compatible = "arm,gic-v3";
		#interrupt-cells = <0x04>;
		#address-cells = <0x02>;
		#size-cells = <0x02>;
		ranges;
		interrupt-controller;
		reg = <0x00 0xfee00000 0x00 0x10000 0x00 0xfef00000 0x00 0xc0000 0x00 0xfff00000 0x00 0x10000 0x00 0xfff10000 0x00 0x10000 0x00 0xfff20000 0x00 0x10000>;
		interrupts = <0x01 0x09 0x04 0x00>;
		phandle = <0x01>;

		interrupt-controller@fee20000 {
			compatible = "arm,gic-v3-its";
			msi-controller;
			reg = <0x00 0xfee20000 0x00 0x20000>;
			phandle = <0x7a>;
		};

		ppi-partitions {

			interrupt-partition-0 {
				affinity = <0x02 0x03 0x04 0x05>;
				phandle = <0x0e>;
			};

			interrupt-partition-1 {
				affinity = <0x06 0x07>;
				phandle = <0x0f>;
			};
		};
	};

	saradc@ff100000 {
		compatible = "rockchip,rk3399-saradc";
		reg = <0x00 0xff100000 0x00 0x100>;
		interrupts = <0x00 0x3e 0x04 0x00>;
		#io-channel-cells = <0x01>;
		clocks = <0x08 0x50 0x08 0x165>;
		clock-names = "saradc\0apb_pclk";
		resets = <0x08 0xd4>;
		reset-names = "saradc-apb";
		status = "disabled";
		phandle = <0xd6>;
	};

	i2c@ff3c0000 {
		compatible = "rockchip,rk3399-i2c";
		reg = <0x00 0xff3c0000 0x00 0x1000>;
		clocks = <0x25 0x09 0x25 0x1b>;
		clock-names = "i2c\0pclk";
		interrupts = <0x00 0x39 0x04 0x00>;
		pinctrl-names = "default";
		pinctrl-0 = <0x26>;
		#address-cells = <0x01>;
		#size-cells = <0x00>;
		status = "okay";
		phandle = <0xd7>;

		backlight@2c {
			compatible = "ti,lp8556";
			reg = <0x2c>;
			bl-name = "lcd-bl";
			dev-ctrl = [85];
			init-brt = [10];
			power-supply = <0x27>;
		};
	};

	i2c@ff110000 {
		compatible = "rockchip,rk3399-i2c";
		reg = <0x00 0xff110000 0x00 0x1000>;
		clocks = <0x08 0x41 0x08 0x155>;
		clock-names = "i2c\0pclk";
		interrupts = <0x00 0x3b 0x04 0x00>;
		pinctrl-names = "default";
		pinctrl-0 = <0x28>;
		#address-cells = <0x01>;
		#size-cells = <0x00>;
		status = "okay";
		phandle = <0xd8>;

		rt5514@57 {
			compatible = "realtek,rt5514";
			reg = <0x57>;
			pinctrl-names = "default";
			pinctrl-0 = <0x29>;
			interrupt-parent = <0x2a>;
			interrupts = <0x0d 0x04>;
			phandle = <0xd9>;
		};
	};

	i2c@ff120000 {
		compatible = "rockchip,rk3399-i2c";
		reg = <0x00 0xff120000 0x00 0x1000>;
		clocks = <0x08 0x42 0x08 0x156>;
		clock-names = "i2c\0pclk";
		interrupts = <0x00 0x23 0x04 0x00>;
		pinctrl-names = "default";
		pinctrl-0 = <0x2b>;
		#address-cells = <0x01>;
		#size-cells = <0x00>;
		status = "okay";
		phandle = <0xda>;
	};

	i2c@ff130000 {
		compatible = "rockchip,rk3399-i2c";
		reg = <0x00 0xff130000 0x00 0x1000>;
		clocks = <0x08 0x43 0x08 0x157>;
		clock-names = "i2c\0pclk";
		interrupts = <0x00 0x22 0x04 0x00>;
		pinctrl-names = "default";
		pinctrl-0 = <0x2c>;
		#address-cells = <0x01>;
		#size-cells = <0x00>;
		status = "okay";
		phandle = <0xdb>;
	};

	i2c@ff140000 {
		compatible = "rockchip,rk3399-i2c";
		reg = <0x00 0xff140000 0x00 0x1000>;
		clocks = <0x08 0x44 0x08 0x158>;
		clock-names = "i2c\0pclk";
		interrupts = <0x00 0x26 0x04 0x00>;
		pinctrl-names = "default";
		pinctrl-0 = <0x2d 0x2e>;
		#address-cells = <0x01>;
		#size-cells = <0x00>;
		status = "okay";
		clock-frequency = <0x61a80>;
		i2c-scl-falling-time-ns = <0x32>;
		i2c-scl-rising-time-ns = <0x12c>;
		phandle = <0xdc>;
	};

	i2c@ff150000 {
		compatible = "rockchip,rk3399-i2c";
		reg = <0x00 0xff150000 0x00 0x1000>;
		clocks = <0x08 0x45 0x08 0x159>;
		clock-names = "i2c\0pclk";
		interrupts = <0x00 0x25 0x04 0x00>;
		pinctrl-names = "default";
		pinctrl-0 = <0x2f>;
		#address-cells = <0x01>;
		#size-cells = <0x00>;
		status = "disabled";
		phandle = <0xdd>;
	};

	i2c@ff160000 {
		compatible = "rockchip,rk3399-i2c";
		reg = <0x00 0xff160000 0x00 0x1000>;
		clocks = <0x08 0x46 0x08 0x15a>;
		clock-names = "i2c\0pclk";
		interrupts = <0x00 0x24 0x04 0x00>;
		pinctrl-names = "default";
		pinctrl-0 = <0x30>;
		#address-cells = <0x01>;
		#size-cells = <0x00>;
		status = "okay";
		phandle = <0xde>;
	};

	serial@ff180000 {
		compatible = "rockchip,rk3399-uart\0snps,dw-apb-uart";
		reg = <0x00 0xff180000 0x00 0x100>;
		clocks = <0x08 0x51 0x08 0x160>;
		clock-names = "baudclk\0apb_pclk";
		interrupts = <0x00 0x63 0x04 0x00>;
		reg-shift = <0x02>;
		reg-io-width = <0x04>;
		pinctrl-names = "default";
		pinctrl-0 = <0x31 0x32 0x33>;
		status = "disabled";
		phandle = <0xdf>;
	};

	serial@ff190000 {
		compatible = "rockchip,rk3399-uart\0snps,dw-apb-uart";
		reg = <0x00 0xff190000 0x00 0x100>;
		clocks = <0x08 0x52 0x08 0x161>;
		clock-names = "baudclk\0apb_pclk";
		interrupts = <0x00 0x62 0x04 0x00>;
		reg-shift = <0x02>;
		reg-io-width = <0x04>;
		pinctrl-names = "default";
		pinctrl-0 = <0x34>;
		status = "disabled";
		phandle = <0xe0>;
	};

	serial@ff1a0000 {
		compatible = "rockchip,rk3399-uart\0snps,dw-apb-uart";
		reg = <0x00 0xff1a0000 0x00 0x100>;
		clocks = <0x08 0x53 0x08 0x162>;
		clock-names = "baudclk\0apb_pclk";
		interrupts = <0x00 0x64 0x04 0x00>;
		reg-shift = <0x02>;
		reg-io-width = <0x04>;
		pinctrl-names = "default";
		pinctrl-0 = <0x35>;
		status = "okay";
		phandle = <0xe1>;
	};

	serial@ff1b0000 {
		compatible = "rockchip,rk3399-uart\0snps,dw-apb-uart";
		reg = <0x00 0xff1b0000 0x00 0x100>;
		clocks = <0x08 0x54 0x08 0x163>;
		clock-names = "baudclk\0apb_pclk";
		interrupts = <0x00 0x65 0x04 0x00>;
		reg-shift = <0x02>;
		reg-io-width = <0x04>;
		pinctrl-names = "default";
		pinctrl-0 = <0x36 0x37 0x38>;
		status = "disabled";
		phandle = <0xe2>;
	};

	spi@ff1c0000 {
		compatible = "rockchip,rk3399-spi\0rockchip,rk3066-spi";
		reg = <0x00 0xff1c0000 0x00 0x1000>;
		clocks = <0x08 0x47 0x08 0x15b>;
		clock-names = "spiclk\0apb_pclk";
		interrupts = <0x00 0x44 0x04 0x00>;
		dmas = <0x39 0x0a 0x39 0x0b>;
		dma-names = "tx\0rx";
		pinctrl-names = "default";
		pinctrl-0 = <0x3a 0x3b 0x3c 0x3d>;
		#address-cells = <0x01>;
		#size-cells = <0x00>;
		status = "okay";
		phandle = <0xe3>;

		tpm@0 {
			compatible = "spidev";
			spi-max-frequency = <0x989680>;
			reg = <0x00>;
		};
	};

	spi@ff1d0000 {
		compatible = "rockchip,rk3399-spi\0rockchip,rk3066-spi";
		reg = <0x00 0xff1d0000 0x00 0x1000>;
		clocks = <0x08 0x48 0x08 0x15c>;
		clock-names = "spiclk\0apb_pclk";
		interrupts = <0x00 0x35 0x04 0x00>;
		dmas = <0x39 0x0c 0x39 0x0d>;
		dma-names = "tx\0rx";
		pinctrl-names = "default";
		pinctrl-0 = <0x3e 0x3f 0x40 0x41>;
		#address-cells = <0x01>;
		#size-cells = <0x00>;
		status = "okay";
		phandle = <0xe4>;

		spiflash@0 {
			compatible = "spidev";
			spi-max-frequency = <0x989680>;
			reg = <0x00>;
		};
	};

	spi@ff1e0000 {
		compatible = "rockchip,rk3399-spi\0rockchip,rk3066-spi";
		reg = <0x00 0xff1e0000 0x00 0x1000>;
		clocks = <0x08 0x49 0x08 0x15d>;
		clock-names = "spiclk\0apb_pclk";
		interrupts = <0x00 0x34 0x04 0x00>;
		dmas = <0x39 0x0e 0x39 0x0f>;
		dma-names = "tx\0rx";
		pinctrl-names = "default";
		pinctrl-0 = <0x42 0x43 0x44 0x45>;
		#address-cells = <0x01>;
		#size-cells = <0x00>;
		status = "okay";
		phandle = <0xe5>;

		wacky_spi_audio@0 {
			compatible = "spidev";
			spi-max-frequency = <0x989680>;
			reg = <0x00>;
		};
	};

	spi@ff1f0000 {
		compatible = "rockchip,rk3399-spi\0rockchip,rk3066-spi";
		reg = <0x00 0xff1f0000 0x00 0x1000>;
		clocks = <0x08 0x4a 0x08 0x15e>;
		clock-names = "spiclk\0apb_pclk";
		interrupts = <0x00 0x43 0x04 0x00>;
		dmas = <0x39 0x12 0x39 0x13>;
		dma-names = "tx\0rx";
		pinctrl-names = "default";
		pinctrl-0 = <0x46 0x47 0x48 0x49>;
		#address-cells = <0x01>;
		#size-cells = <0x00>;
		status = "okay";
		phandle = <0xe6>;

		fingerprint@0 {
			compatible = "spidev";
			spi-max-frequency = <0x989680>;
			reg = <0x00>;
		};
	};

	spi@ff200000 {
		compatible = "rockchip,rk3399-spi\0rockchip,rk3066-spi";
		reg = <0x00 0xff200000 0x00 0x1000>;
		clocks = <0x08 0x4b 0x08 0x15f>;
		clock-names = "spiclk\0apb_pclk";
		interrupts = <0x00 0x84 0x04 0x00>;
		dmas = <0x4a 0x08 0x4a 0x09>;
		dma-names = "tx\0rx";
		pinctrl-names = "default";
		pinctrl-0 = <0x4b 0x4c 0x4d 0x4e>;
		#address-cells = <0x01>;
		#size-cells = <0x00>;
		power-domains = <0x10 0x1c>;
		status = "okay";
		phandle = <0xe7>;

		ec@0 {
			compatible = "google,cros-ec-spi";
			reg = <0x00>;
			pinctrl-names = "default";
			pinctrl-0 = <0x4f>;
			google,cros-ec-spi-pre-delay = <0x1e>;
			interrupt-parent = <0x50>;
			interrupts = <0x01 0x08>;
			spi-max-frequency = <0x2dc6c0>;
			phandle = <0xe8>;

			i2c-tunnel {
				compatible = "google,cros-ec-i2c-tunnel";
				google,remote-bus = <0x00>;
				#address-cells = <0x01>;
				#size-cells = <0x00>;
				phandle = <0xe9>;
			};
		};
	};

	thermal-zones {
		phandle = <0xea>;

		soc-thermal {
			polling-delay-passive = <0x14>;
			polling-delay = <0x3e8>;
			sustainable-power = <0x3e8>;
			thermal-sensors = <0x51 0x00>;
			phandle = <0xeb>;

			trips {

				trip-point-0 {
					temperature = <0x11170>;
					hysteresis = <0x7d0>;
					type = "passive";
					phandle = <0xec>;
				};

				trip-point-1 {
					temperature = <0x14c08>;
					hysteresis = <0x7d0>;
					type = "passive";
					phandle = <0x52>;
				};

				soc-crit {
					temperature = <0x1c138>;
					hysteresis = <0x7d0>;
					type = "critical";
					phandle = <0xed>;
				};
			};

			cooling-maps {

				map0 {
					trip = <0x52>;
					cooling-device = <0x02 0xffffffff 0xffffffff>;
					contribution = <0x1000>;
				};

				map1 {
					trip = <0x52>;
					cooling-device = <0x06 0xffffffff 0xffffffff>;
					contribution = <0x400>;
				};

				map2 {
					trip = <0x52>;
					cooling-device = <0x53 0xffffffff 0xffffffff>;
					contribution = <0x1000>;
				};
			};
		};

		gpu-thermal {
			polling-delay-passive = <0x64>;
			polling-delay = <0x3e8>;
			thermal-sensors = <0x51 0x01>;
			phandle = <0xee>;
		};
	};

	tsadc@ff260000 {
		compatible = "rockchip,rk3399-tsadc";
		reg = <0x00 0xff260000 0x00 0x100>;
		interrupts = <0x00 0x61 0x04 0x00>;
		assigned-clocks = <0x08 0x4f>;
		assigned-clock-rates = <0xb71b0>;
		clocks = <0x08 0x4f 0x08 0x164>;
		clock-names = "tsadc\0apb_pclk";
		resets = <0x08 0xe8>;
		reset-names = "tsadc-apb";
		rockchip,grf = <0x11>;
		rockchip,hw-tshut-temp = <0x1d4c0>;
		pinctrl-names = "gpio\0otpout";
		pinctrl-0 = <0x54>;
		pinctrl-1 = <0x55>;
		#thermal-sensor-cells = <0x01>;
		status = "okay";
		rockchip,hw-tshut-mode = <0x01>;
		rockchip,hw-tshut-polarity = <0x01>;
		phandle = <0x51>;
	};

	qos@ffa58000 {
		compatible = "syscon";
		reg = <0x00 0xffa58000 0x00 0x20>;
		phandle = <0x5d>;
	};

	qos@ffa5c000 {
		compatible = "syscon";
		reg = <0x00 0xffa5c000 0x00 0x20>;
		phandle = <0x5e>;
	};

	qos@ffa60080 {
		compatible = "syscon";
		reg = <0x00 0xffa60080 0x00 0x20>;
		phandle = <0x60>;
	};

	qos@ffa60100 {
		compatible = "syscon";
		reg = <0x00 0xffa60100 0x00 0x20>;
		phandle = <0x61>;
	};

	qos@ffa60180 {
		compatible = "syscon";
		reg = <0x00 0xffa60180 0x00 0x20>;
		phandle = <0x62>;
	};

	qos@ffa70000 {
		compatible = "syscon";
		reg = <0x00 0xffa70000 0x00 0x20>;
		phandle = <0x65>;
	};

	qos@ffa70080 {
		compatible = "syscon";
		reg = <0x00 0xffa70080 0x00 0x20>;
		phandle = <0x66>;
	};

	qos@ffa74000 {
		compatible = "syscon";
		reg = <0x00 0xffa74000 0x00 0x20>;
		phandle = <0x63>;
	};

	qos@ffa76000 {
		compatible = "syscon";
		reg = <0x00 0xffa76000 0x00 0x20>;
		phandle = <0x64>;
	};

	qos@ffa90000 {
		compatible = "syscon";
		reg = <0x00 0xffa90000 0x00 0x20>;
		phandle = <0x67>;
	};

	qos@ffa98000 {
		compatible = "syscon";
		reg = <0x00 0xffa98000 0x00 0x20>;
		phandle = <0x56>;
	};

	qos@ffaa0000 {
		compatible = "syscon";
		reg = <0x00 0xffaa0000 0x00 0x20>;
		phandle = <0x68>;
	};

	qos@ffaa0080 {
		compatible = "syscon";
		reg = <0x00 0xffaa0080 0x00 0x20>;
		phandle = <0x69>;
	};

	qos@ffaa8000 {
		compatible = "syscon";
		reg = <0x00 0xffaa8000 0x00 0x20>;
		phandle = <0x6a>;
	};

	qos@ffaa8080 {
		compatible = "syscon";
		reg = <0x00 0xffaa8080 0x00 0x20>;
		phandle = <0x6b>;
	};

	qos@ffab0000 {
		compatible = "syscon";
		reg = <0x00 0xffab0000 0x00 0x20>;
		phandle = <0x57>;
	};

	qos@ffab0080 {
		compatible = "syscon";
		reg = <0x00 0xffab0080 0x00 0x20>;
		phandle = <0x58>;
	};

	qos@ffab8000 {
		compatible = "syscon";
		reg = <0x00 0xffab8000 0x00 0x20>;
		phandle = <0x59>;
	};

	qos@ffac0000 {
		compatible = "syscon";
		reg = <0x00 0xffac0000 0x00 0x20>;
		phandle = <0x5a>;
	};

	qos@ffac0080 {
		compatible = "syscon";
		reg = <0x00 0xffac0080 0x00 0x20>;
		phandle = <0x5b>;
	};

	qos@ffac8000 {
		compatible = "syscon";
		reg = <0x00 0xffac8000 0x00 0x20>;
		phandle = <0x6c>;
	};

	qos@ffac8080 {
		compatible = "syscon";
		reg = <0x00 0xffac8080 0x00 0x20>;
		phandle = <0x6d>;
	};

	qos@ffad0000 {
		compatible = "syscon";
		reg = <0x00 0xffad0000 0x00 0x20>;
		phandle = <0x6e>;
	};

	qos@ffad8080 {
		compatible = "syscon";
		reg = <0x00 0xffad8080 0x00 0x20>;
		phandle = <0x5f>;
	};

	qos@ffae0000 {
		compatible = "syscon";
		reg = <0x00 0xffae0000 0x00 0x20>;
		phandle = <0x5c>;
	};

	power-management@ff310000 {
		compatible = "rockchip,rk3399-pmu\0syscon\0simple-mfd";
		reg = <0x00 0xff310000 0x00 0x1000>;
		phandle = <0xef>;

		power-controller {
			compatible = "rockchip,rk3399-power-controller";
			#power-domain-cells = <0x01>;
			#address-cells = <0x01>;
			#size-cells = <0x00>;
			phandle = <0x10>;

			pd_iep@34 {
				reg = <0x22>;
				clocks = <0x08 0xe1 0x08 0x1dd>;
				pm_qos = <0x56>;
			};

			pd_rga@33 {
				reg = <0x21>;
				clocks = <0x08 0xdc 0x08 0x1e5>;
				pm_qos = <0x57 0x58>;
			};

			pd_vcodec@31 {
				reg = <0x1f>;
				clocks = <0x08 0xeb 0x08 0x1ea>;
				pm_qos = <0x59>;
			};

			pd_vdu@32 {
				reg = <0x20>;
				clocks = <0x08 0xed 0x08 0x1ec>;
				pm_qos = <0x5a 0x5b>;
			};

			pd_gpu@35 {
				reg = <0x23>;
				clocks = <0x08 0xd0>;
				pm_qos = <0x5c>;
			};

			pd_edp@25 {
				reg = <0x19>;
				clocks = <0x08 0x16c>;
			};

			pd_emmc@23 {
				reg = <0x17>;
				clocks = <0x08 0xf0>;
				pm_qos = <0x5d>;
			};

			pd_gmac@22 {
				reg = <0x16>;
				clocks = <0x08 0xd5 0x08 0x166>;
				pm_qos = <0x5e>;
			};

			pd_perihp@14 {
				reg = <0x0e>;
				#address-cells = <0x01>;
				#size-cells = <0x00>;
				clocks = <0x08 0xc0>;
				pm_qos = <0x5f 0x60 0x61 0x62>;

				pd_sd@27 {
					reg = <0x1b>;
					clocks = <0x08 0x1ce 0x08 0x4c>;
					pm_qos = <0x63>;
				};
			};

			pd_sdioaudio@28 {
				reg = <0x1c>;
				clocks = <0x08 0x1ee>;
				pm_qos = <0x64>;
			};

			pd_usb3@24 {
				reg = <0x18>;
				clocks = <0x08 0xf4>;
				pm_qos = <0x65 0x66>;
			};

			pd_vio@15 {
				reg = <0x0f>;
				#address-cells = <0x01>;
				#size-cells = <0x00>;

				pd_hdcp@21 {
					reg = <0x15>;
					clocks = <0x08 0xde 0x08 0x1e7 0x08 0x172>;
					pm_qos = <0x67>;
				};

				pd_isp0@19 {
					reg = <0x13>;
					clocks = <0x08 0xe5 0x08 0x1df>;
					pm_qos = <0x68 0x69>;
				};

				pd_isp1@20 {
					reg = <0x14>;
					clocks = <0x08 0xe6 0x08 0x1e0>;
					pm_qos = <0x6a 0x6b>;
				};

				pd_tcpc0@RK3399_PD_TCPC0 {
					reg = <0x08>;
					clocks = <0x08 0x7e 0x08 0x7d>;
				};

				pd_tcpc1@RK3399_PD_TCPC1 {
					reg = <0x09>;
					clocks = <0x08 0x80 0x08 0x7f>;
				};

				pd_vo@16 {
					reg = <0x10>;
					#address-cells = <0x01>;
					#size-cells = <0x00>;

					pd_vopb@17 {
						reg = <0x11>;
						clocks = <0x08 0xd9 0x08 0x1d9>;
						pm_qos = <0x6c 0x6d>;
					};

					pd_vopl@18 {
						reg = <0x12>;
						clocks = <0x08 0xdb 0x08 0x1db>;
						pm_qos = <0x6e>;
					};
				};
			};
		};
	};

	syscon@ff320000 {
		compatible = "rockchip,rk3399-pmugrf\0syscon\0simple-mfd";
		reg = <0x00 0xff320000 0x00 0x1000>;
		#address-cells = <0x01>;
		#size-cells = <0x01>;
		phandle = <0x81>;

		io-domains {
			compatible = "rockchip,rk3399-pmu-io-voltage-domain";
			status = "okay";
			pmu1830-supply = <0x6f>;
			phandle = <0xf0>;
		};

		reboot-mode {
			compatible = "syscon-reboot-mode";
			offset = <0x300>;
			mode-bootloader = <0x5242c301>;
			mode-charge = <0x5242c30b>;
			mode-fastboot = <0x5242c309>;
			mode-loader = <0x5242c301>;
			mode-normal = <0x5242c300>;
			mode-recovery = <0x5242c303>;
			mode-ums = <0x5242c30c>;
		};

		pmu-pvtm {
			compatible = "rockchip,rk3399-pmu-pvtm";
			clocks = <0x25 0x07>;
			clock-names = "pmu";
			resets = <0x08 0x1b>;
			reset-names = "pmu";
			status = "okay";
			phandle = <0xf1>;
		};
	};

	spi@ff350000 {
		compatible = "rockchip,rk3399-spi\0rockchip,rk3066-spi";
		reg = <0x00 0xff350000 0x00 0x1000>;
		clocks = <0x25 0x03 0x25 0x1f>;
		clock-names = "spiclk\0apb_pclk";
		interrupts = <0x00 0x3c 0x04 0x00>;
		pinctrl-names = "default";
		pinctrl-0 = <0x70 0x71 0x72 0x73>;
		#address-cells = <0x01>;
		#size-cells = <0x00>;
		status = "disabled";
		phandle = <0xf2>;
	};

	serial@ff370000 {
		compatible = "rockchip,rk3399-uart\0snps,dw-apb-uart";
		reg = <0x00 0xff370000 0x00 0x100>;
		clocks = <0x25 0x06 0x25 0x22>;
		clock-names = "baudclk\0apb_pclk";
		interrupts = <0x00 0x66 0x04 0x00>;
		reg-shift = <0x02>;
		reg-io-width = <0x04>;
		pinctrl-names = "default";
		pinctrl-0 = <0x74>;
		status = "disabled";
		phandle = <0xf3>;
	};

	i2c@ff3d0000 {
		compatible = "rockchip,rk3399-i2c";
		reg = <0x00 0xff3d0000 0x00 0x1000>;
		clocks = <0x25 0x0a 0x25 0x1c>;
		clock-names = "i2c\0pclk";
		interrupts = <0x00 0x38 0x04 0x00>;
		pinctrl-names = "default";
		pinctrl-0 = <0x75>;
		#address-cells = <0x01>;
		#size-cells = <0x00>;
		status = "disabled";
		phandle = <0xf4>;
	};

	i2c@ff3e0000 {
		compatible = "rockchip,rk3399-i2c";
		reg = <0x00 0xff3e0000 0x00 0x1000>;
		clocks = <0x25 0x0b 0x25 0x1d>;
		clock-names = "i2c\0pclk";
		interrupts = <0x00 0x3a 0x04 0x00>;
		pinctrl-names = "default";
		pinctrl-0 = <0x76>;
		#address-cells = <0x01>;
		#size-cells = <0x00>;
		status = "okay";
		phandle = <0xf5>;

		da7219@1a {
			compatible = "dlg,da7219";
			reg = <0x1a>;
			pinctrl-names = "default";
			pinctrl-0 = <0x77 0x78>;
			interrupt-parent = <0x2a>;
			interrupts = <0x17 0x08>;
			VDD-supply = <0x6f>;
			VDDMIC-supply = <0x79>;
			VDDIO-supply = <0x6f>;
			clocks = <0x08 0x59>;
			clock-names = "mclk";
			dlg,ldo-lvl = <0x4b0>;
			dlg,micbias-lvl = <0xa28>;
			dlg,mic-amp-in-sel = "diff";
			phandle = <0xc0>;

			da7219_aad {
				dlg,btn-cfg = <0x32>;
				dlg,mic-det-thr = <0x1f4>;
				dlg,jack-ins-deb = <0x14>;
				dlg,jack-det-rate = "32ms_64ms";
				dlg,jack-rem-deb = <0x01>;
				dlg,a-d-btn-thr = <0x0a>;
				dlg,d-b-btn-thr = <0x16>;
				dlg,b-c-btn-thr = <0x21>;
				dlg,c-mic-btn-thr = <0x3e>;
				dlg,btn-avg = <0x04>;
				dlg,adc-1bit-rpt = <0x01>;
			};
		};
	};

	pcie-phy {
		compatible = "rockchip,rk3399-pcie-phy";
		#phy-cells = <0x00>;
		rockchip,grf = <0x11>;
		clocks = <0x08 0x8a>;
		clock-names = "refclk";
		resets = <0x08 0x87>;
		reset-names = "phy";
		status = "disabled";
		phandle = <0x7c>;
	};

	pcie@f8000000 {
		compatible = "rockchip,rk3399-pcie";
		#address-cells = <0x03>;
		#size-cells = <0x02>;
		aspm-no-l0s;
		clocks = <0x08 0xc5 0x08 0xc4 0x08 0x147 0x08 0xa0>;
		clock-names = "aclk\0aclk-perf\0hclk\0pm";
		bus-range = <0x00 0x1f>;
		max-link-speed = <0x01>;
		linux,pci-domain = <0x00>;
		msi-map = <0x00 0x7a 0x00 0x1000>;
		interrupts = <0x00 0x31 0x04 0x00 0x00 0x32 0x04 0x00 0x00 0x33 0x04 0x00>;
		interrupt-names = "sys\0legacy\0client";
		#interrupt-cells = <0x01>;
		interrupt-map-mask = <0x00 0x00 0x00 0x07>;
		interrupt-map = <0x00 0x00 0x00 0x01 0x7b 0x00 0x00 0x00 0x00 0x02 0x7b 0x01 0x00 0x00 0x00 0x03 0x7b 0x02 0x00 0x00 0x00 0x04 0x7b 0x03>;
		phys = <0x7c>;
		phy-names = "pcie-phy";
		ranges = <0x83000000 0x00 0xfa000000 0x00 0xfa000000 0x00 0x1e00000 0x81000000 0x00 0xfbe00000 0x00 0xfbe00000 0x00 0x100000>;
		reg = <0x00 0xf8000000 0x00 0x2000000 0x00 0xfd000000 0x00 0x1000000>;
		reg-names = "axi-base\0apb-base";
		resets = <0x08 0x82 0x08 0x83 0x08 0x84 0x08 0x85 0x08 0x86 0x08 0x81 0x08 0x80>;
		reset-names = "core\0mgmt\0mgmt-sticky\0pipe\0pm\0pclk\0aclk";
		status = "disabled";
		phandle = <0xf6>;

		interrupt-controller {
			interrupt-controller;
			#address-cells = <0x00>;
			#interrupt-cells = <0x01>;
			phandle = <0x7b>;
		};
	};

	pwm@ff420000 {
		compatible = "rockchip,rk3399-pwm\0rockchip,rk3288-pwm";
		reg = <0x00 0xff420000 0x00 0x10>;
		#pwm-cells = <0x03>;
		pinctrl-names = "active";
		pinctrl-0 = <0x7d>;
		clocks = <0x25 0x1e>;
		clock-names = "pwm";
		status = "disabled";
		phandle = <0xb5>;
	};

	pwm@ff420010 {
		compatible = "rockchip,rk3399-pwm\0rockchip,rk3288-pwm";
		reg = <0x00 0xff420010 0x00 0x10>;
		#pwm-cells = <0x03>;
		pinctrl-names = "active";
		pinctrl-0 = <0x7e>;
		clocks = <0x25 0x1e>;
		clock-names = "pwm";
		status = "disabled";
		phandle = <0xb3>;
	};

	pwm@ff420020 {
		compatible = "rockchip,rk3399-pwm\0rockchip,rk3288-pwm";
		reg = <0x00 0xff420020 0x00 0x10>;
		#pwm-cells = <0x03>;
		pinctrl-names = "active";
		pinctrl-0 = <0x7f>;
		clocks = <0x25 0x1e>;
		clock-names = "pwm";
		status = "disabled";
		phandle = <0xb4>;
	};

	pwm@ff420030 {
		compatible = "rockchip,rk3399-pwm\0rockchip,rk3288-pwm";
		reg = <0x00 0xff420030 0x00 0x10>;
		#pwm-cells = <0x03>;
		pinctrl-names = "active";
		pinctrl-0 = <0x80>;
		clocks = <0x25 0x1e>;
		clock-names = "pwm";
		status = "disabled";
		phandle = <0xb6>;
	};

	dfi@ff630000 {
		reg = <0x00 0xff630000 0x00 0x4000>;
		compatible = "rockchip,rk3399-dfi";
		rockchip,pmu = <0x81>;
		clocks = <0x08 0x179>;
		clock-names = "pclk_ddr_mon";
		status = "disabled";
		phandle = <0x82>;
	};

	dmc {
		compatible = "rockchip,rk3399-dmc";
		devfreq-events = <0x82>;
		interrupts = <0x00 0x01 0x04 0x00>;
		clocks = <0x08 0xaa>;
		clock-names = "dmc_clk";
		ddr_timing = <0x83>;
		upthreshold = <0x28>;
		downdifferential = <0x14>;
		system-status-freq = <0x01 0xc3500 0x08 0x80e80 0x02 0x30d40 0x20 0x493e0 0x10 0x927c0 0x10000 0xc3500 0x2000 0xc3500 0x1000 0x61a80 0xc00 0x927c0 0x4000 0x927c0>;
		auto-min-freq = <0x61a80>;
		auto-freq-en = <0x01>;
		status = "disabled";
		phandle = <0x9c>;
	};

	vpu_service@ff650000 {
		compatible = "rockchip,vpu_service";
		rockchip,grf = <0x11>;
		iommus = <0x84>;
		iommu_enabled = <0x01>;
		reg = <0x00 0xff650000 0x00 0x800>;
		interrupts = <0x00 0x71 0x04 0x00 0x00 0x72 0x04 0x00>;
		interrupt-names = "irq_dec\0irq_enc";
		clocks = <0x08 0xeb 0x08 0x1ea>;
		clock-names = "aclk_vcodec\0hclk_vcodec";
		resets = <0x08 0x53 0x08 0x51>;
		reset-names = "video_h\0video_a";
		power-domains = <0x10 0x1f>;
		dev_mode = <0x00>;
		allocator = <0x01>;
		status = "disabled";
		phandle = <0xf7>;
	};

	iommu@ff650800 {
		compatible = "rockchip,iommu";
		reg = <0x00 0xff650800 0x00 0x40>;
		interrupts = <0x00 0x73 0x04 0x00>;
		interrupt-names = "vpu_mmu";
		clocks = <0x08 0xeb 0x08 0x1ea>;
		clock-names = "aclk\0hclk";
		power-domains = <0x10 0x1f>;
		#iommu-cells = <0x00>;
		phandle = <0x84>;
	};

	rkvdec@ff660000 {
		compatible = "rockchip,rkvdec";
		rockchip,grf = <0x11>;
		iommus = <0x85>;
		iommu_enabled = <0x01>;
		reg = <0x00 0xff660000 0x00 0x400>;
		interrupts = <0x00 0x74 0x04 0x00>;
		interrupt-names = "irq_dec";
		clocks = <0x08 0xed 0x08 0x1ec 0x08 0x9f 0x08 0x9e>;
		clock-names = "aclk_vcodec\0hclk_vcodec\0clk_cabac\0clk_core";
		resets = <0x08 0x5b 0x08 0x59 0x08 0x5c 0x08 0x5d 0x08 0x58 0x08 0x5a>;
		reset-names = "video_h\0video_a\0video_core\0video_cabac\0niu_a\0niu_h";
		power-domains = <0x10 0x20>;
		dev_mode = <0x02>;
		allocator = <0x01>;
		status = "disabled";
		phandle = <0xf8>;
	};

	iommu@ff660480 {
		compatible = "rockchip,iommu";
		reg = <0x00 0xff660480 0x00 0x40 0x00 0xff6604c0 0x00 0x40>;
		interrupts = <0x00 0x75 0x04 0x00>;
		interrupt-names = "vdec_mmu";
		clocks = <0x08 0xed 0x08 0x1ec>;
		clock-names = "aclk\0hclk";
		power-domains = <0x10 0x20>;
		#iommu-cells = <0x00>;
		phandle = <0x85>;
	};

	iep@ff670000 {
		compatible = "rockchip,iep";
		iommu_enabled = <0x01>;
		iommus = <0x86>;
		reg = <0x00 0xff670000 0x00 0x800>;
		interrupts = <0x00 0x2a 0x04 0x00>;
		clocks = <0x08 0xe1 0x08 0x1dd>;
		clock-names = "aclk_iep\0hclk_iep";
		power-domains = <0x10 0x22>;
		allocator = <0x01>;
		version = <0x02>;
		status = "disabled";
		phandle = <0xf9>;
	};

	iommu@ff670800 {
		compatible = "rockchip,iommu";
		reg = <0x00 0xff670800 0x00 0x40>;
		interrupts = <0x00 0x2a 0x04 0x00>;
		interrupt-names = "iep_mmu";
		#iommu-cells = <0x00>;
		status = "disabled";
		phandle = <0x86>;
	};

	rga@ff680000 {
		compatible = "rockchip,rk3399-rga";
		reg = <0x00 0xff680000 0x00 0x10000>;
		interrupts = <0x00 0x37 0x04 0x00>;
		clocks = <0x08 0xdc 0x08 0x1e5 0x08 0x6d>;
		clock-names = "aclk\0hclk\0sclk";
		resets = <0x08 0x6a 0x08 0x67 0x08 0x69>;
		reset-names = "core\0axi\0ahb";
		power-domains = <0x10 0x21>;
		status = "disabled";
		phandle = <0xfa>;
	};

	efuse@ff690000 {
		compatible = "rockchip,rk3399-efuse";
		reg = <0x00 0xff690000 0x00 0x80>;
		#address-cells = <0x01>;
		#size-cells = <0x01>;
		clocks = <0x08 0x17d>;
		clock-names = "pclk_efuse";
		phandle = <0xfb>;

		specification-serial-number@6 {
			reg = <0x06 0x01>;
			bits = <0x00 0x05>;
			phandle = <0xfc>;
		};

		cpu-id@7 {
			reg = <0x07 0x10>;
			phandle = <0x0d>;
		};

		cpu-leakage@17 {
			reg = <0x17 0x01>;
			phandle = <0xfd>;
		};

		gpu-leakage@18 {
			reg = <0x18 0x01>;
			phandle = <0xfe>;
		};

		center-leakage@19 {
			reg = <0x19 0x01>;
			phandle = <0xff>;
		};

		cpu-leakage@1a {
			reg = <0x1a 0x01>;
			phandle = <0x100>;
		};

		logic-leakage@1b {
			reg = <0x1b 0x01>;
			phandle = <0x101>;
		};

		wafer-info@1c {
			reg = <0x1c 0x01>;
			phandle = <0x102>;
		};
	};

	pmu-clock-controller@ff750000 {
		compatible = "rockchip,rk3399-pmucru";
		reg = <0x00 0xff750000 0x00 0x1000>;
		#clock-cells = <0x01>;
		#reset-cells = <0x01>;
		assigned-clocks = <0x25 0x01 0x25 0x2c>;
		assigned-clock-rates = <0x284af100 0x5c81a40>;
		phandle = <0x25>;
	};

	clock-controller@ff760000 {
		compatible = "rockchip,rk3399-cru";
		reg = <0x00 0xff760000 0x00 0x1000>;
		#clock-cells = <0x01>;
		#reset-cells = <0x01>;
		assigned-clocks = <0x08 0x05 0x08 0x04 0x08 0x06 0x08 0xc0 0x08 0x1c0 0x08 0x140 0x08 0xc2 0x08 0x1c1 0x08 0x142 0x08 0xc9 0x08 0x1c2 0x08 0x143 0x08 0xe3 0x08 0xde 0x08 0x106 0x08 0x178>;
		assigned-clock-rates = <0x23c34600 0x2faf0800 0x3b9aca00 0x8f0d180 0x47868c0 0x23c3460 0x5f5e100 0x5f5e100 0x2faf080 0x2faf0800 0x5f5e100 0x2faf080 0x17d78400 0x17d78400 0xbebc200 0xbebc200>;
		phandle = <0x08>;
	};

	syscon@ff770000 {
		compatible = "rockchip,rk3399-grf\0syscon\0simple-mfd";
		reg = <0x00 0xff770000 0x00 0x10000>;
		#address-cells = <0x01>;
		#size-cells = <0x01>;
		phandle = <0x11>;

		io-domains {
			compatible = "rockchip,rk3399-io-voltage-domain";
			status = "okay";
			bt656-supply = <0x6f>;
			audio-supply = <0x87>;
			sdmmc-supply = <0x19>;
			gpio1830-supply = <0x88>;
			phandle = <0x103>;
		};

		usb2-phy@e450 {
			compatible = "rockchip,rk3399-usb2phy";
			reg = <0xe450 0x10>;
			clocks = <0x08 0x7b>;
			clock-names = "phyclk";
			#clock-cells = <0x00>;
			clock-output-names = "clk_usbphy0_480m";
			status = "disabled";
			phandle = <0x104>;

			host-port {
				#phy-cells = <0x00>;
				interrupts = <0x00 0x1b 0x04 0x00>;
				interrupt-names = "linestate";
				status = "disabled";
				phandle = <0x1b>;
			};

			otg-port {
				#phy-cells = <0x00>;
				interrupts = <0x00 0x67 0x04 0x00 0x00 0x68 0x04 0x00 0x00 0x6a 0x04 0x00>;
				interrupt-names = "otg-bvalid\0otg-id\0linestate";
				status = "disabled";
				phandle = <0x1d>;
			};
		};

		usb2-phy@e460 {
			compatible = "rockchip,rk3399-usb2phy";
			reg = <0xe460 0x10>;
			clocks = <0x08 0x7c>;
			clock-names = "phyclk";
			#clock-cells = <0x00>;
			clock-output-names = "clk_usbphy1_480m";
			status = "disabled";
			phandle = <0x105>;

			host-port {
				#phy-cells = <0x00>;
				interrupts = <0x00 0x1f 0x04 0x00>;
				interrupt-names = "linestate";
				status = "disabled";
				phandle = <0x1c>;
			};

			otg-port {
				#phy-cells = <0x00>;
				interrupts = <0x00 0x6c 0x04 0x00 0x00 0x6d 0x04 0x00 0x00 0x6f 0x04 0x00>;
				interrupt-names = "otg-bvalid\0otg-id\0linestate";
				status = "disabled";
				phandle = <0x1f>;
			};
		};

		phy@f780 {
			compatible = "rockchip,rk3399-emmc-phy";
			reg = <0xf780 0x24>;
			clocks = <0x89>;
			clock-names = "emmcclk";
			#phy-cells = <0x00>;
			status = "okay";
			phandle = <0x1a>;
		};

		mipi-dphy-rx0 {
			compatible = "rockchip,rk3399-mipi-dphy";
			clocks = <0x08 0x77 0x08 0xa5 0x08 0x16f>;
			clock-names = "dphy-ref\0dphy-cfg\0grf";
			power-domains = <0x10 0x0f>;
			status = "disabled";
			phandle = <0x106>;
		};

		pvtm {
			compatible = "rockchip,rk3399-pvtm";
			clocks = <0x08 0x73 0x08 0x74 0x08 0x75 0x08 0x76>;
			clock-names = "core_l\0core_b\0gpu\0ddr";
			resets = <0x08 0x1f 0x08 0x2f 0x08 0x123 0x08 0x4f>;
			reset-names = "core_l\0core_b\0gpu\0ddr";
			status = "okay";
			phandle = <0x107>;
		};
	};

	phy@ff7c0000 {
		compatible = "rockchip,rk3399-typec-phy";
		reg = <0x00 0xff7c0000 0x00 0x40000>;
		#phy-cells = <0x01>;
		clocks = <0x08 0x7e 0x08 0x7d>;
		clock-names = "tcpdcore\0tcpdphy-ref";
		assigned-clocks = <0x08 0x7e>;
		assigned-clock-rates = <0x2faf080>;
		power-domains = <0x10 0x08>;
		resets = <0x08 0x95 0x08 0x94 0x08 0x14c>;
		reset-names = "uphy\0uphy-pipe\0uphy-tcphy";
		rockchip,grf = <0x11>;
		rockchip,typec-conn-dir = <0xe580 0x00 0x10>;
		rockchip,usb3tousb2-en = <0xe580 0x03 0x13>;
		rockchip,usb3-host-disable = <0x2434 0x00 0x10>;
		rockchip,usb3-host-port = <0x2434 0x0c 0x1c>;
		rockchip,external-psm = <0xe588 0x0e 0x1e>;
		rockchip,pipe-status = <0xe5c0 0x00 0x00>;
		rockchip,uphy-dp-sel = <0x6268 0x13 0x13>;
		status = "disabled";
		phandle = <0x108>;

		dp-port {
			#phy-cells = <0x00>;
			phandle = <0x21>;
		};

		usb3-port {
			#phy-cells = <0x00>;
			phandle = <0x1e>;
		};
	};

	phy@ff800000 {
		compatible = "rockchip,rk3399-typec-phy";
		reg = <0x00 0xff800000 0x00 0x40000>;
		#phy-cells = <0x01>;
		clocks = <0x08 0x80 0x08 0x7f>;
		clock-names = "tcpdcore\0tcpdphy-ref";
		assigned-clocks = <0x08 0x80>;
		assigned-clock-rates = <0x2faf080>;
		power-domains = <0x10 0x09>;
		resets = <0x08 0x9d 0x08 0x9c 0x08 0x14d>;
		reset-names = "uphy\0uphy-pipe\0uphy-tcphy";
		rockchip,grf = <0x11>;
		rockchip,typec-conn-dir = <0xe58c 0x00 0x10>;
		rockchip,usb3tousb2-en = <0xe58c 0x03 0x13>;
		rockchip,usb3-host-disable = <0x2444 0x00 0x10>;
		rockchip,usb3-host-port = <0x2444 0x0c 0x1c>;
		rockchip,external-psm = <0xe594 0x0e 0x1e>;
		rockchip,pipe-status = <0xe5c0 0x10 0x10>;
		rockchip,uphy-dp-sel = <0x6268 0x03 0x13>;
		status = "disabled";
		phandle = <0x109>;

		dp-port {
			#phy-cells = <0x00>;
			phandle = <0x22>;
		};

		usb3-port {
			#phy-cells = <0x00>;
			phandle = <0x20>;
		};
	};

	watchdog@ff848000 {
		compatible = "snps,dw-wdt";
		reg = <0x00 0xff848000 0x00 0x100>;
		clocks = <0x08 0x17c>;
		interrupts = <0x00 0x78 0x04 0x00>;
	};

	rktimer@ff850000 {
		compatible = "rockchip,rk3399-timer";
		reg = <0x00 0xff850000 0x00 0x1000>;
		interrupts = <0x00 0x51 0x04 0x00>;
		clocks = <0x08 0x168 0x08 0x5a>;
		clock-names = "pclk\0timer";
		phandle = <0x10a>;
	};

	spdif@ff870000 {
		compatible = "rockchip,rk3399-spdif";
		reg = <0x00 0xff870000 0x00 0x1000>;
		interrupts = <0x00 0x42 0x04 0x00>;
		dmas = <0x4a 0x07>;
		dma-names = "tx";
		clock-names = "mclk\0hclk";
		clocks = <0x08 0x55 0x08 0x1d7>;
		pinctrl-names = "default";
		pinctrl-0 = <0x8a>;
		power-domains = <0x10 0x1c>;
		status = "disabled";
		phandle = <0x10b>;
	};

	i2s@ff880000 {
		compatible = "rockchip,rk3399-i2s\0rockchip,rk3066-i2s";
		reg = <0x00 0xff880000 0x00 0x1000>;
		rockchip,grf = <0x11>;
		interrupts = <0x00 0x27 0x04 0x00>;
		dmas = <0x4a 0x00 0x4a 0x01>;
		dma-names = "tx\0rx";
		clock-names = "i2s_clk\0i2s_hclk";
		clocks = <0x08 0x56 0x08 0x1d4>;
		resets = <0x08 0xe0 0x08 0xc2>;
		reset-names = "reset-m\0reset-h";
		pinctrl-names = "default";
		pinctrl-0 = <0x8b>;
		power-domains = <0x10 0x1c>;
		status = "okay";
		phandle = <0xbf>;
	};

	i2s@ff890000 {
		compatible = "rockchip,rk3399-i2s\0rockchip,rk3066-i2s";
		reg = <0x00 0xff890000 0x00 0x1000>;
		interrupts = <0x00 0x28 0x04 0x00>;
		dmas = <0x4a 0x02 0x4a 0x03>;
		dma-names = "tx\0rx";
		clock-names = "i2s_clk\0i2s_hclk";
		clocks = <0x08 0x57 0x08 0x1d5>;
		resets = <0x08 0xe1 0x08 0xc3>;
		reset-names = "reset-m\0reset-h";
		pinctrl-names = "default";
		pinctrl-0 = <0x8c>;
		power-domains = <0x10 0x1c>;
		status = "disabled";
		phandle = <0x10c>;
	};

	i2s@ff8a0000 {
		compatible = "rockchip,rk3399-i2s\0rockchip,rk3066-i2s";
		reg = <0x00 0xff8a0000 0x00 0x1000>;
		interrupts = <0x00 0x29 0x04 0x00>;
		dmas = <0x4a 0x04 0x4a 0x05>;
		dma-names = "tx\0rx";
		clock-names = "i2s_clk\0i2s_hclk";
		clocks = <0x08 0x58 0x08 0x1d6>;
		resets = <0x08 0xe2 0x08 0xc4>;
		reset-names = "reset-m\0reset-h";
		power-domains = <0x10 0x1c>;
		status = "disabled";
		phandle = <0x10d>;
	};

	gpu@ff9a0000 {
		compatible = "arm,malit860\0arm,malit86x\0arm,malit8xx\0arm,mali-midgard";
		reg = <0x00 0xff9a0000 0x00 0x10000>;
		interrupts = <0x00 0x13 0x04 0x00 0x00 0x14 0x04 0x00 0x00 0x15 0x04 0x00>;
		interrupt-names = "GPU\0JOB\0MMU";
		clocks = <0x08 0xd0>;
		clock-names = "clk_mali";
		#cooling-cells = <0x02>;
		power-domains = <0x10 0x23>;
		power-off-delay-ms = <0xc8>;
		status = "okay";
		mali-supply = <0x8d>;
		phandle = <0x53>;

		power_model {
			compatible = "arm,mali-simple-power-model";
			static-coefficient = <0x64578>;
			dynamic-coefficient = <0x2dd>;
			ts = <0x7d00 0x125c 0xffffffb0 0x02>;
			thermal-zone = "gpu-thermal";
			phandle = <0x10e>;
		};
	};

	vop@ff8f0000 {
		compatible = "rockchip,rk3399-vop-lit";
		reg = <0x00 0xff8f0000 0x00 0x600 0x00 0xff8f1c00 0x00 0x200 0x00 0xff8f2000 0x00 0x400>;
		reg-names = "regs\0cabc_lut\0gamma_lut";
		interrupts = <0x00 0x77 0x04 0x00>;
		clocks = <0x08 0xdb 0x08 0xb5 0x08 0x1db 0x08 0xb7>;
		clock-names = "aclk_vop\0dclk_vop\0hclk_vop\0dclk_source";
		iommus = <0x8e>;
		power-domains = <0x10 0x12>;
		resets = <0x08 0x113 0x08 0x117 0x08 0x119>;
		reset-names = "axi\0ahb\0dclk";
		status = "okay";
		phandle = <0x10f>;

		port {
			#address-cells = <0x01>;
			#size-cells = <0x00>;
			phandle = <0xa9>;

			endpoint@0 {
				reg = <0x00>;
				remote-endpoint = <0x8f>;
				phandle = <0xa3>;
			};

			endpoint@1 {
				reg = <0x01>;
				remote-endpoint = <0x90>;
				phandle = <0xa7>;
			};

			endpoint@2 {
				reg = <0x02>;
				remote-endpoint = <0x91>;
				phandle = <0xa1>;
			};

			endpoint@3 {
				reg = <0x03>;
				remote-endpoint = <0x92>;
				phandle = <0x24>;
			};

			endpoint@4 {
				reg = <0x04>;
				remote-endpoint = <0x93>;
				phandle = <0xa5>;
			};
		};
	};

	voppwm@ff8f01a0 {
		compatible = "rockchip,vop-pwm";
		reg = <0x00 0xff8f01a0 0x00 0x10>;
		#pwm-cells = <0x03>;
		pinctrl-names = "active";
		pinctrl-0 = <0x94>;
		clocks = <0x08 0x6c>;
		clock-names = "pwm";
		status = "disabled";
		phandle = <0x110>;
	};

	iommu@ff8f3f00 {
		compatible = "rockchip,iommu";
		reg = <0x00 0xff8f3f00 0x00 0x100>;
		interrupts = <0x00 0x77 0x04 0x00>;
		interrupt-names = "vopl_mmu";
		clocks = <0x08 0xdb 0x08 0x1db>;
		clock-names = "aclk\0hclk";
		power-domains = <0x10 0x12>;
		#iommu-cells = <0x00>;
		status = "okay";
		phandle = <0x8e>;
	};

	vop@ff900000 {
		compatible = "rockchip,rk3399-vop-big";
		reg = <0x00 0xff900000 0x00 0x600 0x00 0xff901c00 0x00 0x200 0x00 0xff902000 0x00 0x1000>;
		reg-names = "regs\0cabc_lut\0gamma_lut";
		interrupts = <0x00 0x76 0x04 0x00>;
		clocks = <0x08 0xd9 0x08 0xb4 0x08 0x1d9 0x08 0xb6>;
		clock-names = "aclk_vop\0dclk_vop\0hclk_vop\0dclk_source";
		resets = <0x08 0x112 0x08 0x116 0x08 0x118>;
		reset-names = "axi\0ahb\0dclk";
		power-domains = <0x10 0x11>;
		iommus = <0x95>;
		status = "okay";
		phandle = <0x111>;

		port {
			#address-cells = <0x01>;
			#size-cells = <0x00>;
			phandle = <0xaa>;

			endpoint@0 {
				reg = <0x00>;
				remote-endpoint = <0x96>;
				phandle = <0xa6>;
			};

			endpoint@1 {
				reg = <0x01>;
				remote-endpoint = <0x97>;
				phandle = <0xa2>;
			};

			endpoint@2 {
				reg = <0x02>;
				remote-endpoint = <0x98>;
				phandle = <0xa0>;
			};

			endpoint@3 {
				reg = <0x03>;
				remote-endpoint = <0x99>;
				phandle = <0x23>;
			};

			endpoint@4 {
				reg = <0x04>;
				remote-endpoint = <0x9a>;
				phandle = <0xa4>;
			};
		};
	};

	voppwm@ff9001a0 {
		compatible = "rockchip,vop-pwm";
		reg = <0x00 0xff9001a0 0x00 0x10>;
		#pwm-cells = <0x03>;
		pinctrl-names = "active";
		pinctrl-0 = <0x9b>;
		clocks = <0x08 0x6b>;
		clock-names = "pwm";
		status = "disabled";
		phandle = <0x112>;
	};

	iommu@ff903f00 {
		compatible = "rockchip,iommu";
		reg = <0x00 0xff903f00 0x00 0x100>;
		interrupts = <0x00 0x76 0x04 0x00>;
		interrupt-names = "vopb_mmu";
		clocks = <0x08 0xd9 0x08 0x1d9>;
		clock-names = "aclk\0hclk";
		power-domains = <0x10 0x11>;
		#iommu-cells = <0x00>;
		status = "okay";
		phandle = <0x95>;
	};

	rkisp1@ff910000 {
		compatible = "rockchip,rk3399-rkisp1";
		reg = <0x00 0xff910000 0x00 0x4000>;
		interrupts = <0x00 0x2b 0x04 0x00>;
		interrupt-names = "isp_irq";
		clocks = <0x08 0x6e 0x08 0xe5 0x08 0x1df 0x08 0xe9 0x08 0x1e3>;
		clock-names = "clk_isp\0aclk_isp\0hclk_isp\0aclk_isp_wrap\0hclk_isp_wrap";
		devfreq = <0x9c>;
		power-domains = <0x10 0x13>;
		iommus = <0x9d>;
		status = "disabled";
		phandle = <0x113>;
	};

	iommu@ff914000 {
		compatible = "rockchip,iommu";
		reg = <0x00 0xff914000 0x00 0x100 0x00 0xff915000 0x00 0x100>;
		interrupts = <0x00 0x2b 0x04 0x00>;
		interrupt-names = "isp0_mmu";
		#iommu-cells = <0x00>;
		clocks = <0x08 0xe9 0x08 0x1e3>;
		clock-names = "aclk\0hclk";
		power-domains = <0x10 0x13>;
		rk_iommu,disable_reset_quirk;
		status = "disabled";
		phandle = <0x9d>;
	};

	rkisp1@ff920000 {
		compatible = "rockchip,rk3399-rkisp1";
		reg = <0x00 0xff920000 0x00 0x4000>;
		interrupts = <0x00 0x2c 0x04 0x00>;
		interrupt-names = "isp_irq";
		clocks = <0x08 0x6f 0x08 0xe6 0x08 0x1e0 0x08 0xea 0x08 0x1e4 0x08 0x17b>;
		clock-names = "clk_isp\0aclk_isp\0hclk_isp\0aclk_isp_wrap\0hclk_isp_wrap\0pclk_isp_wrap";
		devfreq = <0x9c>;
		power-domains = <0x10 0x14>;
		iommus = <0x9e>;
		status = "disabled";
		phandle = <0x114>;
	};

	iommu@ff924000 {
		compatible = "rockchip,iommu";
		reg = <0x00 0xff924000 0x00 0x100 0x00 0xff925000 0x00 0x100>;
		interrupts = <0x00 0x2c 0x04 0x00>;
		interrupt-names = "isp1_mmu";
		#iommu-cells = <0x00>;
		clocks = <0x08 0xea 0x08 0x1e4>;
		clock-names = "aclk\0hclk";
		power-domains = <0x10 0x14>;
		rk_iommu,disable_reset_quirk;
		status = "disabled";
		phandle = <0x9e>;
	};

	hdmi@ff940000 {
		compatible = "rockchip,rk3399-dw-hdmi";
		reg = <0x00 0xff940000 0x00 0x20000>;
		pinctrl-names = "default";
		pinctrl-0 = <0x9f>;
		interrupts = <0x00 0x17 0x04 0x00>;
		clocks = <0x08 0x174 0x08 0x71 0x08 0x07 0x08 0x16f 0x08 0x70>;
		clock-names = "iahb\0isfr\0vpll\0grf\0cec";
		power-domains = <0x10 0x15>;
		reg-io-width = <0x04>;
		rockchip,grf = <0x11>;
		status = "disabled";
		phandle = <0x115>;

		ports {

			port {
				#address-cells = <0x01>;
				#size-cells = <0x00>;
				phandle = <0x116>;

				endpoint@0 {
					reg = <0x00>;
					remote-endpoint = <0xa0>;
					phandle = <0x98>;
				};

				endpoint@1 {
					reg = <0x01>;
					remote-endpoint = <0xa1>;
					phandle = <0x91>;
				};
			};
		};
	};

	dsi@ff960000 {
		compatible = "rockchip,rk3399-mipi-dsi";
		reg = <0x00 0xff960000 0x00 0x8000>;
		interrupts = <0x00 0x2d 0x04 0x00>;
		clocks = <0x08 0xa2 0x08 0x170 0x08 0xa3>;
		clock-names = "ref\0pclk\0phy_cfg";
		power-domains = <0x10 0x0f>;
		resets = <0x08 0xfb>;
		reset-names = "apb";
		rockchip,grf = <0x11>;
		status = "disabled";
		#address-cells = <0x01>;
		#size-cells = <0x00>;
		phandle = <0x117>;

		ports {

			port {
				#address-cells = <0x01>;
				#size-cells = <0x00>;

				endpoint@0 {
					reg = <0x00>;
					remote-endpoint = <0xa2>;
					phandle = <0x97>;
				};

				endpoint@1 {
					reg = <0x01>;
					remote-endpoint = <0xa3>;
					phandle = <0x8f>;
				};
			};
		};
	};

	dsi@ff968000 {
		compatible = "rockchip,rk3399-mipi-dsi";
		reg = <0x00 0xff968000 0x00 0x8000>;
		interrupts = <0x00 0x2e 0x04 0x00>;
		clocks = <0x08 0xa2 0x08 0x171 0x08 0xa4>;
		clock-names = "ref\0pclk\0phy_cfg";
		power-domains = <0x10 0x0f>;
		resets = <0x08 0xfc>;
		reset-names = "apb";
		rockchip,grf = <0x11>;
		status = "disabled";
		#address-cells = <0x01>;
		#size-cells = <0x00>;
		phandle = <0x118>;

		ports {

			port {
				#address-cells = <0x01>;
				#size-cells = <0x00>;

				endpoint@0 {
					reg = <0x00>;
					remote-endpoint = <0xa4>;
					phandle = <0x9a>;
				};

				endpoint@1 {
					reg = <0x01>;
					remote-endpoint = <0xa5>;
					phandle = <0x93>;
				};
			};
		};
	};

	mipi-dphy-tx1rx1@ff968000 {
		compatible = "rockchip,rk3399-mipi-dphy";
		reg = <0x00 0xff968000 0x00 0x8000>;
		clocks = <0x08 0x77 0x08 0xa4 0x08 0x16f 0x08 0x171>;
		clock-names = "dphy-ref\0dphy-cfg\0grf\0pclk_mipi_dsi";
		rockchip,grf = <0x11>;
		power-domains = <0x10 0x0f>;
		status = "disabled";
		phandle = <0x119>;
	};

	edp@ff970000 {
		compatible = "rockchip,rk3399-edp";
		reg = <0x00 0xff970000 0x00 0x8000>;
		interrupts = <0x00 0x0a 0x04 0x00>;
		clocks = <0x08 0x16a 0x08 0x16c>;
		clock-names = "dp\0pclk";
		power-domains = <0x10 0x19>;
		resets = <0x08 0x11d>;
		reset-names = "dp";
		rockchip,grf = <0x11>;
		status = "okay";
		phandle = <0x11a>;

		ports {
			#address-cells = <0x01>;
			#size-cells = <0x00>;

			port@0 {
				reg = <0x00>;
				#address-cells = <0x01>;
				#size-cells = <0x00>;
				phandle = <0x11b>;

				endpoint@0 {
					reg = <0x00>;
					remote-endpoint = <0xa6>;
					phandle = <0x96>;
				};

				endpoint@1 {
					reg = <0x01>;
					remote-endpoint = <0xa7>;
					phandle = <0x90>;
				};
			};

			port@1 {
				reg = <0x01>;
				#address-cells = <0x01>;
				#size-cells = <0x00>;
				phandle = <0x11c>;

				endpoint@0 {
					reg = <0x00>;
					remote-endpoint = <0xa8>;
					phandle = <0xc3>;
				};
			};
		};
	};

	hdmi-hdcp2@ff988000 {
		compatible = "rockchip,rk3399-hdmi-hdcp2";
		reg = <0x00 0xff988000 0x00 0x2000>;
		interrupts = <0x00 0x16 0x04 0x00>;
		clocks = <0x08 0xe0 0x08 0x176 0x08 0x1e9>;
		clock-names = "aclk_hdcp2\0pclk_hdcp2\0hdcp2_clk_hdmi";
		status = "disabled";
		phandle = <0x11d>;
	};

	display-subsystem {
		compatible = "rockchip,display-subsystem";
		ports = <0xa9 0xaa>;
		clocks = <0x08 0x07 0x08 0x04>;
		clock-names = "hdmi-tmds-pll\0default-vop-pll";
		devfreq = <0x9c>;
		status = "okay";
		phandle = <0x11e>;
	};

	nocp-cci-msch0@ffa86000 {
		compatible = "rockchip,rk3399-nocp";
		reg = <0x00 0xffa86000 0x00 0x400>;
		phandle = <0x11f>;
	};

	nocp-gpu-msch0@ffa86400 {
		compatible = "rockchip,rk3399-nocp";
		reg = <0x00 0xffa86400 0x00 0x400>;
		phandle = <0x120>;
	};

	nocp-hp-msch0@ffa86800 {
		compatible = "rockchip,rk3399-nocp";
		reg = <0x00 0xffa86800 0x00 0x400>;
		phandle = <0x121>;
	};

	nocp-lp-msch0@ffa86c00 {
		compatible = "rockchip,rk3399-nocp";
		reg = <0x00 0xffa86c00 0x00 0x400>;
		phandle = <0x122>;
	};

	nocp-video-msch0@ffa87000 {
		compatible = "rockchip,rk3399-nocp";
		reg = <0x00 0xffa87000 0x00 0x400>;
		phandle = <0x123>;
	};

	nocp-vio0-msch0@ffa87400 {
		compatible = "rockchip,rk3399-nocp";
		reg = <0x00 0xffa87400 0x00 0x400>;
		phandle = <0x124>;
	};

	nocp-vio1-msch0@ffa87800 {
		compatible = "rockchip,rk3399-nocp";
		reg = <0x00 0xffa87800 0x00 0x400>;
		phandle = <0x125>;
	};

	nocp-cci-msch1@ffa8e000 {
		compatible = "rockchip,rk3399-nocp";
		reg = <0x00 0xffa8e000 0x00 0x400>;
		phandle = <0x126>;
	};

	nocp-gpu-msch1@ffa8e400 {
		compatible = "rockchip,rk3399-nocp";
		reg = <0x00 0xffa8e400 0x00 0x400>;
		phandle = <0x127>;
	};

	nocp-hp-msch1@ffa8e800 {
		compatible = "rockchip,rk3399-nocp";
		reg = <0x00 0xffa8e800 0x00 0x400>;
		phandle = <0x128>;
	};

	nocp-lp-msch1@ffa8ec00 {
		compatible = "rockchip,rk3399-nocp";
		reg = <0x00 0xffa8ec00 0x00 0x400>;
		phandle = <0x129>;
	};

	nocp-video-msch1@ffa8f000 {
		compatible = "rockchip,rk3399-nocp";
		reg = <0x00 0xffa8f000 0x00 0x400>;
		phandle = <0x12a>;
	};

	nocp-vio0-msch1@ffa8f400 {
		compatible = "rockchip,rk3399-nocp";
		reg = <0x00 0xffa8f400 0x00 0x400>;
		phandle = <0x12b>;
	};

	nocp-vio1-msch1@ffa8f800 {
		compatible = "rockchip,rk3399-nocp";
		reg = <0x00 0xffa8f800 0x00 0x400>;
		phandle = <0x12c>;
	};

	rockchip-system-monitor {
		compatible = "rockchip,system-monitor";
		rockchip,thermal-zone = "soc-thermal";
		rockchip,polling-delay = <0xc8>;
		phandle = <0x12d>;
	};

	pinctrl {
		compatible = "rockchip,rk3399-pinctrl";
		rockchip,grf = <0x11>;
		rockchip,pmu = <0x81>;
		#address-cells = <0x02>;
		#size-cells = <0x02>;
		ranges;
		phandle = <0x12e>;

		gpio0@ff720000 {
			compatible = "rockchip,gpio-bank";
			reg = <0x00 0xff720000 0x00 0x100>;
			clocks = <0x25 0x17>;
			interrupts = <0x00 0x0e 0x04 0x00>;
			gpio-controller;
			#gpio-cells = <0x02>;
			interrupt-controller;
			#interrupt-cells = <0x02>;
			phandle = <0x50>;
		};

		gpio1@ff730000 {
			compatible = "rockchip,gpio-bank";
			reg = <0x00 0xff730000 0x00 0x100>;
			clocks = <0x25 0x18>;
			interrupts = <0x00 0x0f 0x04 0x00>;
			gpio-controller;
			#gpio-cells = <0x02>;
			interrupt-controller;
			#interrupt-cells = <0x02>;
			phandle = <0x2a>;
		};

		gpio2@ff780000 {
			compatible = "rockchip,gpio-bank";
			reg = <0x00 0xff780000 0x00 0x100>;
			clocks = <0x08 0x150>;
			interrupts = <0x00 0x10 0x04 0x00>;
			gpio-controller;
			#gpio-cells = <0x02>;
			interrupt-controller;
			#interrupt-cells = <0x02>;
			phandle = <0xbd>;
		};

		gpio3@ff788000 {
			compatible = "rockchip,gpio-bank";
			reg = <0x00 0xff788000 0x00 0x100>;
			clocks = <0x08 0x151>;
			interrupts = <0x00 0x11 0x04 0x00>;
			gpio-controller;
			#gpio-cells = <0x02>;
			interrupt-controller;
			#interrupt-cells = <0x02>;
			phandle = <0x12f>;
		};

		gpio4@ff790000 {
			compatible = "rockchip,gpio-bank";
			reg = <0x00 0xff790000 0x00 0x100>;
			clocks = <0x08 0x152>;
			interrupts = <0x00 0x12 0x04 0x00>;
			gpio-controller;
			#gpio-cells = <0x02>;
			interrupt-controller;
			#interrupt-cells = <0x02>;
			phandle = <0x17>;
		};

		pcfg-pull-up {
			bias-pull-up;
			phandle = <0xab>;
		};

		pcfg-pull-down {
			bias-pull-down;
			phandle = <0xaf>;
		};

		pcfg-pull-none {
			bias-disable;
			phandle = <0xad>;
		};

		pcfg-pull-up-20ma {
			bias-pull-up;
			drive-strength = <0x14>;
			phandle = <0x130>;
		};

		pcfg-pull-none-20ma {
			bias-disable;
			drive-strength = <0x14>;
			phandle = <0x131>;
		};

		pcfg-pull-none-18ma {
			bias-disable;
			drive-strength = <0x12>;
			phandle = <0x132>;
		};

		pcfg-pull-none-12ma {
			bias-disable;
			drive-strength = <0x0c>;
			phandle = <0xae>;
		};

		pcfg-pull-none-10ma {
			bias-disable;
			drive-strength = <0x0a>;
			phandle = <0x133>;
		};

		pcfg-pull-up-10ma {
			bias-pull-up;
			drive-strength = <0x0a>;
			phandle = <0x134>;
		};

		pcfg-pull-up-8ma {
			bias-pull-up;
			drive-strength = <0x08>;
			phandle = <0x135>;
		};

		pcfg-pull-down-4ma {
			bias-pull-down;
			drive-strength = <0x04>;
			phandle = <0x136>;
		};

		pcfg-pull-up-2ma {
			bias-pull-up;
			drive-strength = <0x02>;
			phandle = <0x137>;
		};

		pcfg-pull-down-12ma {
			bias-pull-down;
			drive-strength = <0x0c>;
			phandle = <0x138>;
		};

		pcfg-pull-none-13ma {
			bias-disable;
			drive-strength = <0x0d>;
			phandle = <0xac>;
		};

		pcfg-output-high {
			output-high;
			phandle = <0xb0>;
		};

		pcfg-output-low {
			output-low;
			phandle = <0x139>;
		};

		pcfg-input {
			input-enable;
			phandle = <0x13a>;
		};

		emmc {

			emmc-pwr {
				rockchip,pins = <0x00 0x05 0x01 0xab>;
				phandle = <0x13b>;
			};
		};

		gmac {

			rgmii-pins {
				rockchip,pins = <0x03 0x11 0x01 0xac 0x03 0x0e 0x01 0xad 0x03 0x0d 0x01 0xad 0x03 0x0c 0x01 0xac 0x03 0x0b 0x01 0xad 0x03 0x09 0x01 0xad 0x03 0x08 0x01 0xad 0x03 0x07 0x01 0xad 0x03 0x06 0x01 0xad 0x03 0x05 0x01 0xac 0x03 0x04 0x01 0xac 0x03 0x03 0x01 0xad 0x03 0x02 0x01 0xad 0x03 0x01 0x01 0xac 0x03 0x00 0x01 0xac>;
				phandle = <0x13c>;
			};

			rmii-pins {
				rockchip,pins = <0x03 0x0d 0x01 0xad 0x03 0x0c 0x01 0xac 0x03 0x0b 0x01 0xad 0x03 0x0a 0x01 0xad 0x03 0x09 0x01 0xad 0x03 0x08 0x01 0xad 0x03 0x07 0x01 0xad 0x03 0x06 0x01 0xad 0x03 0x05 0x01 0xac 0x03 0x04 0x01 0xac>;
				phandle = <0x13d>;
			};
		};

		i2c0 {

			i2c0-xfer {
				rockchip,pins = <0x01 0x0f 0x02 0xad 0x01 0x10 0x02 0xad>;
				phandle = <0x26>;
			};
		};

		i2c1 {

			i2c1-xfer {
				rockchip,pins = <0x04 0x02 0x01 0xad 0x04 0x01 0x01 0xad>;
				phandle = <0x28>;
			};
		};

		i2c2 {

			i2c2-xfer {
				rockchip,pins = <0x02 0x01 0x02 0xae 0x02 0x00 0x02 0xae>;
				phandle = <0x2b>;
			};
		};

		i2c3 {

			i2c3-xfer {
				rockchip,pins = <0x04 0x11 0x01 0xad 0x04 0x10 0x01 0xad>;
				phandle = <0x2c>;
			};

			i2c3_gpio {
				rockchip,pins = <0x04 0x11 0x00 0xad 0x04 0x10 0x00 0xad>;
				phandle = <0x13e>;
			};
		};

		i2c4 {

			i2c4-xfer {
				rockchip,pins = <0x01 0x0c 0x01 0xad 0x01 0x0b 0x01 0xad>;
				phandle = <0x75>;
			};
		};

		i2c5 {

			i2c5-xfer {
				rockchip,pins = <0x03 0x0b 0x02 0xad 0x03 0x0a 0x02 0xad>;
				phandle = <0x2d>;
			};
		};

		i2c6 {

			i2c6-xfer {
				rockchip,pins = <0x02 0x0a 0x02 0xad 0x02 0x09 0x02 0xad>;
				phandle = <0x2f>;
			};
		};

		i2c7 {

			i2c7-xfer {
				rockchip,pins = <0x02 0x08 0x02 0xad 0x02 0x07 0x02 0xad>;
				phandle = <0x30>;
			};
		};

		i2c8 {

			i2c8-xfer {
				rockchip,pins = <0x01 0x15 0x01 0xad 0x01 0x14 0x01 0xad>;
				phandle = <0x76>;
			};
		};

		i2s0 {

			i2s0-8ch-bus {
				rockchip,pins = <0x03 0x18 0x01 0xad 0x03 0x19 0x01 0xad 0x03 0x1a 0x01 0xad 0x03 0x1b 0x01 0xad 0x03 0x1c 0x01 0xad 0x03 0x1d 0x01 0xad 0x03 0x1e 0x01 0xad 0x03 0x1f 0x01 0xad>;
				phandle = <0x8b>;
			};

			i2s-8ch-mclk {
				rockchip,pins = <0x04 0x00 0x01 0xad>;
				phandle = <0x78>;
			};
		};

		i2s1 {

			i2s1-2ch-bus {
				rockchip,pins = <0x04 0x03 0x01 0xad 0x04 0x04 0x01 0xad 0x04 0x05 0x01 0xad 0x04 0x06 0x01 0xad 0x04 0x07 0x01 0xad>;
				phandle = <0x8c>;
			};
		};

		sdio0 {

			sdio0-bus1 {
				rockchip,pins = <0x02 0x14 0x01 0xab>;
				phandle = <0x13f>;
			};

			sdio0-bus4 {
				rockchip,pins = <0x02 0x14 0x01 0xab 0x02 0x15 0x01 0xab 0x02 0x16 0x01 0xab 0x02 0x17 0x01 0xab>;
				phandle = <0x140>;
			};

			sdio0-cmd {
				rockchip,pins = <0x02 0x18 0x01 0xab>;
				phandle = <0x141>;
			};

			sdio0-clk {
				rockchip,pins = <0x02 0x19 0x01 0xad>;
				phandle = <0x142>;
			};

			sdio0-cd {
				rockchip,pins = <0x02 0x1a 0x01 0xab>;
				phandle = <0x143>;
			};

			sdio0-pwr {
				rockchip,pins = <0x02 0x1b 0x01 0xab>;
				phandle = <0x144>;
			};

			sdio0-bkpwr {
				rockchip,pins = <0x02 0x1c 0x01 0xab>;
				phandle = <0x145>;
			};

			sdio0-wp {
				rockchip,pins = <0x00 0x03 0x01 0xab>;
				phandle = <0x146>;
			};

			sdio0-int {
				rockchip,pins = <0x00 0x04 0x01 0xab>;
				phandle = <0x147>;
			};
		};

		sdmmc {

			sdmmc-bus1 {
				rockchip,pins = <0x04 0x08 0x01 0xab>;
				phandle = <0x148>;
			};

			sdmmc-bus4 {
				rockchip,pins = <0x04 0x08 0x01 0xad 0x04 0x09 0x01 0xad 0x04 0x0a 0x01 0xad 0x04 0x0b 0x01 0xad>;
				phandle = <0x16>;
			};

			sdmmc-clk {
				rockchip,pins = <0x04 0x0c 0x01 0xad>;
				phandle = <0x12>;
			};

			sdmmc-cmd {
				rockchip,pins = <0x04 0x0d 0x01 0xad>;
				phandle = <0x13>;
			};

			sdmcc-cd {
				rockchip,pins = <0x00 0x07 0x01 0xad>;
				phandle = <0x14>;
			};

			sdmmc-wp {
				rockchip,pins = <0x00 0x08 0x01 0xab>;
				phandle = <0x149>;
			};

			sdmmc-cd-gpio {
				rockchip,pins = <0x04 0x18 0x00 0xad>;
				phandle = <0x15>;
			};
		};

		spdif {

			spdif-bus {
				rockchip,pins = <0x04 0x15 0x01 0xad>;
				phandle = <0x8a>;
			};

			spdif-bus-1 {
				rockchip,pins = <0x03 0x10 0x03 0xad>;
				phandle = <0x14a>;
			};
		};

		spi0 {

			spi0-clk {
				rockchip,pins = <0x03 0x06 0x02 0xab>;
				phandle = <0x3a>;
			};

			spi0-cs0 {
				rockchip,pins = <0x03 0x07 0x02 0xab>;
				phandle = <0x3d>;
			};

			spi0-cs1 {
				rockchip,pins = <0x03 0x08 0x02 0xab>;
				phandle = <0x14b>;
			};

			spi0-tx {
				rockchip,pins = <0x03 0x05 0x02 0xab>;
				phandle = <0x3b>;
			};

			spi0-rx {
				rockchip,pins = <0x03 0x04 0x02 0xab>;
				phandle = <0x3c>;
			};
		};

		spi1 {

			spi1-clk {
				rockchip,pins = <0x01 0x09 0x02 0xab>;
				phandle = <0x3e>;
			};

			spi1-cs0 {
				rockchip,pins = <0x01 0x0a 0x02 0xab>;
				phandle = <0x41>;
			};

			spi1-rx {
				rockchip,pins = <0x01 0x07 0x02 0xab>;
				phandle = <0x40>;
			};

			spi1-tx {
				rockchip,pins = <0x01 0x08 0x02 0xab>;
				phandle = <0x3f>;
			};
		};

		spi2 {

			spi2-clk {
				rockchip,pins = <0x02 0x0b 0x01 0xab>;
				phandle = <0x42>;
			};

			spi2-cs0 {
				rockchip,pins = <0x02 0x0c 0x01 0xab>;
				phandle = <0x45>;
			};

			spi2-rx {
				rockchip,pins = <0x02 0x09 0x01 0xab>;
				phandle = <0x44>;
			};

			spi2-tx {
				rockchip,pins = <0x02 0x0a 0x01 0xab>;
				phandle = <0x43>;
			};
		};

		spi3 {

			spi3-clk {
				rockchip,pins = <0x01 0x11 0x01 0xab>;
				phandle = <0x70>;
			};

			spi3-cs0 {
				rockchip,pins = <0x01 0x12 0x01 0xab>;
				phandle = <0x73>;
			};

			spi3-rx {
				rockchip,pins = <0x01 0x0f 0x01 0xab>;
				phandle = <0x72>;
			};

			spi3-tx {
				rockchip,pins = <0x01 0x10 0x01 0xab>;
				phandle = <0x71>;
			};
		};

		spi4 {

			spi4-clk {
				rockchip,pins = <0x03 0x02 0x02 0xab>;
				phandle = <0x46>;
			};

			spi4-cs0 {
				rockchip,pins = <0x03 0x03 0x02 0xab>;
				phandle = <0x49>;
			};

			spi4-rx {
				rockchip,pins = <0x03 0x00 0x02 0xab>;
				phandle = <0x48>;
			};

			spi4-tx {
				rockchip,pins = <0x03 0x01 0x02 0xab>;
				phandle = <0x47>;
			};
		};

		spi5 {

			spi5-clk {
				rockchip,pins = <0x02 0x16 0x02 0xab>;
				phandle = <0x4b>;
			};

			spi5-cs0 {
				rockchip,pins = <0x02 0x17 0x02 0xab>;
				phandle = <0x4e>;
			};

			spi5-rx {
				rockchip,pins = <0x02 0x14 0x02 0xab>;
				phandle = <0x4d>;
			};

			spi5-tx {
				rockchip,pins = <0x02 0x15 0x02 0xab>;
				phandle = <0x4c>;
			};
		};

		tsadc {

			otp-gpio {
				rockchip,pins = <0x01 0x06 0x00 0xad>;
				phandle = <0x54>;
			};

			otp-out {
				rockchip,pins = <0x01 0x06 0x01 0xad>;
				phandle = <0x55>;
			};
		};

		uart0 {

			uart0-xfer {
				rockchip,pins = <0x02 0x10 0x01 0xab 0x02 0x11 0x01 0xad>;
				phandle = <0x31>;
			};

			uart0-cts {
				rockchip,pins = <0x02 0x12 0x01 0xad>;
				phandle = <0x32>;
			};

			uart0-rts {
				rockchip,pins = <0x02 0x13 0x01 0xad>;
				phandle = <0x33>;
			};
		};

		uart1 {

			uart1-xfer {
				rockchip,pins = <0x03 0x0c 0x02 0xab 0x03 0x0d 0x02 0xad>;
				phandle = <0x34>;
			};
		};

		uart2a {

			uart2a-xfer {
				rockchip,pins = <0x04 0x08 0x02 0xab 0x04 0x09 0x02 0xad>;
				phandle = <0x14c>;
			};
		};

		uart2b {

			uart2b-xfer {
				rockchip,pins = <0x04 0x10 0x02 0xab 0x04 0x11 0x02 0xad>;
				phandle = <0x14d>;
			};
		};

		uart2c {

			uart2c-xfer {
				rockchip,pins = <0x04 0x13 0x01 0xab 0x04 0x14 0x01 0xad>;
				phandle = <0x35>;
			};
		};

		uart3 {

			uart3-xfer {
				rockchip,pins = <0x03 0x0e 0x02 0xab 0x03 0x0f 0x02 0xad>;
				phandle = <0x36>;
			};

			uart3-cts {
				rockchip,pins = <0x03 0x10 0x02 0xad>;
				phandle = <0x37>;
			};

			uart3-rts {
				rockchip,pins = <0x03 0x11 0x02 0xad>;
				phandle = <0x38>;
			};
		};

		uart4 {

			uart4-xfer {
				rockchip,pins = <0x01 0x07 0x01 0xab 0x01 0x08 0x01 0xad>;
				phandle = <0x74>;
			};
		};

		uarthdcp {

			uarthdcp-xfer {
				rockchip,pins = <0x04 0x15 0x02 0xab 0x04 0x16 0x02 0xad>;
				phandle = <0x14e>;
			};
		};

		pwm0 {

			pwm0-pin {
				rockchip,pins = <0x04 0x12 0x01 0xad>;
				phandle = <0x7d>;
			};

			pwm0-pin-pull-down {
				rockchip,pins = <0x04 0x12 0x01 0xaf>;
				phandle = <0x14f>;
			};

			vop0-pwm-pin {
				rockchip,pins = <0x04 0x12 0x02 0xad>;
				phandle = <0x9b>;
			};

			vop1-pwm-pin {
				rockchip,pins = <0x04 0x12 0x03 0xad>;
				phandle = <0x94>;
			};
		};

		pwm1 {

			pwm1-pin {
				rockchip,pins = <0x04 0x16 0x01 0xad>;
				phandle = <0x7e>;
			};

			pwm1-pin-pull-down {
				rockchip,pins = <0x04 0x16 0x01 0xaf>;
				phandle = <0x150>;
			};
		};

		pwm2 {

			pwm2-pin {
				rockchip,pins = <0x01 0x13 0x01 0xad>;
				phandle = <0x7f>;
			};

			pwm2-pin-pull-down {
				rockchip,pins = <0x01 0x13 0x01 0xaf>;
				phandle = <0x151>;
			};
		};

		pwm3a {

			pwm3a-pin {
				rockchip,pins = <0x00 0x06 0x01 0xad>;
				phandle = <0x80>;
			};

			pwm3a-pin-pull-down {
				rockchip,pins = <0x00 0x06 0x01 0xaf>;
				phandle = <0x152>;
			};
		};

		pwm3b {

			pwm3b-pin {
				rockchip,pins = <0x01 0x0e 0x01 0xad>;
				phandle = <0x153>;
			};

			pwm3b-pin-pull-down {
				rockchip,pins = <0x01 0x0e 0x01 0xaf>;
				phandle = <0x154>;
			};
		};

		edp {

			edp-hpd {
				rockchip,pins = <0x04 0x17 0x02 0xad>;
				phandle = <0x155>;
			};
		};

		hdmi {

			hdmi-i2c-xfer {
				rockchip,pins = <0x04 0x11 0x03 0xad 0x04 0x10 0x03 0xad>;
				phandle = <0x9f>;
			};

			hdmi-cec {
				rockchip,pins = <0x04 0x17 0x01 0xad>;
				phandle = <0x156>;
			};
		};

		pcie {

			pci-clkreqn {
				rockchip,pins = <0x02 0x1a 0x02 0xad>;
				phandle = <0x157>;
			};

			pci-clkreqnb {
				rockchip,pins = <0x04 0x18 0x01 0xad>;
				phandle = <0x158>;
			};

			pci-clkreqn-cpm {
				rockchip,pins = <0x02 0x1a 0x00 0xad>;
				phandle = <0x159>;
			};

			pci-clkreqnb-cpm {
				rockchip,pins = <0x04 0x18 0x00 0xad>;
				phandle = <0x15a>;
			};
		};

		cros-ec {

			ec-ap-int-l {
				rockchip,pins = <0x00 0x01 0x00 0xab>;
				phandle = <0x4f>;
			};
		};

		discrete-regulators {

			pp1500-en {
				rockchip,pins = <0x00 0x0a 0x00 0xad>;
				phandle = <0xb7>;
			};

			pp1800-audio-en {
				rockchip,pins = <0x00 0x02 0x00 0xaf>;
				phandle = <0xb8>;
			};

			pp3300-disp-en {
				rockchip,pins = <0x04 0x1b 0x00 0xad>;
				phandle = <0xbe>;
			};

			pp3000-en {
				rockchip,pins = <0x00 0x0c 0x00 0xad>;
				phandle = <0xb2>;
			};

			sd-io-pwr-en {
				rockchip,pins = <0x02 0x02 0x00 0xad>;
				phandle = <0xbb>;
			};

			sd-pwr-1800-sel {
				rockchip,pins = <0x02 0x1c 0x00 0xad>;
				phandle = <0xbc>;
			};

			sd-slot-pwr-en {
				rockchip,pins = <0x04 0x1d 0x00 0xad>;
				phandle = <0xba>;
			};

			wlan-module-pd-l {
				rockchip,pins = <0x00 0x04 0x00 0xaf>;
				phandle = <0xb9>;
			};

			fp-en {
				rockchip,pins = <0x01 0x01 0x00 0xad>;
				phandle = <0xc4>;
			};
		};

		codec {

			headset-int-l {
				rockchip,pins = <0x01 0x17 0x00 0xad>;
				phandle = <0x77>;
			};

			mic-int {
				rockchip,pins = <0x01 0x0d 0x00 0xaf>;
				phandle = <0x29>;
			};
		};

		trackpad {

			ap-i2c-tp-pu-en {
				rockchip,pins = <0x03 0x0c 0x00 0xb0>;
				phandle = <0x2e>;
			};

			trackpad-int-l {
				rockchip,pins = <0x01 0x04 0x00 0xab>;
				phandle = <0x15b>;
			};
		};

		backlight-enable {

			bl-en {
				rockchip,pins = <0x01 0x11 0x00 0xad>;
				phandle = <0xc1>;
			};
		};
	};

	rockchip-suspend {
		compatible = "rockchip,pm-rk3399";
		status = "disabled";
		rockchip,sleep-debug-en = <0x00>;
		rockchip,virtual-poweroff = <0x00>;
		rockchip,sleep-mode-config = <0xfe>;
		rockchip,wakeup-config = <0x04>;
		phandle = <0x15c>;
	};

	ppvar-sys {
		compatible = "regulator-fixed";
		regulator-name = "ppvar_sys";
		regulator-always-on;
		regulator-boot-on;
		phandle = <0xb1>;
	};

	pp900-ap {
		compatible = "regulator-fixed";
		regulator-name = "pp900_ap";
		regulator-always-on;
		regulator-boot-on;
		regulator-min-microvolt = <0xdbba0>;
		regulator-max-microvolt = <0xdbba0>;
		vin-supply = <0xb1>;
		phandle = <0x15d>;
	};

	pp1200-lpddr {
		compatible = "regulator-fixed";
		regulator-name = "pp1200_lpddr";
		regulator-always-on;
		regulator-boot-on;
		regulator-min-microvolt = <0x124f80>;
		regulator-max-microvolt = <0x124f80>;
		vin-supply = <0xb1>;
		phandle = <0x15e>;
	};

	pp1800 {
		compatible = "regulator-fixed";
		regulator-name = "pp1800";
		regulator-always-on;
		regulator-boot-on;
		regulator-min-microvolt = <0x1b7740>;
		regulator-max-microvolt = <0x1b7740>;
		vin-supply = <0xb1>;
		phandle = <0x6f>;
	};

	pp3000 {
		compatible = "regulator-fixed";
		regulator-name = "pp3000";
		pinctrl-names = "default";
		pinctrl-0 = <0xb2>;
		enable-active-high;
		gpio = <0x50 0x0c 0x00>;
		regulator-always-on;
		regulator-boot-on;
		regulator-min-microvolt = <0x2dc6c0>;
		regulator-max-microvolt = <0x2dc6c0>;
		vin-supply = <0xb1>;
		phandle = <0x88>;
	};

	pp3300 {
		compatible = "regulator-fixed";
		regulator-name = "pp3300";
		regulator-always-on;
		regulator-boot-on;
		regulator-min-microvolt = <0x325aa0>;
		regulator-max-microvolt = <0x325aa0>;
		vin-supply = <0xb1>;
		phandle = <0x79>;
	};

	pp5000 {
		compatible = "regulator-fixed";
		regulator-name = "pp5000";
		regulator-always-on;
		regulator-boot-on;
		regulator-min-microvolt = <0x4c4b40>;
		regulator-max-microvolt = <0x4c4b40>;
		vin-supply = <0xb1>;
		phandle = <0x15f>;
	};

	ppvar-bigcpu {
		compatible = "regulator-fixed";
		regulator-name = "ppvar_bigcpu";
		status = "okay";
		pwms = <0xb3 0x00 0xd05 0x00>;
		regulator-always-on;
		regulator-boot-on;
		regulator-min-microvolt = <0xdbba0>;
		regulator-max-microvolt = <0xdbba0>;
		pwm-supply = <0xb1>;
		phandle = <0x0c>;
	};

	ppvar-litcpu {
		compatible = "regulator-fixed";
		regulator-name = "ppvar_litcpu";
		status = "okay";
		pwms = <0xb4 0x00 0xd05 0x00>;
		regulator-always-on;
		regulator-boot-on;
		regulator-min-microvolt = <0xdbba0>;
		regulator-max-microvolt = <0xdbba0>;
		pwm-supply = <0xb1>;
		phandle = <0x0b>;
	};

	ppvar-gpu {
		compatible = "regulator-fixed";
		regulator-name = "ppvar_gpu";
		status = "okay";
		pwms = <0xb5 0x00 0xd05 0x00>;
		regulator-always-on;
		regulator-boot-on;
		regulator-min-microvolt = <0xdbba0>;
		regulator-max-microvolt = <0xdbba0>;
		pwm-supply = <0xb1>;
		phandle = <0x8d>;
	};

	ppvar-centerlogic {
		compatible = "regulator-fixed";
		regulator-name = "ppvar_centerlogic";
		status = "okay";
		pwms = <0xb6 0x00 0xd05 0x00>;
		regulator-always-on;
		regulator-boot-on;
		regulator-min-microvolt = <0xdbba0>;
		regulator-max-microvolt = <0xdbba0>;
		pwm-supply = <0xb1>;
		phandle = <0x160>;
	};

	ppvar-logic {
		compatible = "regulator-fixed";
		regulator-name = "ppvar_logic";
		regulator-always-on;
		regulator-boot-on;
		regulator-min-microvolt = <0xdbba0>;
		regulator-max-microvolt = <0xdbba0>;
		vin-supply = <0xb1>;
		phandle = <0x161>;
	};

	pp900_ap {
		phandle = <0x162>;
	};

	pp1200-hsic {
		compatible = "regulator-fixed";
		regulator-name = "pp1200_hsic";
		regulator-always-on;
		regulator-boot-on;
		regulator-min-microvolt = <0x124f80>;
		regulator-max-microvolt = <0x124f80>;
		vin-supply = <0x6f>;
		phandle = <0x163>;
	};

	pp1500-ap-io {
		compatible = "regulator-fixed";
		regulator-name = "pp1500_ap_io";
		pinctrl-names = "default";
		pinctrl-0 = <0xb7>;
		enable-active-high;
		gpio = <0x2a 0x0b 0x00>;
		regulator-always-on;
		regulator-boot-on;
		regulator-min-microvolt = <0x16e360>;
		regulator-max-microvolt = <0x16e360>;
		vin-supply = <0x6f>;
		phandle = <0x164>;
	};

	pp1800-audio {
		compatible = "regulator-fixed";
		regulator-name = "pp1800_audio";
		pinctrl-names = "default";
		pinctrl-0 = <0xb8>;
		regulator-always-on;
		regulator-boot-on;
		enable-active-high;
		gpio = <0x50 0x02 0x00>;
		vin-supply = <0x6f>;
		phandle = <0x87>;
	};

	pp1800-pcie {
		compatible = "regulator-fixed";
		regulator-name = "pp1800_pcie";
		pinctrl-names = "default";
		pinctrl-0 = <0xb9>;
		regulator-always-on;
		regulator-boot-on;
		enable-active-high;
		gpio = <0x50 0x04 0x00>;
		vin-supply = <0x6f>;
		phandle = <0x165>;
	};

	pp3000-sd-slot {
		compatible = "regulator-fixed";
		regulator-name = "pp3000_sd_slot";
		pinctrl-names = "default";
		pinctrl-0 = <0xba>;
		enable-active-high;
		gpio = <0x17 0x1d 0x00>;
		vin-supply = <0x88>;
		phandle = <0x18>;
	};

	ppvar-sd-card-io {
		compatible = "regulator-gpio";
		regulator-name = "ppvar_sd_card_io";
		pinctrl-names = "default";
		pinctrl-0 = <0xbb 0xbc>;
		enable-active-high;
		enable-gpio = <0xbd 0x02 0x00>;
		gpios = <0xbd 0x1c 0x00>;
		states = <0x1b7740 0x01 0x2dc6c0 0x00>;
		regulator-min-microvolt = <0x1b7740>;
		regulator-max-microvolt = <0x2dc6c0>;
		phandle = <0x19>;
	};

	pp3300-trackpad {
		phandle = <0x166>;
	};

	pp3300-disp {
		compatible = "regulator-fixed";
		regulator-name = "pp3300_disp";
		pinctrl-names = "default";
		pinctrl-0 = <0xbe>;
		enable-active-high;
		regulator-always-on;
		regulator-boot-on;
		gpio = <0x17 0x1b 0x00>;
		vin-supply = <0x79>;
		phandle = <0x27>;
	};

	pp3300-wifi-bt {
		compatible = "regulator-fixed";
		regulator-name = "pp3300_wifi_bt";
		regulator-always-on;
		regulator-boot-on;
		enable-active-high;
		gpio = <0x50 0x08 0x00>;
		vin-supply = <0x79>;
		phandle = <0x167>;
	};

	sound {
		compatible = "rockchip,rockchip-audio-da7219";
		rockchip,model = "audio-da7219";
		rockchip,i2s-controller = <0xbf>;
		rockchip,audio-codec = <0xc0>;
	};

	backlight {
		compatible = "gpio-backlight";
		pinctrl-names = "default";
		pinctrl-0 = <0xc1>;
		gpios = <0x2a 0x11 0x00>;
		phandle = <0xc2>;
	};

	edp-panel {
		compatible = "samsung,lsn122dl01-c01\0panel-simple";
		backlight = <0xc2>;
		power-supply = <0x27>;
		phandle = <0x168>;

		ports {

			endpoint {
				remote-endpoint = <0xc3>;
				phandle = <0xa8>;
			};
		};
	};

	pp1800-fp {
		compatible = "regulator-fixed";
		regulator-name = "pp1800_fp";
		pinctrl-names = "default";
		pinctrl-0 = <0xc4>;
		enable-active-high;
		gpio = <0x2a 0x01 0x00>;
		regulator-always-on;
		regulator-boot-on;
		vin-supply = <0x6f>;
		phandle = <0x169>;
	};

	pp3300-fp {
		compatible = "regulator-fixed";
		regulator-name = "pp3300_fp";
		enable-active-high;
		gpio = <0x2a 0x01 0x00>;
		regulator-always-on;
		regulator-boot-on;
		vin-supply = <0x79>;
		phandle = <0x16a>;
	};

	__symbols__ {
		ddr_timing = "/ddr_timing";
		cpu_l0 = "/cpus/cpu@0";
		cpu_l1 = "/cpus/cpu@1";
		cpu_l2 = "/cpus/cpu@2";
		cpu_l3 = "/cpus/cpu@3";
		cpu_b0 = "/cpus/cpu@100";
		cpu_b1 = "/cpus/cpu@101";
		CPU_SLEEP = "/cpus/idle-states/cpu-sleep";
		CLUSTER_SLEEP = "/cpus/idle-states/cluster-sleep";
		xin24m = "/xin24m";
		dummy_cpll = "/dummy_cpll";
		dummy_vpll = "/dummy_vpll";
		dmac_bus = "/amba/dma-controller@ff6d0000";
		dmac_peri = "/amba/dma-controller@ff6e0000";
		gmac = "/ethernet@fe300000";
		sdio0 = "/dwmmc@fe310000";
		sdmmc = "/dwmmc@fe320000";
		sdhci = "/sdhci@fe330000";
		usic = "/usb@fe340000";
		usb_host0_ehci = "/usb@fe380000";
		usb_host0_ohci = "/usb@fe3a0000";
		usb_host1_ehci = "/usb@fe3c0000";
		usb_host1_ohci = "/usb@fe3e0000";
		usbdrd3_0 = "/usb0";
		usbdrd_dwc3_0 = "/usb0/dwc3@fe800000";
		usbdrd3_1 = "/usb1";
		usbdrd_dwc3_1 = "/usb1/dwc3@fe900000";
		cdn_dp = "/dp@fec00000";
		dp_in = "/dp@fec00000/ports/port";
		dp_in_vopb = "/dp@fec00000/ports/port/endpoint@0";
		dp_in_vopl = "/dp@fec00000/ports/port/endpoint@1";
		gic = "/interrupt-controller@fee00000";
		its = "/interrupt-controller@fee00000/interrupt-controller@fee20000";
		ppi_cluster0 = "/interrupt-controller@fee00000/ppi-partitions/interrupt-partition-0";
		ppi_cluster1 = "/interrupt-controller@fee00000/ppi-partitions/interrupt-partition-1";
		saradc = "/saradc@ff100000";
		ap_i2c_dvs = "/i2c@ff3c0000";
		i2c0 = "/i2c@ff3c0000";
		ap_i2c_mic = "/i2c@ff110000";
		i2c1 = "/i2c@ff110000";
		headsetcodec = "/i2c@ff110000/rt5514@57";
		ap_i2c_cam = "/i2c@ff120000";
		i2c2 = "/i2c@ff120000";
		ap_i2c_ts = "/i2c@ff130000";
		i2c3 = "/i2c@ff130000";
		ap_i2c_tp = "/i2c@ff140000";
		i2c5 = "/i2c@ff140000";
		i2c6 = "/i2c@ff150000";
		ap_i2c_nfc = "/i2c@ff160000";
		i2c7 = "/i2c@ff160000";
		uart0 = "/serial@ff180000";
		uart1 = "/serial@ff190000";
		uart2 = "/serial@ff1a0000";
		uart3 = "/serial@ff1b0000";
		spi0 = "/spi@ff1c0000";
		spi1 = "/spi@ff1d0000";
		spi2 = "/spi@ff1e0000";
		spi4 = "/spi@ff1f0000";
		spi5 = "/spi@ff200000";
		cros_ec = "/spi@ff200000/ec@0";
		i2c_tunnel = "/spi@ff200000/ec@0/i2c-tunnel";
		thermal_zones = "/thermal-zones";
		soc_thermal = "/thermal-zones/soc-thermal";
		threshold = "/thermal-zones/soc-thermal/trips/trip-point-0";
		target = "/thermal-zones/soc-thermal/trips/trip-point-1";
		soc_crit = "/thermal-zones/soc-thermal/trips/soc-crit";
		gpu_thermal = "/thermal-zones/gpu-thermal";
		tsadc = "/tsadc@ff260000";
		qos_emmc = "/qos@ffa58000";
		qos_gmac = "/qos@ffa5c000";
		qos_pcie = "/qos@ffa60080";
		qos_usb_host0 = "/qos@ffa60100";
		qos_usb_host1 = "/qos@ffa60180";
		qos_usb_otg0 = "/qos@ffa70000";
		qos_usb_otg1 = "/qos@ffa70080";
		qos_sd = "/qos@ffa74000";
		qos_sdioaudio = "/qos@ffa76000";
		qos_hdcp = "/qos@ffa90000";
		qos_iep = "/qos@ffa98000";
		qos_isp0_m0 = "/qos@ffaa0000";
		qos_isp0_m1 = "/qos@ffaa0080";
		qos_isp1_m0 = "/qos@ffaa8000";
		qos_isp1_m1 = "/qos@ffaa8080";
		qos_rga_r = "/qos@ffab0000";
		qos_rga_w = "/qos@ffab0080";
		qos_video_m0 = "/qos@ffab8000";
		qos_video_m1_r = "/qos@ffac0000";
		qos_video_m1_w = "/qos@ffac0080";
		qos_vop_big_r = "/qos@ffac8000";
		qos_vop_big_w = "/qos@ffac8080";
		qos_vop_little = "/qos@ffad0000";
		qos_perihp = "/qos@ffad8080";
		qos_gpu = "/qos@ffae0000";
		pmu = "/power-management@ff310000";
		power = "/power-management@ff310000/power-controller";
		pmugrf = "/syscon@ff320000";
		pmu_io_domains = "/syscon@ff320000/io-domains";
		pmu_pvtm = "/syscon@ff320000/pmu-pvtm";
		spi3 = "/spi@ff350000";
		uart4 = "/serial@ff370000";
		i2c4 = "/i2c@ff3d0000";
		ap_i2c_audio = "/i2c@ff3e0000";
		i2c8 = "/i2c@ff3e0000";
		codec = "/i2c@ff3e0000/da7219@1a";
		pcie_phy = "/pcie-phy";
		pcie0 = "/pcie@f8000000";
		pcie0_intc = "/pcie@f8000000/interrupt-controller";
		pwm0 = "/pwm@ff420000";
		pwm1 = "/pwm@ff420010";
		pwm2 = "/pwm@ff420020";
		pwm3 = "/pwm@ff420030";
		dfi = "/dfi@ff630000";
		dmc = "/dmc";
		vpu = "/vpu_service@ff650000";
		vpu_mmu = "/iommu@ff650800";
		rkvdec = "/rkvdec@ff660000";
		vdec_mmu = "/iommu@ff660480";
		iep = "/iep@ff670000";
		iep_mmu = "/iommu@ff670800";
		rga = "/rga@ff680000";
		efuse0 = "/efuse@ff690000";
		specification_serial_number = "/efuse@ff690000/specification-serial-number@6";
		cpu_id = "/efuse@ff690000/cpu-id@7";
		cpub_leakage = "/efuse@ff690000/cpu-leakage@17";
		gpu_leakage = "/efuse@ff690000/gpu-leakage@18";
		center_leakage = "/efuse@ff690000/center-leakage@19";
		cpul_leakage = "/efuse@ff690000/cpu-leakage@1a";
		logic_leakage = "/efuse@ff690000/logic-leakage@1b";
		wafer_info = "/efuse@ff690000/wafer-info@1c";
		pmucru = "/pmu-clock-controller@ff750000";
		cru = "/clock-controller@ff760000";
		grf = "/syscon@ff770000";
		io_domains = "/syscon@ff770000/io-domains";
		u2phy0 = "/syscon@ff770000/usb2-phy@e450";
		u2phy0_host = "/syscon@ff770000/usb2-phy@e450/host-port";
		u2phy0_otg = "/syscon@ff770000/usb2-phy@e450/otg-port";
		u2phy1 = "/syscon@ff770000/usb2-phy@e460";
		u2phy1_host = "/syscon@ff770000/usb2-phy@e460/host-port";
		u2phy1_otg = "/syscon@ff770000/usb2-phy@e460/otg-port";
		emmc_phy = "/syscon@ff770000/phy@f780";
		mipi_dphy_rx0 = "/syscon@ff770000/mipi-dphy-rx0";
		pvtm = "/syscon@ff770000/pvtm";
		tcphy0 = "/phy@ff7c0000";
		tcphy0_dp = "/phy@ff7c0000/dp-port";
		tcphy0_usb3 = "/phy@ff7c0000/usb3-port";
		tcphy1 = "/phy@ff800000";
		tcphy1_dp = "/phy@ff800000/dp-port";
		tcphy1_usb3 = "/phy@ff800000/usb3-port";
		rktimer = "/rktimer@ff850000";
		spdif = "/spdif@ff870000";
		i2s0 = "/i2s@ff880000";
		i2s1 = "/i2s@ff890000";
		i2s2 = "/i2s@ff8a0000";
		gpu = "/gpu@ff9a0000";
		gpu_power_model = "/gpu@ff9a0000/power_model";
		vopl = "/vop@ff8f0000";
		vopl_out = "/vop@ff8f0000/port";
		vopl_out_dsi = "/vop@ff8f0000/port/endpoint@0";
		vopl_out_edp = "/vop@ff8f0000/port/endpoint@1";
		vopl_out_hdmi = "/vop@ff8f0000/port/endpoint@2";
		vopl_out_dp = "/vop@ff8f0000/port/endpoint@3";
		vopl_out_dsi1 = "/vop@ff8f0000/port/endpoint@4";
		vop1_pwm = "/voppwm@ff8f01a0";
		vopl_mmu = "/iommu@ff8f3f00";
		vopb = "/vop@ff900000";
		vopb_out = "/vop@ff900000/port";
		vopb_out_edp = "/vop@ff900000/port/endpoint@0";
		vopb_out_dsi = "/vop@ff900000/port/endpoint@1";
		vopb_out_hdmi = "/vop@ff900000/port/endpoint@2";
		vopb_out_dp = "/vop@ff900000/port/endpoint@3";
		vopb_out_dsi1 = "/vop@ff900000/port/endpoint@4";
		vop0_pwm = "/voppwm@ff9001a0";
		vopb_mmu = "/iommu@ff903f00";
		rkisp1_0 = "/rkisp1@ff910000";
		isp0_mmu = "/iommu@ff914000";
		rkisp1_1 = "/rkisp1@ff920000";
		isp1_mmu = "/iommu@ff924000";
		hdmi = "/hdmi@ff940000";
		hdmi_in = "/hdmi@ff940000/ports/port";
		hdmi_in_vopb = "/hdmi@ff940000/ports/port/endpoint@0";
		hdmi_in_vopl = "/hdmi@ff940000/ports/port/endpoint@1";
		dsi = "/dsi@ff960000";
		dsi_in_vopb = "/dsi@ff960000/ports/port/endpoint@0";
		dsi_in_vopl = "/dsi@ff960000/ports/port/endpoint@1";
		dsi1 = "/dsi@ff968000";
		dsi1_in_vopb = "/dsi@ff968000/ports/port/endpoint@0";
		dsi1_in_vopl = "/dsi@ff968000/ports/port/endpoint@1";
		mipi_dphy_tx1rx1 = "/mipi-dphy-tx1rx1@ff968000";
		edp = "/edp@ff970000";
		edp_in = "/edp@ff970000/ports/port@0";
		edp_in_vopb = "/edp@ff970000/ports/port@0/endpoint@0";
		edp_in_vopl = "/edp@ff970000/ports/port@0/endpoint@1";
		edp_out = "/edp@ff970000/ports/port@1";
		edp_out_panel = "/edp@ff970000/ports/port@1/endpoint@0";
		hdmi_hdcp2 = "/hdmi-hdcp2@ff988000";
		display_subsystem = "/display-subsystem";
		nocp_cci_msch0 = "/nocp-cci-msch0@ffa86000";
		nocp_gpu_msch0 = "/nocp-gpu-msch0@ffa86400";
		nocp_hp_msch0 = "/nocp-hp-msch0@ffa86800";
		nocp_lp_msch0 = "/nocp-lp-msch0@ffa86c00";
		nocp_video_msch0 = "/nocp-video-msch0@ffa87000";
		nocp_vio0_msch0 = "/nocp-vio0-msch0@ffa87400";
		nocp_vio1_msch0 = "/nocp-vio1-msch0@ffa87800";
		nocp_cci_msch1 = "/nocp-cci-msch1@ffa8e000";
		nocp_gpu_msch1 = "/nocp-gpu-msch1@ffa8e400";
		nocp_hp_msch1 = "/nocp-hp-msch1@ffa8e800";
		nocp_lp_msch1 = "/nocp-lp-msch1@ffa8ec00";
		nocp_video_msch1 = "/nocp-video-msch1@ffa8f000";
		nocp_vio0_msch1 = "/nocp-vio0-msch1@ffa8f400";
		nocp_vio1_msch1 = "/nocp-vio1-msch1@ffa8f800";
		rockchip_system_monitor = "/rockchip-system-monitor";
		pinctrl = "/pinctrl";
		gpio0 = "/pinctrl/gpio0@ff720000";
		gpio1 = "/pinctrl/gpio1@ff730000";
		gpio2 = "/pinctrl/gpio2@ff780000";
		gpio3 = "/pinctrl/gpio3@ff788000";
		gpio4 = "/pinctrl/gpio4@ff790000";
		pcfg_pull_up = "/pinctrl/pcfg-pull-up";
		pcfg_pull_down = "/pinctrl/pcfg-pull-down";
		pcfg_pull_none = "/pinctrl/pcfg-pull-none";
		pcfg_pull_up_20ma = "/pinctrl/pcfg-pull-up-20ma";
		pcfg_pull_none_20ma = "/pinctrl/pcfg-pull-none-20ma";
		pcfg_pull_none_18ma = "/pinctrl/pcfg-pull-none-18ma";
		pcfg_pull_none_12ma = "/pinctrl/pcfg-pull-none-12ma";
		pcfg_pull_none_10ma = "/pinctrl/pcfg-pull-none-10ma";
		pcfg_pull_up_10ma = "/pinctrl/pcfg-pull-up-10ma";
		pcfg_pull_up_8ma = "/pinctrl/pcfg-pull-up-8ma";
		pcfg_pull_down_4ma = "/pinctrl/pcfg-pull-down-4ma";
		pcfg_pull_up_2ma = "/pinctrl/pcfg-pull-up-2ma";
		pcfg_pull_down_12ma = "/pinctrl/pcfg-pull-down-12ma";
		pcfg_pull_none_13ma = "/pinctrl/pcfg-pull-none-13ma";
		pcfg_output_high = "/pinctrl/pcfg-output-high";
		pcfg_output_low = "/pinctrl/pcfg-output-low";
		pcfg_input = "/pinctrl/pcfg-input";
		emmc_pwr = "/pinctrl/emmc/emmc-pwr";
		rgmii_pins = "/pinctrl/gmac/rgmii-pins";
		rmii_pins = "/pinctrl/gmac/rmii-pins";
		i2c0_xfer = "/pinctrl/i2c0/i2c0-xfer";
		i2c1_xfer = "/pinctrl/i2c1/i2c1-xfer";
		i2c2_xfer = "/pinctrl/i2c2/i2c2-xfer";
		i2c3_xfer = "/pinctrl/i2c3/i2c3-xfer";
		i2c3_gpio = "/pinctrl/i2c3/i2c3_gpio";
		i2c4_xfer = "/pinctrl/i2c4/i2c4-xfer";
		i2c5_xfer = "/pinctrl/i2c5/i2c5-xfer";
		i2c6_xfer = "/pinctrl/i2c6/i2c6-xfer";
		i2c7_xfer = "/pinctrl/i2c7/i2c7-xfer";
		i2c8_xfer = "/pinctrl/i2c8/i2c8-xfer";
		i2s0_8ch_bus = "/pinctrl/i2s0/i2s0-8ch-bus";
		i2s_8ch_mclk = "/pinctrl/i2s0/i2s-8ch-mclk";
		i2s1_2ch_bus = "/pinctrl/i2s1/i2s1-2ch-bus";
		sdio0_bus1 = "/pinctrl/sdio0/sdio0-bus1";
		sdio0_bus4 = "/pinctrl/sdio0/sdio0-bus4";
		sdio0_cmd = "/pinctrl/sdio0/sdio0-cmd";
		sdio0_clk = "/pinctrl/sdio0/sdio0-clk";
		sdio0_cd = "/pinctrl/sdio0/sdio0-cd";
		sdio0_pwr = "/pinctrl/sdio0/sdio0-pwr";
		sdio0_bkpwr = "/pinctrl/sdio0/sdio0-bkpwr";
		sdio0_wp = "/pinctrl/sdio0/sdio0-wp";
		sdio0_int = "/pinctrl/sdio0/sdio0-int";
		sdmmc_bus1 = "/pinctrl/sdmmc/sdmmc-bus1";
		sdmmc_bus4 = "/pinctrl/sdmmc/sdmmc-bus4";
		sdmmc_clk = "/pinctrl/sdmmc/sdmmc-clk";
		sdmmc_cmd = "/pinctrl/sdmmc/sdmmc-cmd";
		sdmmc_cd = "/pinctrl/sdmmc/sdmcc-cd";
		sdmmc_wp = "/pinctrl/sdmmc/sdmmc-wp";
		sdmmc_cd_gpio = "/pinctrl/sdmmc/sdmmc-cd-gpio";
		spdif_bus = "/pinctrl/spdif/spdif-bus";
		spdif_bus_1 = "/pinctrl/spdif/spdif-bus-1";
		spi0_clk = "/pinctrl/spi0/spi0-clk";
		spi0_cs0 = "/pinctrl/spi0/spi0-cs0";
		spi0_cs1 = "/pinctrl/spi0/spi0-cs1";
		spi0_tx = "/pinctrl/spi0/spi0-tx";
		spi0_rx = "/pinctrl/spi0/spi0-rx";
		spi1_clk = "/pinctrl/spi1/spi1-clk";
		spi1_cs0 = "/pinctrl/spi1/spi1-cs0";
		spi1_rx = "/pinctrl/spi1/spi1-rx";
		spi1_tx = "/pinctrl/spi1/spi1-tx";
		spi2_clk = "/pinctrl/spi2/spi2-clk";
		spi2_cs0 = "/pinctrl/spi2/spi2-cs0";
		spi2_rx = "/pinctrl/spi2/spi2-rx";
		spi2_tx = "/pinctrl/spi2/spi2-tx";
		spi3_clk = "/pinctrl/spi3/spi3-clk";
		spi3_cs0 = "/pinctrl/spi3/spi3-cs0";
		spi3_rx = "/pinctrl/spi3/spi3-rx";
		spi3_tx = "/pinctrl/spi3/spi3-tx";
		spi4_clk = "/pinctrl/spi4/spi4-clk";
		spi4_cs0 = "/pinctrl/spi4/spi4-cs0";
		spi4_rx = "/pinctrl/spi4/spi4-rx";
		spi4_tx = "/pinctrl/spi4/spi4-tx";
		spi5_clk = "/pinctrl/spi5/spi5-clk";
		spi5_cs0 = "/pinctrl/spi5/spi5-cs0";
		spi5_rx = "/pinctrl/spi5/spi5-rx";
		spi5_tx = "/pinctrl/spi5/spi5-tx";
		otp_gpio = "/pinctrl/tsadc/otp-gpio";
		otp_out = "/pinctrl/tsadc/otp-out";
		uart0_xfer = "/pinctrl/uart0/uart0-xfer";
		uart0_cts = "/pinctrl/uart0/uart0-cts";
		uart0_rts = "/pinctrl/uart0/uart0-rts";
		uart1_xfer = "/pinctrl/uart1/uart1-xfer";
		uart2a_xfer = "/pinctrl/uart2a/uart2a-xfer";
		uart2b_xfer = "/pinctrl/uart2b/uart2b-xfer";
		uart2c_xfer = "/pinctrl/uart2c/uart2c-xfer";
		uart3_xfer = "/pinctrl/uart3/uart3-xfer";
		uart3_cts = "/pinctrl/uart3/uart3-cts";
		uart3_rts = "/pinctrl/uart3/uart3-rts";
		uart4_xfer = "/pinctrl/uart4/uart4-xfer";
		uarthdcp_xfer = "/pinctrl/uarthdcp/uarthdcp-xfer";
		pwm0_pin = "/pinctrl/pwm0/pwm0-pin";
		pwm0_pin_pull_down = "/pinctrl/pwm0/pwm0-pin-pull-down";
		vop0_pwm_pin = "/pinctrl/pwm0/vop0-pwm-pin";
		vop1_pwm_pin = "/pinctrl/pwm0/vop1-pwm-pin";
		pwm1_pin = "/pinctrl/pwm1/pwm1-pin";
		pwm1_pin_pull_down = "/pinctrl/pwm1/pwm1-pin-pull-down";
		pwm2_pin = "/pinctrl/pwm2/pwm2-pin";
		pwm2_pin_pull_down = "/pinctrl/pwm2/pwm2-pin-pull-down";
		pwm3a_pin = "/pinctrl/pwm3a/pwm3a-pin";
		pwm3a_pin_pull_down = "/pinctrl/pwm3a/pwm3a-pin-pull-down";
		pwm3b_pin = "/pinctrl/pwm3b/pwm3b-pin";
		pwm3b_pin_pull_down = "/pinctrl/pwm3b/pwm3b-pin-pull-down";
		edp_hpd = "/pinctrl/edp/edp-hpd";
		hdmi_i2c_xfer = "/pinctrl/hdmi/hdmi-i2c-xfer";
		hdmi_cec = "/pinctrl/hdmi/hdmi-cec";
		pcie_clkreqn = "/pinctrl/pcie/pci-clkreqn";
		pcie_clkreqnb = "/pinctrl/pcie/pci-clkreqnb";
		pcie_clkreqn_cpm = "/pinctrl/pcie/pci-clkreqn-cpm";
		pcie_clkreqnb_cpm = "/pinctrl/pcie/pci-clkreqnb-cpm";
		ec_ap_int_l = "/pinctrl/cros-ec/ec-ap-int-l";
		pp1500_en = "/pinctrl/discrete-regulators/pp1500-en";
		pp1800_audio_en = "/pinctrl/discrete-regulators/pp1800-audio-en";
		pp3300_disp_en = "/pinctrl/discrete-regulators/pp3300-disp-en";
		pp3000_en = "/pinctrl/discrete-regulators/pp3000-en";
		sd_io_pwr_en = "/pinctrl/discrete-regulators/sd-io-pwr-en";
		sd_pwr_1800_sel = "/pinctrl/discrete-regulators/sd-pwr-1800-sel";
		sd_slot_pwr_en = "/pinctrl/discrete-regulators/sd-slot-pwr-en";
		wlan_module_pd_l = "/pinctrl/discrete-regulators/wlan-module-pd-l";
		fp_en = "/pinctrl/discrete-regulators/fp-en";
		headset_int_l = "/pinctrl/codec/headset-int-l";
		mic_int = "/pinctrl/codec/mic-int";
		ap_i2c_tp_pu_en = "/pinctrl/trackpad/ap-i2c-tp-pu-en";
		trackpad_int_l = "/pinctrl/trackpad/trackpad-int-l";
		bl_en = "/pinctrl/backlight-enable/bl-en";
		rockchip_suspend = "/rockchip-suspend";
		ppvar_sys = "/ppvar-sys";
		pp900_ap = "/pp900-ap";
		pp1200_lpddr = "/pp1200-lpddr";
		pp1800_usb = "/pp1800";
		pp1800_sensor = "/pp1800";
		pp1800_pmu = "/pp1800";
		pp1800_lpddr = "/pp1800";
		pp1800_mic = "/pp1800";
		pp1800_lid = "/pp1800";
		pp1800_avdd = "/pp1800";
		pp1800_s0 = "/pp1800";
		pp1800_nfc = "/pp1800";
		pp1800_emmc = "/pp1800";
		pp1800_ap_io = "/pp1800";
		pp1800 = "/pp1800";
		pp3000_emmc = "/pp3000";
		pp3000_ap = "/pp3000";
		pp3000 = "/pp3000";
		pp3300_usb = "/pp3300";
		pp3300 = "/pp3300";
		pp5000 = "/pp5000";
		ppvar_bigcpu = "/ppvar-bigcpu";
		ppvar_litcpu = "/ppvar-litcpu";
		ppvar_gpu = "/ppvar-gpu";
		ppvar_centerlogic = "/ppvar-centerlogic";
		ppvar_logic = "/ppvar-logic";
		pp900_usb = "/pp900_ap";
		pp900_pmu = "/pp900_ap";
		pp900_pll = "/pp900_ap";
		pp900_pcie = "/pp900_ap";
		pp900_ddrpll = "/pp900_ap";
		pp1200_hsic = "/pp1200-hsic";
		pp1500_ap_io = "/pp1500-ap-io";
		pp1800_audio = "/pp1800-audio";
		pp1800_pcie = "/pp1800-pcie";
		pp3000_sd_slot = "/pp3000-sd-slot";
		ppvar_sd_card_io = "/ppvar-sd-card-io";
		pp3300_trackpad = "/pp3300-trackpad";
		pp3300_disp = "/pp3300-disp";
		pp3300_wifi_bt = "/pp3300-wifi-bt";
		backlight = "/backlight";
		edp_panel = "/edp-panel";
		panel_in_edp = "/edp-panel/ports/endpoint";
		pp1800_fp = "/pp1800-fp";
		pp3300_fp = "/pp3300-fp";
	};
};
