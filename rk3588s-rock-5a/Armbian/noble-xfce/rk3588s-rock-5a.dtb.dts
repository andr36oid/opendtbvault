/dts-v1/;

/ {
	compatible = "radxa,rock-5a\0rockchip,rk3588s";
	interrupt-parent = <0x01>;
	#address-cells = <0x02>;
	#size-cells = <0x02>;
	model = "Radxa ROCK 5A";

	aliases {
		gpio0 = "/pinctrl/gpio@fd8a0000";
		gpio1 = "/pinctrl/gpio@fec20000";
		gpio2 = "/pinctrl/gpio@fec30000";
		gpio3 = "/pinctrl/gpio@fec40000";
		gpio4 = "/pinctrl/gpio@fec50000";
		i2c0 = "/i2c@fd880000";
		i2c1 = "/i2c@fea90000";
		i2c2 = "/i2c@feaa0000";
		i2c3 = "/i2c@feab0000";
		i2c4 = "/i2c@feac0000";
		i2c5 = "/i2c@fead0000";
		i2c6 = "/i2c@fec80000";
		i2c7 = "/i2c@fec90000";
		i2c8 = "/i2c@feca0000";
		serial0 = "/serial@fd890000";
		serial1 = "/serial@feb40000";
		serial2 = "/serial@feb50000";
		serial3 = "/serial@feb60000";
		serial4 = "/serial@feb70000";
		serial5 = "/serial@feb80000";
		serial6 = "/serial@feb90000";
		serial7 = "/serial@feba0000";
		serial8 = "/serial@febb0000";
		serial9 = "/serial@febc0000";
		spi0 = "/spi@feb00000";
		spi1 = "/spi@feb10000";
		spi2 = "/spi@feb20000";
		spi3 = "/spi@feb30000";
		spi4 = "/spi@fecb0000";
		ethernet0 = "/ethernet@fe1c0000";
		mmc0 = "/mmc@fe2e0000";
		mmc1 = "/mmc@fe2c0000";
	};

	cpus {
		#address-cells = <0x01>;
		#size-cells = <0x00>;

		cpu-map {

			cluster0 {

				core0 {
					cpu = <0x02>;
				};

				core1 {
					cpu = <0x03>;
				};

				core2 {
					cpu = <0x04>;
				};

				core3 {
					cpu = <0x05>;
				};
			};

			cluster1 {

				core0 {
					cpu = <0x06>;
				};

				core1 {
					cpu = <0x07>;
				};
			};

			cluster2 {

				core0 {
					cpu = <0x08>;
				};

				core1 {
					cpu = <0x09>;
				};
			};
		};

		cpu@0 {
			device_type = "cpu";
			compatible = "arm,cortex-a55";
			reg = <0x00>;
			enable-method = "psci";
			capacity-dmips-mhz = <0x212>;
			clocks = <0x0a 0x00>;
			assigned-clocks = <0x0a 0x00>;
			assigned-clock-rates = <0x30a32c00>;
			cpu-idle-states = <0x0b>;
			i-cache-size = <0x8000>;
			i-cache-line-size = <0x40>;
			i-cache-sets = <0x80>;
			d-cache-size = <0x8000>;
			d-cache-line-size = <0x40>;
			d-cache-sets = <0x80>;
			next-level-cache = <0x0c>;
			dynamic-power-coefficient = <0xe4>;
			#cooling-cells = <0x02>;
			operating-points-v2 = <0x0d>;
			cpu-supply = <0x0e>;
			phandle = <0x02>;
		};

		cpu@100 {
			device_type = "cpu";
			compatible = "arm,cortex-a55";
			reg = <0x100>;
			enable-method = "psci";
			capacity-dmips-mhz = <0x212>;
			clocks = <0x0a 0x00>;
			cpu-idle-states = <0x0b>;
			i-cache-size = <0x8000>;
			i-cache-line-size = <0x40>;
			i-cache-sets = <0x80>;
			d-cache-size = <0x8000>;
			d-cache-line-size = <0x40>;
			d-cache-sets = <0x80>;
			next-level-cache = <0x0f>;
			dynamic-power-coefficient = <0xe4>;
			#cooling-cells = <0x02>;
			operating-points-v2 = <0x0d>;
			cpu-supply = <0x0e>;
			phandle = <0x03>;
		};

		cpu@200 {
			device_type = "cpu";
			compatible = "arm,cortex-a55";
			reg = <0x200>;
			enable-method = "psci";
			capacity-dmips-mhz = <0x212>;
			clocks = <0x0a 0x00>;
			cpu-idle-states = <0x0b>;
			i-cache-size = <0x8000>;
			i-cache-line-size = <0x40>;
			i-cache-sets = <0x80>;
			d-cache-size = <0x8000>;
			d-cache-line-size = <0x40>;
			d-cache-sets = <0x80>;
			next-level-cache = <0x10>;
			dynamic-power-coefficient = <0xe4>;
			#cooling-cells = <0x02>;
			operating-points-v2 = <0x0d>;
			cpu-supply = <0x0e>;
			phandle = <0x04>;
		};

		cpu@300 {
			device_type = "cpu";
			compatible = "arm,cortex-a55";
			reg = <0x300>;
			enable-method = "psci";
			capacity-dmips-mhz = <0x212>;
			clocks = <0x0a 0x00>;
			cpu-idle-states = <0x0b>;
			i-cache-size = <0x8000>;
			i-cache-line-size = <0x40>;
			i-cache-sets = <0x80>;
			d-cache-size = <0x8000>;
			d-cache-line-size = <0x40>;
			d-cache-sets = <0x80>;
			next-level-cache = <0x11>;
			dynamic-power-coefficient = <0xe4>;
			#cooling-cells = <0x02>;
			operating-points-v2 = <0x0d>;
			cpu-supply = <0x0e>;
			phandle = <0x05>;
		};

		cpu@400 {
			device_type = "cpu";
			compatible = "arm,cortex-a76";
			reg = <0x400>;
			enable-method = "psci";
			capacity-dmips-mhz = <0x400>;
			clocks = <0x0a 0x02>;
			assigned-clocks = <0x0a 0x02>;
			assigned-clock-rates = <0x30a32c00>;
			cpu-idle-states = <0x0b>;
			i-cache-size = <0x10000>;
			i-cache-line-size = <0x40>;
			i-cache-sets = <0x100>;
			d-cache-size = <0x10000>;
			d-cache-line-size = <0x40>;
			d-cache-sets = <0x100>;
			next-level-cache = <0x12>;
			dynamic-power-coefficient = <0x1a0>;
			#cooling-cells = <0x02>;
			operating-points-v2 = <0x13>;
			cpu-supply = <0x14>;
			phandle = <0x06>;
		};

		cpu@500 {
			device_type = "cpu";
			compatible = "arm,cortex-a76";
			reg = <0x500>;
			enable-method = "psci";
			capacity-dmips-mhz = <0x400>;
			clocks = <0x0a 0x02>;
			cpu-idle-states = <0x0b>;
			i-cache-size = <0x10000>;
			i-cache-line-size = <0x40>;
			i-cache-sets = <0x100>;
			d-cache-size = <0x10000>;
			d-cache-line-size = <0x40>;
			d-cache-sets = <0x100>;
			next-level-cache = <0x15>;
			dynamic-power-coefficient = <0x1a0>;
			#cooling-cells = <0x02>;
			operating-points-v2 = <0x13>;
			cpu-supply = <0x14>;
			phandle = <0x07>;
		};

		cpu@600 {
			device_type = "cpu";
			compatible = "arm,cortex-a76";
			reg = <0x600>;
			enable-method = "psci";
			capacity-dmips-mhz = <0x400>;
			clocks = <0x0a 0x03>;
			assigned-clocks = <0x0a 0x03>;
			assigned-clock-rates = <0x30a32c00>;
			cpu-idle-states = <0x0b>;
			i-cache-size = <0x10000>;
			i-cache-line-size = <0x40>;
			i-cache-sets = <0x100>;
			d-cache-size = <0x10000>;
			d-cache-line-size = <0x40>;
			d-cache-sets = <0x100>;
			next-level-cache = <0x16>;
			dynamic-power-coefficient = <0x1a0>;
			#cooling-cells = <0x02>;
			operating-points-v2 = <0x17>;
			cpu-supply = <0x18>;
			phandle = <0x08>;
		};

		cpu@700 {
			device_type = "cpu";
			compatible = "arm,cortex-a76";
			reg = <0x700>;
			enable-method = "psci";
			capacity-dmips-mhz = <0x400>;
			clocks = <0x0a 0x03>;
			cpu-idle-states = <0x0b>;
			i-cache-size = <0x10000>;
			i-cache-line-size = <0x40>;
			i-cache-sets = <0x100>;
			d-cache-size = <0x10000>;
			d-cache-line-size = <0x40>;
			d-cache-sets = <0x100>;
			next-level-cache = <0x19>;
			dynamic-power-coefficient = <0x1a0>;
			#cooling-cells = <0x02>;
			operating-points-v2 = <0x17>;
			cpu-supply = <0x18>;
			phandle = <0x09>;
		};

		idle-states {
			entry-method = "psci";

			cpu-sleep {
				compatible = "arm,idle-state";
				local-timer-stop;
				arm,psci-suspend-param = <0x10000>;
				entry-latency-us = <0x64>;
				exit-latency-us = <0x78>;
				min-residency-us = <0x3e8>;
				phandle = <0x0b>;
			};
		};

		l2-cache-l0 {
			compatible = "cache";
			cache-size = <0x20000>;
			cache-line-size = <0x40>;
			cache-sets = <0x200>;
			cache-level = <0x02>;
			cache-unified;
			next-level-cache = <0x1a>;
			phandle = <0x0c>;
		};

		l2-cache-l1 {
			compatible = "cache";
			cache-size = <0x20000>;
			cache-line-size = <0x40>;
			cache-sets = <0x200>;
			cache-level = <0x02>;
			cache-unified;
			next-level-cache = <0x1a>;
			phandle = <0x0f>;
		};

		l2-cache-l2 {
			compatible = "cache";
			cache-size = <0x20000>;
			cache-line-size = <0x40>;
			cache-sets = <0x200>;
			cache-level = <0x02>;
			cache-unified;
			next-level-cache = <0x1a>;
			phandle = <0x10>;
		};

		l2-cache-l3 {
			compatible = "cache";
			cache-size = <0x20000>;
			cache-line-size = <0x40>;
			cache-sets = <0x200>;
			cache-level = <0x02>;
			cache-unified;
			next-level-cache = <0x1a>;
			phandle = <0x11>;
		};

		l2-cache-b0 {
			compatible = "cache";
			cache-size = <0x80000>;
			cache-line-size = <0x40>;
			cache-sets = <0x400>;
			cache-level = <0x02>;
			cache-unified;
			next-level-cache = <0x1a>;
			phandle = <0x12>;
		};

		l2-cache-b1 {
			compatible = "cache";
			cache-size = <0x80000>;
			cache-line-size = <0x40>;
			cache-sets = <0x400>;
			cache-level = <0x02>;
			cache-unified;
			next-level-cache = <0x1a>;
			phandle = <0x15>;
		};

		l2-cache-b2 {
			compatible = "cache";
			cache-size = <0x80000>;
			cache-line-size = <0x40>;
			cache-sets = <0x400>;
			cache-level = <0x02>;
			cache-unified;
			next-level-cache = <0x1a>;
			phandle = <0x16>;
		};

		l2-cache-b3 {
			compatible = "cache";
			cache-size = <0x80000>;
			cache-line-size = <0x40>;
			cache-sets = <0x400>;
			cache-level = <0x02>;
			cache-unified;
			next-level-cache = <0x1a>;
			phandle = <0x19>;
		};
	};

	l3-cache {
		compatible = "cache";
		cache-size = <0x300000>;
		cache-line-size = <0x40>;
		cache-sets = <0x1000>;
		cache-level = <0x03>;
		cache-unified;
		phandle = <0x1a>;
	};

	display-subsystem {
		compatible = "rockchip,display-subsystem";
		ports = <0x1b>;
	};

	firmware {

		optee {
			compatible = "linaro,optee-tz";
			method = "smc";
		};

		scmi {
			compatible = "arm,scmi-smc";
			arm,smc-id = <0x82000010>;
			shmem = <0x1c>;
			#address-cells = <0x01>;
			#size-cells = <0x00>;

			protocol@14 {
				reg = <0x14>;
				#clock-cells = <0x01>;
				phandle = <0x0a>;
			};

			protocol@16 {
				reg = <0x16>;
				#reset-cells = <0x01>;
			};
		};
	};

	pmu-a55 {
		compatible = "arm,cortex-a55-pmu";
		interrupts = <0x01 0x07 0x04 0x1d>;
	};

	pmu-a76 {
		compatible = "arm,cortex-a76-pmu";
		interrupts = <0x01 0x07 0x04 0x1e>;
	};

	psci {
		compatible = "arm,psci-1.0";
		method = "smc";
	};

	clock-0 {
		compatible = "fixed-clock";
		clock-frequency = <0x29d7ab80>;
		clock-output-names = "spll";
		#clock-cells = <0x00>;
	};

	timer {
		compatible = "arm,armv8-timer";
		interrupts = <0x01 0x0d 0x04 0x00 0x01 0x0e 0x04 0x00 0x01 0x0b 0x04 0x00 0x01 0x0a 0x04 0x00 0x01 0x0c 0x04 0x00>;
		interrupt-names = "sec-phys\0phys\0virt\0hyp-phys\0hyp-virt";
	};

	clock-1 {
		compatible = "fixed-clock";
		clock-frequency = <0x16e3600>;
		clock-output-names = "xin24m";
		#clock-cells = <0x00>;
	};

	clock-2 {
		compatible = "fixed-clock";
		clock-frequency = <0x8000>;
		clock-output-names = "xin32k";
		#clock-cells = <0x00>;
	};

	sram@10f000 {
		compatible = "mmio-sram";
		reg = <0x00 0x10f000 0x00 0x100>;
		ranges = <0x00 0x00 0x10f000 0x100>;
		#address-cells = <0x01>;
		#size-cells = <0x01>;

		sram@0 {
			compatible = "arm,scmi-shmem";
			reg = <0x00 0x100>;
			phandle = <0x1c>;
		};
	};

	gpu@fb000000 {
		compatible = "rockchip,rk3588-mali\0arm,mali-valhall-csf";
		reg = <0x00 0xfb000000 0x00 0x200000>;
		#cooling-cells = <0x02>;
		assigned-clocks = <0x0a 0x05>;
		assigned-clock-rates = <0xbebc200>;
		clocks = <0x1f 0x106 0x1f 0x107 0x1f 0x108>;
		clock-names = "core\0coregroup\0stacks";
		dynamic-power-coefficient = <0xba6>;
		interrupts = <0x00 0x5c 0x04 0x00 0x00 0x5d 0x04 0x00 0x00 0x5e 0x04 0x00>;
		interrupt-names = "job\0mmu\0gpu";
		power-domains = <0x20 0x0c>;
		status = "disabled";
		operating-points-v2 = <0x21>;
		phandle = <0xd6>;
	};

	usb@fc000000 {
		compatible = "rockchip,rk3588-dwc3\0snps,dwc3";
		reg = <0x00 0xfc000000 0x00 0x400000>;
		interrupts = <0x00 0xdc 0x04 0x00>;
		clocks = <0x1f 0x194 0x1f 0x193 0x1f 0x192>;
		clock-names = "ref_clk\0suspend_clk\0bus_clk";
		dr_mode = "host";
		phys = <0x22 0x23 0x04>;
		phy-names = "usb2-phy\0usb3-phy";
		phy_type = "utmi_wide";
		power-domains = <0x20 0x1f>;
		resets = <0x1f 0x152>;
		snps,dis_enblslpm_quirk;
		snps,dis-u1-entry-quirk;
		snps,dis-u2-entry-quirk;
		snps,dis-u2-freeclk-exists-quirk;
		snps,dis-del-phy-power-chg-quirk;
		snps,dis-tx-ipgap-linecheck-quirk;
		status = "okay";
	};

	usb@fc800000 {
		compatible = "rockchip,rk3588-ehci\0generic-ehci";
		reg = <0x00 0xfc800000 0x00 0x40000>;
		interrupts = <0x00 0xd7 0x04 0x00>;
		clocks = <0x1f 0x18e 0x1f 0x18f 0x1f 0x2c0 0x24>;
		phys = <0x25>;
		phy-names = "usb";
		power-domains = <0x20 0x1f>;
		status = "okay";
	};

	usb@fc840000 {
		compatible = "rockchip,rk3588-ohci\0generic-ohci";
		reg = <0x00 0xfc840000 0x00 0x40000>;
		interrupts = <0x00 0xd8 0x04 0x00>;
		clocks = <0x1f 0x18e 0x1f 0x18f 0x1f 0x2c0 0x24>;
		phys = <0x25>;
		phy-names = "usb";
		power-domains = <0x20 0x1f>;
		status = "okay";
	};

	usb@fc880000 {
		compatible = "rockchip,rk3588-ehci\0generic-ehci";
		reg = <0x00 0xfc880000 0x00 0x40000>;
		interrupts = <0x00 0xda 0x04 0x00>;
		clocks = <0x1f 0x190 0x1f 0x191 0x1f 0x2c0 0x26>;
		phys = <0x27>;
		phy-names = "usb";
		power-domains = <0x20 0x1f>;
		status = "okay";
	};

	usb@fc8c0000 {
		compatible = "rockchip,rk3588-ohci\0generic-ohci";
		reg = <0x00 0xfc8c0000 0x00 0x40000>;
		interrupts = <0x00 0xdb 0x04 0x00>;
		clocks = <0x1f 0x190 0x1f 0x191 0x1f 0x2c0 0x26>;
		phys = <0x27>;
		phy-names = "usb";
		power-domains = <0x20 0x1f>;
		status = "okay";
	};

	usb@fcd00000 {
		compatible = "rockchip,rk3588-dwc3\0snps,dwc3";
		reg = <0x00 0xfcd00000 0x00 0x400000>;
		interrupts = <0x00 0xde 0x04 0x00>;
		clocks = <0x1f 0x16a 0x1f 0x169 0x1f 0x168 0x1f 0x16b 0x1f 0x172>;
		clock-names = "ref_clk\0suspend_clk\0bus_clk\0utmi\0pipe";
		dr_mode = "host";
		phys = <0x28 0x04>;
		phy-names = "usb3-phy";
		phy_type = "utmi_wide";
		resets = <0x1f 0x134>;
		snps,dis_enblslpm_quirk;
		snps,dis-u2-freeclk-exists-quirk;
		snps,dis-del-phy-power-chg-quirk;
		snps,dis-tx-ipgap-linecheck-quirk;
		snps,dis_rxdet_inp3_quirk;
		status = "okay";
	};

	iommu@fc900000 {
		compatible = "arm,smmu-v3";
		reg = <0x00 0xfc900000 0x00 0x200000>;
		interrupts = <0x00 0x171 0x01 0x00 0x00 0x173 0x01 0x00 0x00 0x176 0x01 0x00 0x00 0x16f 0x01 0x00>;
		interrupt-names = "eventq\0gerror\0priq\0cmdq-sync";
		#iommu-cells = <0x01>;
		status = "disabled";
	};

	iommu@fcb00000 {
		compatible = "arm,smmu-v3";
		reg = <0x00 0xfcb00000 0x00 0x200000>;
		interrupts = <0x00 0x17d 0x01 0x00 0x00 0x17f 0x01 0x00 0x00 0x182 0x01 0x00 0x00 0x17b 0x01 0x00>;
		interrupt-names = "eventq\0gerror\0priq\0cmdq-sync";
		#iommu-cells = <0x01>;
		status = "disabled";
	};

	syscon@fd58a000 {
		compatible = "rockchip,rk3588-pmugrf\0syscon\0simple-mfd";
		reg = <0x00 0xfd58a000 0x00 0x10000>;
		phandle = <0x6d>;
	};

	syscon@fd58c000 {
		compatible = "rockchip,rk3588-sys-grf\0syscon";
		reg = <0x00 0xfd58c000 0x00 0x1000>;
		phandle = <0x68>;
	};

	syscon@fd5a4000 {
		compatible = "rockchip,rk3588-vop-grf\0syscon";
		reg = <0x00 0xfd5a4000 0x00 0x2000>;
		phandle = <0x69>;
	};

	syscon@fd5a6000 {
		compatible = "rockchip,rk3588-vo0-grf\0syscon";
		reg = <0x00 0xfd5a6000 0x00 0x2000>;
		clocks = <0x1f 0x1e9>;
		phandle = <0xe6>;
	};

	syscon@fd5a8000 {
		compatible = "rockchip,rk3588-vo1-grf\0syscon";
		reg = <0x00 0xfd5a8000 0x00 0x4000>;
		clocks = <0x1f 0x2d1>;
		phandle = <0x6a>;
	};

	syscon@fd5ac000 {
		compatible = "rockchip,rk3588-usb-grf\0syscon";
		reg = <0x00 0xfd5ac000 0x00 0x4000>;
		phandle = <0xe4>;
	};

	syscon@fd5b0000 {
		compatible = "rockchip,rk3588-php-grf\0syscon";
		reg = <0x00 0xfd5b0000 0x00 0x1000>;
		phandle = <0x2a>;
	};

	syscon@fd5bc000 {
		compatible = "rockchip,rk3588-pipe-phy-grf\0syscon";
		reg = <0x00 0xfd5bc000 0x00 0x100>;
		phandle = <0xe7>;
	};

	syscon@fd5c4000 {
		compatible = "rockchip,rk3588-pipe-phy-grf\0syscon";
		reg = <0x00 0xfd5c4000 0x00 0x100>;
		phandle = <0xe8>;
	};

	syscon@fd5c8000 {
		compatible = "rockchip,rk3588-usbdpphy-grf\0syscon";
		reg = <0x00 0xfd5c8000 0x00 0x4000>;
		phandle = <0xe5>;
	};

	syscon@fd5d0000 {
		compatible = "rockchip,rk3588-usb2phy-grf\0syscon\0simple-mfd";
		reg = <0x00 0xfd5d0000 0x00 0x4000>;
		#address-cells = <0x01>;
		#size-cells = <0x01>;
		phandle = <0xe3>;

		usb2phy@0 {
			compatible = "rockchip,rk3588-usb2phy";
			reg = <0x00 0x10>;
			#clock-cells = <0x00>;
			clocks = <0x1f 0x2a0>;
			clock-names = "phyclk";
			clock-output-names = "usb480m_phy0";
			interrupts = <0x00 0x189 0x04 0x00>;
			resets = <0x1f 0x26d 0x1f 0x21d>;
			reset-names = "phy\0apb";
			status = "okay";
			phandle = <0xe2>;

			otg-port {
				#phy-cells = <0x00>;
				status = "okay";
				phandle = <0x22>;
			};
		};
	};

	syscon@fd5d8000 {
		compatible = "rockchip,rk3588-usb2phy-grf\0syscon\0simple-mfd";
		reg = <0x00 0xfd5d8000 0x00 0x4000>;
		#address-cells = <0x01>;
		#size-cells = <0x01>;

		usb2phy@8000 {
			compatible = "rockchip,rk3588-usb2phy";
			reg = <0x8000 0x10>;
			#clock-cells = <0x00>;
			clocks = <0x1f 0x2a0>;
			clock-names = "phyclk";
			clock-output-names = "usb480m_phy2";
			interrupts = <0x00 0x187 0x04 0x00>;
			resets = <0x1f 0x26f 0x1f 0x21f>;
			reset-names = "phy\0apb";
			status = "okay";
			phandle = <0x24>;

			host-port {
				#phy-cells = <0x00>;
				status = "okay";
				phy-supply = <0x29>;
				phandle = <0x25>;
			};
		};
	};

	syscon@fd5dc000 {
		compatible = "rockchip,rk3588-usb2phy-grf\0syscon\0simple-mfd";
		reg = <0x00 0xfd5dc000 0x00 0x4000>;
		#address-cells = <0x01>;
		#size-cells = <0x01>;

		usb2phy@c000 {
			compatible = "rockchip,rk3588-usb2phy";
			reg = <0xc000 0x10>;
			#clock-cells = <0x00>;
			clocks = <0x1f 0x2a0>;
			clock-names = "phyclk";
			clock-output-names = "usb480m_phy3";
			interrupts = <0x00 0x188 0x04 0x00>;
			resets = <0x1f 0x270 0x1f 0x220>;
			reset-names = "phy\0apb";
			status = "okay";
			phandle = <0x26>;

			host-port {
				#phy-cells = <0x00>;
				status = "okay";
				phy-supply = <0x29>;
				phandle = <0x27>;
			};
		};
	};

	syscon@fd5e0000 {
		compatible = "rockchip,rk3588-hdptxphy-grf\0syscon";
		reg = <0x00 0xfd5e0000 0x00 0x100>;
		phandle = <0xe1>;
	};

	syscon@fd5f0000 {
		compatible = "rockchip,rk3588-ioc\0syscon";
		reg = <0x00 0xfd5f0000 0x00 0x10000>;
		phandle = <0xe9>;
	};

	sram@fd600000 {
		compatible = "mmio-sram";
		reg = <0x00 0xfd600000 0x00 0x100000>;
		ranges = <0x00 0x00 0xfd600000 0x100000>;
		#address-cells = <0x01>;
		#size-cells = <0x01>;
	};

	clock-controller@fd7c0000 {
		compatible = "rockchip,rk3588-cru";
		reg = <0x00 0xfd7c0000 0x00 0x5c000>;
		assigned-clocks = <0x1f 0x08 0x1f 0x04 0x1f 0x07 0x1f 0x06 0x1f 0xcc 0x1f 0xce 0x1f 0xcd 0x1f 0x100 0x1f 0x101 0x1f 0x102 0x1f 0x286 0x1f 0x287 0x1f 0x25d 0x1f 0x71 0x1f 0xe0 0x1f 0x106>;
		assigned-clock-rates = <0x4190ab00 0x2ee00000 0x32a9f880 0x46cf7100 0x29d7ab80 0x17d78400 0x1dcd6500 0x2faf0800 0x5f5e100 0x17d78400 0x5f5e100 0xbebc200 0x1dcd6500 0x165a0bc0 0x8f0d180 0xbebc200>;
		rockchip,grf = <0x2a>;
		#clock-cells = <0x01>;
		#reset-cells = <0x01>;
		phandle = <0x1f>;
	};

	i2c@fd880000 {
		compatible = "rockchip,rk3588-i2c\0rockchip,rk3399-i2c";
		reg = <0x00 0xfd880000 0x00 0x1000>;
		interrupts = <0x00 0x13d 0x04 0x00>;
		clocks = <0x1f 0x274 0x1f 0x273>;
		clock-names = "i2c\0pclk";
		pinctrl-0 = <0x2b>;
		pinctrl-names = "default";
		#address-cells = <0x01>;
		#size-cells = <0x00>;
		status = "okay";

		regulator@42 {
			compatible = "rockchip,rk8602";
			reg = <0x42>;
			fcs,suspend-voltage-selector = <0x01>;
			regulator-name = "vdd_cpu_big0_s0";
			regulator-always-on;
			regulator-boot-on;
			regulator-min-microvolt = <0x86470>;
			regulator-max-microvolt = <0x100590>;
			regulator-ramp-delay = <0x8fc>;
			vin-supply = <0x2c>;
			phandle = <0x14>;

			regulator-state-mem {
				regulator-off-in-suspend;
			};
		};

		regulator@43 {
			compatible = "rockchip,rk8603\0rockchip,rk8602";
			reg = <0x43>;
			fcs,suspend-voltage-selector = <0x01>;
			regulator-name = "vdd_cpu_big1_s0";
			regulator-always-on;
			regulator-boot-on;
			regulator-min-microvolt = <0x86470>;
			regulator-max-microvolt = <0x100590>;
			regulator-ramp-delay = <0x8fc>;
			vin-supply = <0x2c>;
			phandle = <0x18>;

			regulator-state-mem {
				regulator-off-in-suspend;
			};
		};
	};

	serial@fd890000 {
		compatible = "rockchip,rk3588-uart\0snps,dw-apb-uart";
		reg = <0x00 0xfd890000 0x00 0x100>;
		interrupts = <0x00 0x14b 0x04 0x00>;
		clocks = <0x1f 0x29b 0x1f 0x29c>;
		clock-names = "baudclk\0apb_pclk";
		dmas = <0x2d 0x06 0x2d 0x07>;
		dma-names = "tx\0rx";
		pinctrl-0 = <0x2e>;
		pinctrl-names = "default";
		reg-shift = <0x02>;
		reg-io-width = <0x04>;
		status = "disabled";
	};

	pwm@fd8b0000 {
		compatible = "rockchip,rk3588-pwm\0rockchip,rk3328-pwm";
		reg = <0x00 0xfd8b0000 0x00 0x10>;
		clocks = <0x1f 0x292 0x1f 0x291>;
		clock-names = "pwm\0pclk";
		pinctrl-0 = <0x2f>;
		pinctrl-names = "default";
		#pwm-cells = <0x03>;
		status = "disabled";
	};

	pwm@fd8b0010 {
		compatible = "rockchip,rk3588-pwm\0rockchip,rk3328-pwm";
		reg = <0x00 0xfd8b0010 0x00 0x10>;
		clocks = <0x1f 0x292 0x1f 0x291>;
		clock-names = "pwm\0pclk";
		pinctrl-0 = <0x30>;
		pinctrl-names = "default";
		#pwm-cells = <0x03>;
		status = "disabled";
	};

	pwm@fd8b0020 {
		compatible = "rockchip,rk3588-pwm\0rockchip,rk3328-pwm";
		reg = <0x00 0xfd8b0020 0x00 0x10>;
		clocks = <0x1f 0x292 0x1f 0x291>;
		clock-names = "pwm\0pclk";
		pinctrl-0 = <0x31>;
		pinctrl-names = "default";
		#pwm-cells = <0x03>;
		status = "disabled";
	};

	pwm@fd8b0030 {
		compatible = "rockchip,rk3588-pwm\0rockchip,rk3328-pwm";
		reg = <0x00 0xfd8b0030 0x00 0x10>;
		clocks = <0x1f 0x292 0x1f 0x291>;
		clock-names = "pwm\0pclk";
		pinctrl-0 = <0x32>;
		pinctrl-names = "default";
		#pwm-cells = <0x03>;
		status = "okay";
		phandle = <0xf5>;
	};

	power-management@fd8d8000 {
		compatible = "rockchip,rk3588-pmu\0syscon\0simple-mfd";
		reg = <0x00 0xfd8d8000 0x00 0x400>;
		phandle = <0x6b>;

		power-controller {
			compatible = "rockchip,rk3588-power-controller";
			#address-cells = <0x01>;
			#power-domain-cells = <0x01>;
			#size-cells = <0x00>;
			status = "okay";
			phandle = <0x20>;

			power-domain@8 {
				reg = <0x08>;
				#power-domain-cells = <0x00>;
				#address-cells = <0x01>;
				#size-cells = <0x00>;

				power-domain@9 {
					reg = <0x09>;
					clocks = <0x1f 0x121 0x1f 0x123 0x1f 0x122 0x1f 0x118>;
					pm_qos = <0x33 0x34 0x35>;
					#power-domain-cells = <0x00>;
					#address-cells = <0x01>;
					#size-cells = <0x00>;

					power-domain@10 {
						reg = <0x0a>;
						clocks = <0x1f 0x121 0x1f 0x123 0x1f 0x122>;
						pm_qos = <0x36>;
						#power-domain-cells = <0x00>;
					};

					power-domain@11 {
						reg = <0x0b>;
						clocks = <0x1f 0x121 0x1f 0x123 0x1f 0x122>;
						pm_qos = <0x37>;
						#power-domain-cells = <0x00>;
					};
				};
			};

			power-domain@12 {
				reg = <0x0c>;
				clocks = <0x1f 0x106 0x1f 0x107 0x1f 0x108>;
				pm_qos = <0x38 0x39 0x3a 0x3b>;
				#power-domain-cells = <0x00>;
			};

			power-domain@13 {
				reg = <0x0d>;
				#address-cells = <0x01>;
				#size-cells = <0x00>;
				#power-domain-cells = <0x00>;

				power-domain@14 {
					reg = <0x0e>;
					clocks = <0x1f 0x180 0x1f 0x1af 0x1f 0x1ad 0x1f 0x181 0x1f 0x17f>;
					pm_qos = <0x3c>;
					#power-domain-cells = <0x00>;
				};

				power-domain@15 {
					reg = <0x0f>;
					clocks = <0x1f 0x185 0x1f 0x1af 0x1f 0x1ad 0x1f 0x186>;
					pm_qos = <0x3d>;
					#power-domain-cells = <0x00>;
				};

				power-domain@16 {
					reg = <0x10>;
					clocks = <0x1f 0x1b5 0x1f 0x1b6>;
					pm_qos = <0x3e 0x3f 0x40>;
					#address-cells = <0x01>;
					#size-cells = <0x00>;
					#power-domain-cells = <0x00>;

					power-domain@17 {
						reg = <0x11>;
						clocks = <0x1f 0x1ba 0x1f 0x1b5 0x1f 0x1b6 0x1f 0x1bb>;
						pm_qos = <0x41 0x42 0x43>;
						#power-domain-cells = <0x00>;
					};
				};
			};

			power-domain@21 {
				reg = <0x15>;
				clocks = <0x1f 0x1af 0x1f 0x1ae 0x1f 0x1ad 0x1f 0x1b0 0x1f 0x19b 0x1f 0x19a 0x1f 0x19d 0x1f 0x19e 0x1f 0x19f 0x1f 0x1a0 0x1f 0x1a1 0x1f 0x1a2 0x1f 0x1a3 0x1f 0x1a4 0x1f 0x1a5 0x1f 0x1a6 0x1f 0x1a8 0x1f 0x1a7>;
				pm_qos = <0x44 0x45 0x46 0x47 0x48 0x49 0x4a 0x4b>;
				#address-cells = <0x01>;
				#size-cells = <0x00>;
				#power-domain-cells = <0x00>;

				power-domain@23 {
					reg = <0x17>;
					clocks = <0x1f 0x43 0x1f 0x41 0x1f 0x1af>;
					pm_qos = <0x4c>;
					#power-domain-cells = <0x00>;
				};

				power-domain@14 {
					reg = <0x0e>;
					clocks = <0x1f 0x180 0x1f 0x1af 0x1f 0x1ad 0x1f 0x181>;
					pm_qos = <0x3c>;
					#power-domain-cells = <0x00>;
				};

				power-domain@15 {
					reg = <0x0f>;
					clocks = <0x1f 0x185 0x1f 0x1af 0x1f 0x1ad>;
					pm_qos = <0x3d>;
					#power-domain-cells = <0x00>;
				};

				power-domain@22 {
					reg = <0x16>;
					clocks = <0x1f 0x1ab 0x1f 0x1aa>;
					pm_qos = <0x4d>;
					#power-domain-cells = <0x00>;
				};
			};

			power-domain@24 {
				reg = <0x18>;
				clocks = <0x1f 0x25b 0x1f 0x25a 0x1f 0x25d>;
				pm_qos = <0x4e 0x4f>;
				#address-cells = <0x01>;
				#size-cells = <0x00>;
				#power-domain-cells = <0x00>;

				power-domain@25 {
					reg = <0x19>;
					clocks = <0x1f 0x1e7 0x1f 0x1e8 0x1f 0x1e6 0x1f 0x1e4 0x1f 0x1df 0x1f 0x1de 0x1f 0x25a>;
					pm_qos = <0x50>;
					#power-domain-cells = <0x00>;
				};
			};

			power-domain@26 {
				reg = <0x1a>;
				clocks = <0x1f 0x21d 0x1f 0x21e 0x1f 0x21c 0x1f 0x207 0x1f 0x206 0x1f 0x21a 0x1f 0x251>;
				pm_qos = <0x51 0x52>;
				#power-domain-cells = <0x00>;
			};

			power-domain@27 {
				reg = <0x1b>;
				clocks = <0x1f 0x1d2 0x1f 0x1d3 0x1f 0x1d0 0x1f 0x1cf 0x1f 0x1d6 0x1f 0x1d5>;
				pm_qos = <0x53 0x54 0x55 0x56>;
				#address-cells = <0x01>;
				#size-cells = <0x00>;
				#power-domain-cells = <0x00>;

				power-domain@28 {
					reg = <0x1c>;
					clocks = <0x1f 0x113 0x1f 0x112 0x1f 0x1d2 0x1f 0x1d3>;
					pm_qos = <0x57 0x58>;
					#power-domain-cells = <0x00>;
				};

				power-domain@29 {
					reg = <0x1d>;
					clocks = <0x1f 0x1c7 0x1f 0x1c6 0x1f 0x1ca 0x1f 0x1c9 0x1f 0x1d3>;
					pm_qos = <0x59 0x5a>;
					#power-domain-cells = <0x00>;
				};
			};

			power-domain@30 {
				reg = <0x1e>;
				clocks = <0x1f 0x17a 0x1f 0x17b>;
				pm_qos = <0x5b>;
				#power-domain-cells = <0x00>;
			};

			power-domain@31 {
				reg = <0x1f>;
				clocks = <0x1f 0x157 0x1f 0x18c 0x1f 0x2c0 0x1f 0x18d 0x1f 0x18e 0x1f 0x18f 0x1f 0x190 0x1f 0x191>;
				pm_qos = <0x5c 0x5d 0x5e 0x5f>;
				#power-domain-cells = <0x00>;
			};

			power-domain@33 {
				reg = <0x21>;
				clocks = <0x1f 0x157 0x1f 0x15a 0x1f 0x15b>;
				#power-domain-cells = <0x00>;
			};

			power-domain@34 {
				reg = <0x22>;
				clocks = <0x1f 0x157 0x1f 0x15a 0x1f 0x15b>;
				#power-domain-cells = <0x00>;
			};

			power-domain@37 {
				reg = <0x25>;
				clocks = <0x1f 0x18a 0x1f 0x132>;
				pm_qos = <0x60>;
				#power-domain-cells = <0x00>;
			};

			power-domain@38 {
				reg = <0x26>;
				clocks = <0x1f 0x34 0x1f 0x35>;
				#power-domain-cells = <0x00>;
			};

			power-domain@40 {
				reg = <0x28>;
				pm_qos = <0x61>;
				#power-domain-cells = <0x00>;
			};
		};
	};

	video-codec@fdb50000 {
		compatible = "rockchip,rk3588-vpu121\0rockchip,rk3568-vpu";
		reg = <0x00 0xfdb50000 0x00 0x800>;
		interrupts = <0x00 0x77 0x04 0x00>;
		interrupt-names = "vdpu";
		clocks = <0x1f 0x1b1 0x1f 0x1b2>;
		clock-names = "aclk\0hclk";
		iommus = <0x62>;
		power-domains = <0x20 0x15>;
	};

	iommu@fdb50800 {
		compatible = "rockchip,rk3588-iommu\0rockchip,rk3568-iommu";
		reg = <0x00 0xfdb50800 0x00 0x40>;
		interrupts = <0x00 0x76 0x04 0x00>;
		clock-names = "aclk\0iface";
		clocks = <0x1f 0x1b1 0x1f 0x1b2>;
		power-domains = <0x20 0x15>;
		#iommu-cells = <0x00>;
		phandle = <0x62>;
	};

	rga@fdb80000 {
		compatible = "rockchip,rk3588-rga\0rockchip,rk3288-rga";
		reg = <0x00 0xfdb80000 0x00 0x180>;
		interrupts = <0x00 0x74 0x04 0x00>;
		clocks = <0x1f 0x1a8 0x1f 0x1a7 0x1f 0x1a9>;
		clock-names = "aclk\0hclk\0sclk";
		resets = <0x1f 0x172 0x1f 0x171 0x1f 0x170>;
		reset-names = "core\0axi\0ahb";
		power-domains = <0x20 0x15>;
	};

	video-codec@fdba0000 {
		compatible = "rockchip,rk3588-vepu121";
		reg = <0x00 0xfdba0000 0x00 0x800>;
		interrupts = <0x00 0x7a 0x04 0x00>;
		clocks = <0x1f 0x19d 0x1f 0x19e>;
		clock-names = "aclk\0hclk";
		iommus = <0x63>;
		power-domains = <0x20 0x15>;
	};

	iommu@fdba0800 {
		compatible = "rockchip,rk3588-iommu\0rockchip,rk3568-iommu";
		reg = <0x00 0xfdba0800 0x00 0x40>;
		interrupts = <0x00 0x79 0x04 0x00>;
		clocks = <0x1f 0x19d 0x1f 0x19e>;
		clock-names = "aclk\0iface";
		power-domains = <0x20 0x15>;
		#iommu-cells = <0x00>;
		phandle = <0x63>;
	};

	video-codec@fdba4000 {
		compatible = "rockchip,rk3588-vepu121";
		reg = <0x00 0xfdba4000 0x00 0x800>;
		interrupts = <0x00 0x7c 0x04 0x00>;
		clocks = <0x1f 0x19f 0x1f 0x1a0>;
		clock-names = "aclk\0hclk";
		iommus = <0x64>;
		power-domains = <0x20 0x15>;
	};

	iommu@fdba4800 {
		compatible = "rockchip,rk3588-iommu\0rockchip,rk3568-iommu";
		reg = <0x00 0xfdba4800 0x00 0x40>;
		interrupts = <0x00 0x7b 0x04 0x00>;
		clocks = <0x1f 0x19f 0x1f 0x1a0>;
		clock-names = "aclk\0iface";
		power-domains = <0x20 0x15>;
		#iommu-cells = <0x00>;
		phandle = <0x64>;
	};

	video-codec@fdba8000 {
		compatible = "rockchip,rk3588-vepu121";
		reg = <0x00 0xfdba8000 0x00 0x800>;
		interrupts = <0x00 0x7e 0x04 0x00>;
		clocks = <0x1f 0x1a1 0x1f 0x1a2>;
		clock-names = "aclk\0hclk";
		iommus = <0x65>;
		power-domains = <0x20 0x15>;
	};

	iommu@fdba8800 {
		compatible = "rockchip,rk3588-iommu\0rockchip,rk3568-iommu";
		reg = <0x00 0xfdba8800 0x00 0x40>;
		interrupts = <0x00 0x7d 0x04 0x00>;
		clocks = <0x1f 0x1a1 0x1f 0x1a2>;
		clock-names = "aclk\0iface";
		power-domains = <0x20 0x15>;
		#iommu-cells = <0x00>;
		phandle = <0x65>;
	};

	video-codec@fdbac000 {
		compatible = "rockchip,rk3588-vepu121";
		reg = <0x00 0xfdbac000 0x00 0x800>;
		interrupts = <0x00 0x80 0x04 0x00>;
		clocks = <0x1f 0x1a3 0x1f 0x1a4>;
		clock-names = "aclk\0hclk";
		iommus = <0x66>;
		power-domains = <0x20 0x15>;
	};

	iommu@fdbac800 {
		compatible = "rockchip,rk3588-iommu\0rockchip,rk3568-iommu";
		reg = <0x00 0xfdbac800 0x00 0x40>;
		interrupts = <0x00 0x7f 0x04 0x00>;
		clocks = <0x1f 0x1a3 0x1f 0x1a4>;
		clock-names = "aclk\0iface";
		power-domains = <0x20 0x15>;
		#iommu-cells = <0x00>;
		phandle = <0x66>;
	};

	video-codec@fdc70000 {
		compatible = "rockchip,rk3588-av1-vpu";
		reg = <0x00 0xfdc70000 0x00 0x800>;
		interrupts = <0x00 0x6c 0x04 0x00>;
		interrupt-names = "vdpu";
		assigned-clocks = <0x1f 0x41 0x1f 0x43>;
		assigned-clock-rates = <0x17d78400 0x17d78400>;
		clocks = <0x1f 0x41 0x1f 0x43>;
		clock-names = "aclk\0hclk";
		power-domains = <0x20 0x17>;
		resets = <0x1f 0x1fe 0x1f 0x200 0x1f 0x1fd 0x1f 0x1ff>;
	};

	vop@fdd90000 {
		compatible = "rockchip,rk3588-vop";
		reg = <0x00 0xfdd90000 0x00 0x4200 0x00 0xfdd95000 0x00 0x1000>;
		reg-names = "vop\0gamma-lut";
		interrupts = <0x00 0x9c 0x04 0x00>;
		clocks = <0x1f 0x25d 0x1f 0x25c 0x1f 0x261 0x1f 0x262 0x1f 0x263 0x1f 0x264 0x1f 0x25b>;
		clock-names = "aclk\0hclk\0dclk_vp0\0dclk_vp1\0dclk_vp2\0dclk_vp3\0pclk_vop";
		iommus = <0x67>;
		power-domains = <0x20 0x18>;
		rockchip,grf = <0x68>;
		rockchip,vop-grf = <0x69>;
		rockchip,vo1-grf = <0x6a>;
		rockchip,pmu = <0x6b>;
		status = "disabled";

		ports {
			#address-cells = <0x01>;
			#size-cells = <0x00>;
			phandle = <0x1b>;

			port@0 {
				#address-cells = <0x01>;
				#size-cells = <0x00>;
				reg = <0x00>;
			};

			port@1 {
				#address-cells = <0x01>;
				#size-cells = <0x00>;
				reg = <0x01>;
			};

			port@2 {
				#address-cells = <0x01>;
				#size-cells = <0x00>;
				reg = <0x02>;
			};

			port@3 {
				#address-cells = <0x01>;
				#size-cells = <0x00>;
				reg = <0x03>;
			};
		};
	};

	iommu@fdd97e00 {
		compatible = "rockchip,rk3588-iommu\0rockchip,rk3568-iommu";
		reg = <0x00 0xfdd97e00 0x00 0x100 0x00 0xfdd97f00 0x00 0x100>;
		interrupts = <0x00 0x9c 0x04 0x00>;
		clocks = <0x1f 0x25d 0x1f 0x25c>;
		clock-names = "aclk\0iface";
		#iommu-cells = <0x00>;
		power-domains = <0x20 0x18>;
		status = "disabled";
		phandle = <0x67>;
	};

	i2s@fddc0000 {
		compatible = "rockchip,rk3588-i2s-tdm";
		reg = <0x00 0xfddc0000 0x00 0x1000>;
		interrupts = <0x00 0xb8 0x04 0x00>;
		clocks = <0x1f 0x1ec 0x1f 0x1ec 0x1f 0x1e1>;
		clock-names = "mclk_tx\0mclk_rx\0hclk";
		assigned-clocks = <0x1f 0x1ea>;
		assigned-clock-parents = <0x1f 0x04>;
		dmas = <0x6c 0x00>;
		dma-names = "tx";
		power-domains = <0x20 0x19>;
		resets = <0x1f 0x1b8>;
		reset-names = "tx-m";
		#sound-dai-cells = <0x00>;
		status = "disabled";
	};

	i2s@fddf0000 {
		compatible = "rockchip,rk3588-i2s-tdm";
		reg = <0x00 0xfddf0000 0x00 0x1000>;
		interrupts = <0x00 0xb9 0x04 0x00>;
		clocks = <0x1f 0x234 0x1f 0x234 0x1f 0x235>;
		clock-names = "mclk_tx\0mclk_rx\0hclk";
		assigned-clocks = <0x1f 0x231>;
		assigned-clock-parents = <0x1f 0x04>;
		dmas = <0x6c 0x02>;
		dma-names = "tx";
		power-domains = <0x20 0x1a>;
		resets = <0x1f 0x1d8>;
		reset-names = "tx-m";
		#sound-dai-cells = <0x00>;
		status = "disabled";
	};

	i2s@fddfc000 {
		compatible = "rockchip,rk3588-i2s-tdm";
		reg = <0x00 0xfddfc000 0x00 0x1000>;
		interrupts = <0x00 0xbd 0x04 0x00>;
		clocks = <0x1f 0x230 0x1f 0x230 0x1f 0x22c>;
		clock-names = "mclk_tx\0mclk_rx\0hclk";
		assigned-clocks = <0x1f 0x22d>;
		assigned-clock-parents = <0x1f 0x04>;
		dmas = <0x6c 0x17>;
		dma-names = "rx";
		power-domains = <0x20 0x1a>;
		resets = <0x1f 0x1ec>;
		reset-names = "rx-m";
		#sound-dai-cells = <0x00>;
		status = "disabled";
	};

	qos@fdf35000 {
		compatible = "rockchip,rk3588-qos\0syscon";
		reg = <0x00 0xfdf35000 0x00 0x20>;
		phandle = <0x38>;
	};

	qos@fdf35200 {
		compatible = "rockchip,rk3588-qos\0syscon";
		reg = <0x00 0xfdf35200 0x00 0x20>;
		phandle = <0x39>;
	};

	qos@fdf35400 {
		compatible = "rockchip,rk3588-qos\0syscon";
		reg = <0x00 0xfdf35400 0x00 0x20>;
		phandle = <0x3a>;
	};

	qos@fdf35600 {
		compatible = "rockchip,rk3588-qos\0syscon";
		reg = <0x00 0xfdf35600 0x00 0x20>;
		phandle = <0x3b>;
	};

	qos@fdf36000 {
		compatible = "rockchip,rk3588-qos\0syscon";
		reg = <0x00 0xfdf36000 0x00 0x20>;
		phandle = <0x5b>;
	};

	qos@fdf39000 {
		compatible = "rockchip,rk3588-qos\0syscon";
		reg = <0x00 0xfdf39000 0x00 0x20>;
		phandle = <0x60>;
	};

	qos@fdf3d800 {
		compatible = "rockchip,rk3588-qos\0syscon";
		reg = <0x00 0xfdf3d800 0x00 0x20>;
		phandle = <0x61>;
	};

	qos@fdf3e000 {
		compatible = "rockchip,rk3588-qos\0syscon";
		reg = <0x00 0xfdf3e000 0x00 0x20>;
		phandle = <0x5d>;
	};

	qos@fdf3e200 {
		compatible = "rockchip,rk3588-qos\0syscon";
		reg = <0x00 0xfdf3e200 0x00 0x20>;
		phandle = <0x5c>;
	};

	qos@fdf3e400 {
		compatible = "rockchip,rk3588-qos\0syscon";
		reg = <0x00 0xfdf3e400 0x00 0x20>;
		phandle = <0x5e>;
	};

	qos@fdf3e600 {
		compatible = "rockchip,rk3588-qos\0syscon";
		reg = <0x00 0xfdf3e600 0x00 0x20>;
		phandle = <0x5f>;
	};

	qos@fdf40000 {
		compatible = "rockchip,rk3588-qos\0syscon";
		reg = <0x00 0xfdf40000 0x00 0x20>;
		phandle = <0x59>;
	};

	qos@fdf40200 {
		compatible = "rockchip,rk3588-qos\0syscon";
		reg = <0x00 0xfdf40200 0x00 0x20>;
		phandle = <0x5a>;
	};

	qos@fdf40400 {
		compatible = "rockchip,rk3588-qos\0syscon";
		reg = <0x00 0xfdf40400 0x00 0x20>;
		phandle = <0x53>;
	};

	qos@fdf40500 {
		compatible = "rockchip,rk3588-qos\0syscon";
		reg = <0x00 0xfdf40500 0x00 0x20>;
		phandle = <0x54>;
	};

	qos@fdf40600 {
		compatible = "rockchip,rk3588-qos\0syscon";
		reg = <0x00 0xfdf40600 0x00 0x20>;
		phandle = <0x55>;
	};

	qos@fdf40800 {
		compatible = "rockchip,rk3588-qos\0syscon";
		reg = <0x00 0xfdf40800 0x00 0x20>;
		phandle = <0x56>;
	};

	qos@fdf41000 {
		compatible = "rockchip,rk3588-qos\0syscon";
		reg = <0x00 0xfdf41000 0x00 0x20>;
		phandle = <0x57>;
	};

	qos@fdf41100 {
		compatible = "rockchip,rk3588-qos\0syscon";
		reg = <0x00 0xfdf41100 0x00 0x20>;
		phandle = <0x58>;
	};

	qos@fdf60000 {
		compatible = "rockchip,rk3588-qos\0syscon";
		reg = <0x00 0xfdf60000 0x00 0x20>;
		phandle = <0x3e>;
	};

	qos@fdf60200 {
		compatible = "rockchip,rk3588-qos\0syscon";
		reg = <0x00 0xfdf60200 0x00 0x20>;
		phandle = <0x3f>;
	};

	qos@fdf60400 {
		compatible = "rockchip,rk3588-qos\0syscon";
		reg = <0x00 0xfdf60400 0x00 0x20>;
		phandle = <0x40>;
	};

	qos@fdf61000 {
		compatible = "rockchip,rk3588-qos\0syscon";
		reg = <0x00 0xfdf61000 0x00 0x20>;
		phandle = <0x41>;
	};

	qos@fdf61200 {
		compatible = "rockchip,rk3588-qos\0syscon";
		reg = <0x00 0xfdf61200 0x00 0x20>;
		phandle = <0x42>;
	};

	qos@fdf61400 {
		compatible = "rockchip,rk3588-qos\0syscon";
		reg = <0x00 0xfdf61400 0x00 0x20>;
		phandle = <0x43>;
	};

	qos@fdf62000 {
		compatible = "rockchip,rk3588-qos\0syscon";
		reg = <0x00 0xfdf62000 0x00 0x20>;
		phandle = <0x3c>;
	};

	qos@fdf63000 {
		compatible = "rockchip,rk3588-qos\0syscon";
		reg = <0x00 0xfdf63000 0x00 0x20>;
		phandle = <0x3d>;
	};

	qos@fdf64000 {
		compatible = "rockchip,rk3588-qos\0syscon";
		reg = <0x00 0xfdf64000 0x00 0x20>;
		phandle = <0x4c>;
	};

	qos@fdf66000 {
		compatible = "rockchip,rk3588-qos\0syscon";
		reg = <0x00 0xfdf66000 0x00 0x20>;
		phandle = <0x44>;
	};

	qos@fdf66200 {
		compatible = "rockchip,rk3588-qos\0syscon";
		reg = <0x00 0xfdf66200 0x00 0x20>;
		phandle = <0x45>;
	};

	qos@fdf66400 {
		compatible = "rockchip,rk3588-qos\0syscon";
		reg = <0x00 0xfdf66400 0x00 0x20>;
		phandle = <0x46>;
	};

	qos@fdf66600 {
		compatible = "rockchip,rk3588-qos\0syscon";
		reg = <0x00 0xfdf66600 0x00 0x20>;
		phandle = <0x47>;
	};

	qos@fdf66800 {
		compatible = "rockchip,rk3588-qos\0syscon";
		reg = <0x00 0xfdf66800 0x00 0x20>;
		phandle = <0x48>;
	};

	qos@fdf66a00 {
		compatible = "rockchip,rk3588-qos\0syscon";
		reg = <0x00 0xfdf66a00 0x00 0x20>;
		phandle = <0x49>;
	};

	qos@fdf66c00 {
		compatible = "rockchip,rk3588-qos\0syscon";
		reg = <0x00 0xfdf66c00 0x00 0x20>;
		phandle = <0x4a>;
	};

	qos@fdf66e00 {
		compatible = "rockchip,rk3588-qos\0syscon";
		reg = <0x00 0xfdf66e00 0x00 0x20>;
		phandle = <0x4b>;
	};

	qos@fdf67000 {
		compatible = "rockchip,rk3588-qos\0syscon";
		reg = <0x00 0xfdf67000 0x00 0x20>;
		phandle = <0x4d>;
	};

	qos@fdf67200 {
		compatible = "rockchip,rk3588-qos\0syscon";
		reg = <0x00 0xfdf67200 0x00 0x20>;
	};

	qos@fdf70000 {
		compatible = "rockchip,rk3588-qos\0syscon";
		reg = <0x00 0xfdf70000 0x00 0x20>;
		phandle = <0x36>;
	};

	qos@fdf71000 {
		compatible = "rockchip,rk3588-qos\0syscon";
		reg = <0x00 0xfdf71000 0x00 0x20>;
		phandle = <0x37>;
	};

	qos@fdf72000 {
		compatible = "rockchip,rk3588-qos\0syscon";
		reg = <0x00 0xfdf72000 0x00 0x20>;
		phandle = <0x33>;
	};

	qos@fdf72200 {
		compatible = "rockchip,rk3588-qos\0syscon";
		reg = <0x00 0xfdf72200 0x00 0x20>;
		phandle = <0x34>;
	};

	qos@fdf72400 {
		compatible = "rockchip,rk3588-qos\0syscon";
		reg = <0x00 0xfdf72400 0x00 0x20>;
		phandle = <0x35>;
	};

	qos@fdf80000 {
		compatible = "rockchip,rk3588-qos\0syscon";
		reg = <0x00 0xfdf80000 0x00 0x20>;
		phandle = <0x50>;
	};

	qos@fdf81000 {
		compatible = "rockchip,rk3588-qos\0syscon";
		reg = <0x00 0xfdf81000 0x00 0x20>;
		phandle = <0x51>;
	};

	qos@fdf81200 {
		compatible = "rockchip,rk3588-qos\0syscon";
		reg = <0x00 0xfdf81200 0x00 0x20>;
		phandle = <0x52>;
	};

	qos@fdf82000 {
		compatible = "rockchip,rk3588-qos\0syscon";
		reg = <0x00 0xfdf82000 0x00 0x20>;
		phandle = <0x4e>;
	};

	qos@fdf82200 {
		compatible = "rockchip,rk3588-qos\0syscon";
		reg = <0x00 0xfdf82200 0x00 0x20>;
		phandle = <0x4f>;
	};

	dfi@fe060000 {
		reg = <0x00 0xfe060000 0x00 0x10000>;
		compatible = "rockchip,rk3588-dfi";
		interrupts = <0x00 0x1c 0x04 0x00 0x00 0x26 0x04 0x00 0x00 0x30 0x04 0x00 0x00 0x3a 0x04 0x00>;
		rockchip,pmu = <0x6d>;
	};

	pcie@fe180000 {
		compatible = "rockchip,rk3588-pcie\0rockchip,rk3568-pcie";
		bus-range = <0x30 0x3f>;
		clocks = <0x1f 0x143 0x1f 0x148 0x1f 0x13e 0x1f 0x14d 0x1f 0x152 0x1f 0x2b0>;
		clock-names = "aclk_mst\0aclk_slv\0aclk_dbi\0pclk\0aux\0pipe";
		device_type = "pci";
		interrupts = <0x00 0xf8 0x04 0x00 0x00 0xf7 0x04 0x00 0x00 0xf6 0x04 0x00 0x00 0xf5 0x04 0x00 0x00 0xf4 0x04 0x00>;
		interrupt-names = "sys\0pmc\0msg\0legacy\0err";
		#interrupt-cells = <0x01>;
		interrupt-map-mask = <0x00 0x00 0x00 0x07>;
		interrupt-map = <0x00 0x00 0x00 0x01 0x6e 0x00 0x00 0x00 0x00 0x02 0x6e 0x01 0x00 0x00 0x00 0x03 0x6e 0x02 0x00 0x00 0x00 0x04 0x6e 0x03>;
		linux,pci-domain = <0x03>;
		max-link-speed = <0x02>;
		msi-map = <0x3000 0x6f 0x3000 0x1000>;
		num-lanes = <0x01>;
		phys = <0x28 0x02>;
		phy-names = "pcie-phy";
		power-domains = <0x20 0x22>;
		ranges = <0x1000000 0x00 0xf3100000 0x00 0xf3100000 0x00 0x100000 0x2000000 0x00 0xf3200000 0x00 0xf3200000 0x00 0xe00000 0x3000000 0x00 0x40000000 0x09 0xc0000000 0x00 0x40000000>;
		reg = <0x0a 0x40c00000 0x00 0x400000 0x00 0xfe180000 0x00 0x10000 0x00 0xf3000000 0x00 0x100000>;
		reg-names = "dbi\0apb\0config";
		resets = <0x1f 0x129 0x1f 0x12e>;
		reset-names = "pwr\0pipe";
		#address-cells = <0x03>;
		#size-cells = <0x02>;
		status = "disabled";

		legacy-interrupt-controller {
			interrupt-controller;
			#address-cells = <0x00>;
			#interrupt-cells = <0x01>;
			interrupt-parent = <0x01>;
			interrupts = <0x00 0xf5 0x01 0x00>;
			phandle = <0x6e>;
		};
	};

	pcie@fe190000 {
		compatible = "rockchip,rk3588-pcie\0rockchip,rk3568-pcie";
		bus-range = <0x40 0x4f>;
		clocks = <0x1f 0x144 0x1f 0x149 0x1f 0x13f 0x1f 0x14e 0x1f 0x153 0x1f 0x173>;
		clock-names = "aclk_mst\0aclk_slv\0aclk_dbi\0pclk\0aux\0pipe";
		device_type = "pci";
		interrupts = <0x00 0xfd 0x04 0x00 0x00 0xfc 0x04 0x00 0x00 0xfb 0x04 0x00 0x00 0xfa 0x04 0x00 0x00 0xf9 0x04 0x00>;
		interrupt-names = "sys\0pmc\0msg\0legacy\0err";
		#interrupt-cells = <0x01>;
		interrupt-map-mask = <0x00 0x00 0x00 0x07>;
		interrupt-map = <0x00 0x00 0x00 0x01 0x70 0x00 0x00 0x00 0x00 0x02 0x70 0x01 0x00 0x00 0x00 0x03 0x70 0x02 0x00 0x00 0x00 0x04 0x70 0x03>;
		linux,pci-domain = <0x04>;
		max-link-speed = <0x02>;
		msi-map = <0x4000 0x6f 0x4000 0x1000>;
		num-lanes = <0x01>;
		phys = <0x71 0x02>;
		phy-names = "pcie-phy";
		power-domains = <0x20 0x22>;
		ranges = <0x1000000 0x00 0xf4100000 0x00 0xf4100000 0x00 0x100000 0x2000000 0x00 0xf4200000 0x00 0xf4200000 0x00 0xe00000 0x3000000 0x00 0x40000000 0x0a 0x00 0x00 0x40000000>;
		reg = <0x0a 0x41000000 0x00 0x400000 0x00 0xfe190000 0x00 0x10000 0x00 0xf4000000 0x00 0x100000>;
		reg-names = "dbi\0apb\0config";
		resets = <0x1f 0x12a 0x1f 0x12f>;
		reset-names = "pwr\0pipe";
		#address-cells = <0x03>;
		#size-cells = <0x02>;
		status = "okay";
		pinctrl-0 = <0x72>;
		pinctrl-names = "default";
		reset-gpios = <0x73 0x19 0x00>;
		vpcie3v3-supply = <0x74>;

		legacy-interrupt-controller {
			interrupt-controller;
			#address-cells = <0x00>;
			#interrupt-cells = <0x01>;
			interrupt-parent = <0x01>;
			interrupts = <0x00 0xfa 0x01 0x00>;
			phandle = <0x70>;
		};
	};

	ethernet@fe1c0000 {
		compatible = "rockchip,rk3588-gmac\0snps,dwmac-4.20a";
		reg = <0x00 0xfe1c0000 0x00 0x10000>;
		interrupts = <0x00 0xea 0x04 0x00 0x00 0xe9 0x04 0x00>;
		interrupt-names = "macirq\0eth_wake_irq";
		clocks = <0x1f 0x136 0x1f 0x137 0x1f 0x159 0x1f 0x15e 0x1f 0x135>;
		clock-names = "stmmaceth\0clk_mac_ref\0pclk_mac\0aclk_mac\0ptp_ref";
		power-domains = <0x20 0x21>;
		resets = <0x1f 0x124>;
		reset-names = "stmmaceth";
		rockchip,grf = <0x68>;
		rockchip,php-grf = <0x2a>;
		snps,axi-config = <0x75>;
		snps,mixed-burst;
		snps,mtl-rx-config = <0x76>;
		snps,mtl-tx-config = <0x77>;
		snps,tso;
		status = "okay";
		clock_in_out = "output";
		phy-handle = <0x78>;
		phy-mode = "rgmii";
		pinctrl-0 = <0x79 0x7a 0x7b 0x7c 0x7d>;
		pinctrl-names = "default";
		tx_delay = <0x3a>;
		rx_delay = <0x3e>;

		mdio {
			compatible = "snps,dwmac-mdio";
			#address-cells = <0x01>;
			#size-cells = <0x00>;

			ethernet-phy@1 {
				compatible = "ethernet-phy-id001c.c916";
				reg = <0x01>;
				pinctrl-names = "default";
				pinctrl-0 = <0x7e>;
				reset-assert-us = <0x4e20>;
				reset-deassert-us = <0x186a0>;
				reset-gpios = <0x73 0x0f 0x01>;
				phandle = <0x78>;
			};
		};

		stmmac-axi-config {
			snps,blen = <0x00 0x00 0x00 0x00 0x10 0x08 0x04>;
			snps,wr_osr_lmt = <0x04>;
			snps,rd_osr_lmt = <0x08>;
			phandle = <0x75>;
		};

		rx-queues-config {
			snps,rx-queues-to-use = <0x02>;
			phandle = <0x76>;

			queue0 {
			};

			queue1 {
			};
		};

		tx-queues-config {
			snps,tx-queues-to-use = <0x02>;
			phandle = <0x77>;

			queue0 {
			};

			queue1 {
			};
		};
	};

	sata@fe210000 {
		compatible = "rockchip,rk3588-dwc-ahci\0snps,dwc-ahci";
		reg = <0x00 0xfe210000 0x00 0x1000>;
		interrupts = <0x00 0x111 0x04 0x00>;
		clocks = <0x1f 0x162 0x1f 0x15f 0x1f 0x165 0x1f 0x154 0x1f 0x16f>;
		clock-names = "sata\0pmalive\0rxoob\0ref\0asic";
		ports-implemented = <0x01>;
		#address-cells = <0x01>;
		#size-cells = <0x00>;
		status = "disabled";

		sata-port@0 {
			reg = <0x00>;
			hba-port-cap = <0x400000>;
			phys = <0x71 0x01>;
			phy-names = "sata-phy";
			snps,rx-ts-max = <0x20>;
			snps,tx-ts-max = <0x20>;
		};
	};

	sata@fe230000 {
		compatible = "rockchip,rk3588-dwc-ahci\0snps,dwc-ahci";
		reg = <0x00 0xfe230000 0x00 0x1000>;
		interrupts = <0x00 0x113 0x04 0x00>;
		clocks = <0x1f 0x164 0x1f 0x161 0x1f 0x167 0x1f 0x156 0x1f 0x171>;
		clock-names = "sata\0pmalive\0rxoob\0ref\0asic";
		ports-implemented = <0x01>;
		#address-cells = <0x01>;
		#size-cells = <0x00>;
		status = "disabled";

		sata-port@0 {
			reg = <0x00>;
			hba-port-cap = <0x400000>;
			phys = <0x28 0x01>;
			phy-names = "sata-phy";
			snps,rx-ts-max = <0x20>;
			snps,tx-ts-max = <0x20>;
		};
	};

	spi@fe2b0000 {
		compatible = "rockchip,sfc";
		reg = <0x00 0xfe2b0000 0x00 0x4000>;
		interrupts = <0x00 0xce 0x04 0x00>;
		clocks = <0x1f 0x12f 0x1f 0x130>;
		clock-names = "clk_sfc\0hclk_sfc";
		#address-cells = <0x01>;
		#size-cells = <0x00>;
		status = "disabled";
		pinctrl-names = "default";
		pinctrl-0 = <0x7f>;

		flash@0 {
			compatible = "jedec,spi-nor";
			reg = <0x00>;
			spi-max-frequency = <0x632ea00>;
			spi-rx-bus-width = <0x04>;
			spi-tx-bus-width = <0x01>;
		};
	};

	mmc@fe2c0000 {
		compatible = "rockchip,rk3588-dw-mshc\0rockchip,rk3288-dw-mshc";
		reg = <0x00 0xfe2c0000 0x00 0x4000>;
		interrupts = <0x00 0xcb 0x04 0x00>;
		clocks = <0x0a 0x17 0x0a 0x09 0x1f 0x2ad 0x1f 0x2ae>;
		clock-names = "biu\0ciu\0ciu-drive\0ciu-sample";
		fifo-depth = <0x100>;
		max-frequency = <0x8f0d180>;
		pinctrl-names = "default";
		pinctrl-0 = <0x80 0x81 0x82 0x83>;
		power-domains = <0x20 0x28>;
		status = "okay";
		bus-width = <0x04>;
		cap-mmc-highspeed;
		cap-sd-highspeed;
		cd-gpios = <0x84 0x04 0x01>;
		disable-wp;
		no-sdio;
		no-mmc;
		sd-uhs-sdr104;
		vmmc-supply = <0x85>;
		vqmmc-supply = <0x86>;
	};

	mmc@fe2d0000 {
		compatible = "rockchip,rk3588-dw-mshc\0rockchip,rk3288-dw-mshc";
		reg = <0x00 0xfe2d0000 0x00 0x4000>;
		interrupts = <0x00 0xcc 0x04 0x00>;
		clocks = <0x1f 0x18a 0x1f 0x18b 0x1f 0x2ab 0x1f 0x2ac>;
		clock-names = "biu\0ciu\0ciu-drive\0ciu-sample";
		fifo-depth = <0x100>;
		max-frequency = <0xbebc200>;
		pinctrl-names = "default";
		pinctrl-0 = <0x87>;
		power-domains = <0x20 0x25>;
		status = "disabled";
	};

	mmc@fe2e0000 {
		compatible = "rockchip,rk3588-dwcmshc";
		reg = <0x00 0xfe2e0000 0x00 0x10000>;
		interrupts = <0x00 0xcd 0x04 0x00>;
		assigned-clocks = <0x1f 0x12d 0x1f 0x12e 0x1f 0x12c>;
		assigned-clock-rates = <0xbebc200 0x16e3600 0xbebc200>;
		clocks = <0x1f 0x12c 0x1f 0x12a 0x1f 0x12b 0x1f 0x12d 0x1f 0x12e>;
		clock-names = "core\0bus\0axi\0block\0timer";
		max-frequency = <0xbebc200>;
		pinctrl-0 = <0x88 0x89 0x8a 0x8b 0x8c>;
		pinctrl-names = "default";
		resets = <0x1f 0x118 0x1f 0x116 0x1f 0x117 0x1f 0x119 0x1f 0x11a>;
		reset-names = "core\0bus\0axi\0block\0timer";
		status = "okay";
		bus-width = <0x08>;
		no-sdio;
		no-sd;
		non-removable;
		mmc-hs400-1_8v;
		mmc-hs400-enhanced-strobe;
	};

	i2s@fe470000 {
		compatible = "rockchip,rk3588-i2s-tdm";
		reg = <0x00 0xfe470000 0x00 0x1000>;
		interrupts = <0x00 0xb4 0x04 0x00>;
		clocks = <0x1f 0x2b 0x1f 0x2f 0x1f 0x28>;
		clock-names = "mclk_tx\0mclk_rx\0hclk";
		assigned-clocks = <0x1f 0x29 0x1f 0x2d>;
		assigned-clock-parents = <0x1f 0x04 0x1f 0x04>;
		dmas = <0x2d 0x00 0x2d 0x01>;
		dma-names = "tx\0rx";
		power-domains = <0x20 0x26>;
		resets = <0x1f 0x2a 0x1f 0x2b>;
		reset-names = "tx-m\0rx-m";
		rockchip,trcm-sync-tx-only;
		pinctrl-names = "default";
		pinctrl-0 = <0x8d 0x8e 0x8f 0x90 0x91>;
		#sound-dai-cells = <0x00>;
		status = "okay";

		port {
			phandle = <0xf2>;

			endpoint {
				dai-format = "i2s";
				mclk-fs = <0x100>;
				remote-endpoint = <0x92>;
				phandle = <0xdc>;
			};
		};
	};

	i2s@fe480000 {
		compatible = "rockchip,rk3588-i2s-tdm";
		reg = <0x00 0xfe480000 0x00 0x1000>;
		interrupts = <0x00 0xb5 0x04 0x00>;
		clocks = <0x1f 0x279 0x1f 0x27d 0x1f 0x275>;
		clock-names = "mclk_tx\0mclk_rx\0hclk";
		dmas = <0x2d 0x02 0x2d 0x03>;
		dma-names = "tx\0rx";
		resets = <0x1f 0x25e 0x1f 0x25f>;
		reset-names = "tx-m\0rx-m";
		rockchip,trcm-sync-tx-only;
		pinctrl-names = "default";
		pinctrl-0 = <0x93 0x94 0x95 0x96 0x97 0x98 0x99 0x9a 0x9b 0x9c>;
		#sound-dai-cells = <0x00>;
		status = "disabled";
	};

	i2s@fe490000 {
		compatible = "rockchip,rk3588-i2s\0rockchip,rk3066-i2s";
		reg = <0x00 0xfe490000 0x00 0x1000>;
		interrupts = <0x00 0xb6 0x04 0x00>;
		clocks = <0x1f 0x1f 0x1f 0x1a>;
		clock-names = "i2s_clk\0i2s_hclk";
		assigned-clocks = <0x1f 0x1c>;
		assigned-clock-parents = <0x1f 0x04>;
		dmas = <0x9d 0x00 0x9d 0x01>;
		dma-names = "tx\0rx";
		power-domains = <0x20 0x26>;
		pinctrl-names = "default";
		pinctrl-0 = <0x9e 0x9f 0xa0 0xa1>;
		#sound-dai-cells = <0x00>;
		status = "disabled";
	};

	i2s@fe4a0000 {
		compatible = "rockchip,rk3588-i2s\0rockchip,rk3066-i2s";
		reg = <0x00 0xfe4a0000 0x00 0x1000>;
		interrupts = <0x00 0xb7 0x04 0x00>;
		clocks = <0x1f 0x25 0x1f 0x1b>;
		clock-names = "i2s_clk\0i2s_hclk";
		assigned-clocks = <0x1f 0x22>;
		assigned-clock-parents = <0x1f 0x04>;
		dmas = <0x9d 0x02 0x9d 0x03>;
		dma-names = "tx\0rx";
		power-domains = <0x20 0x26>;
		pinctrl-names = "default";
		pinctrl-0 = <0xa2 0xa3 0xa4 0xa5>;
		#sound-dai-cells = <0x00>;
		status = "disabled";
	};

	interrupt-controller@fe600000 {
		compatible = "arm,gic-v3";
		reg = <0x00 0xfe600000 0x00 0x10000 0x00 0xfe680000 0x00 0x100000>;
		interrupts = <0x01 0x09 0x04 0x00>;
		interrupt-controller;
		mbi-alias = <0x00 0xfe610000>;
		mbi-ranges = <0x1a8 0x38>;
		msi-controller;
		ranges;
		#address-cells = <0x02>;
		#interrupt-cells = <0x04>;
		#size-cells = <0x02>;
		phandle = <0x01>;

		msi-controller@fe640000 {
			compatible = "arm,gic-v3-its";
			reg = <0x00 0xfe640000 0x00 0x20000>;
			msi-controller;
			#msi-cells = <0x01>;
			phandle = <0x6f>;
		};

		msi-controller@fe660000 {
			compatible = "arm,gic-v3-its";
			reg = <0x00 0xfe660000 0x00 0x20000>;
			msi-controller;
			#msi-cells = <0x01>;
		};

		ppi-partitions {

			interrupt-partition-0 {
				affinity = <0x02 0x03 0x04 0x05>;
				phandle = <0x1d>;
			};

			interrupt-partition-1 {
				affinity = <0x06 0x07 0x08 0x09>;
				phandle = <0x1e>;
			};
		};
	};

	dma-controller@fea10000 {
		compatible = "arm,pl330\0arm,primecell";
		reg = <0x00 0xfea10000 0x00 0x4000>;
		interrupts = <0x00 0x56 0x04 0x00 0x00 0x57 0x04 0x00>;
		arm,pl330-periph-burst;
		clocks = <0x1f 0x6e>;
		clock-names = "apb_pclk";
		#dma-cells = <0x01>;
		phandle = <0x2d>;
	};

	dma-controller@fea30000 {
		compatible = "arm,pl330\0arm,primecell";
		reg = <0x00 0xfea30000 0x00 0x4000>;
		interrupts = <0x00 0x58 0x04 0x00 0x00 0x59 0x04 0x00>;
		arm,pl330-periph-burst;
		clocks = <0x1f 0x6f>;
		clock-names = "apb_pclk";
		#dma-cells = <0x01>;
		phandle = <0x9d>;
	};

	i2c@fea90000 {
		compatible = "rockchip,rk3588-i2c\0rockchip,rk3399-i2c";
		reg = <0x00 0xfea90000 0x00 0x1000>;
		clocks = <0x1f 0x83 0x1f 0x7b>;
		clock-names = "i2c\0pclk";
		interrupts = <0x00 0x13e 0x04 0x00>;
		pinctrl-0 = <0xa6>;
		pinctrl-names = "default";
		#address-cells = <0x01>;
		#size-cells = <0x00>;
		status = "disabled";
	};

	i2c@feaa0000 {
		compatible = "rockchip,rk3588-i2c\0rockchip,rk3399-i2c";
		reg = <0x00 0xfeaa0000 0x00 0x1000>;
		clocks = <0x1f 0x84 0x1f 0x7c>;
		clock-names = "i2c\0pclk";
		interrupts = <0x00 0x13f 0x04 0x00>;
		pinctrl-0 = <0xa7>;
		pinctrl-names = "default";
		#address-cells = <0x01>;
		#size-cells = <0x00>;
		status = "okay";

		regulator@42 {
			compatible = "rockchip,rk8602";
			reg = <0x42>;
			fcs,suspend-voltage-selector = <0x01>;
			regulator-name = "vdd_npu_s0";
			regulator-always-on;
			regulator-boot-on;
			regulator-min-microvolt = <0x86470>;
			regulator-max-microvolt = <0xe7ef0>;
			regulator-ramp-delay = <0x8fc>;
			vin-supply = <0x2c>;

			regulator-state-mem {
				regulator-off-in-suspend;
			};
		};

		eeprom@50 {
			compatible = "belling,bl24c16a\0atmel,24c16";
			reg = <0x50>;
			pagesize = <0x10>;
		};
	};

	i2c@feab0000 {
		compatible = "rockchip,rk3588-i2c\0rockchip,rk3399-i2c";
		reg = <0x00 0xfeab0000 0x00 0x1000>;
		clocks = <0x1f 0x85 0x1f 0x7d>;
		clock-names = "i2c\0pclk";
		interrupts = <0x00 0x140 0x04 0x00>;
		pinctrl-0 = <0xa8>;
		pinctrl-names = "default";
		#address-cells = <0x01>;
		#size-cells = <0x00>;
		status = "okay";
	};

	i2c@feac0000 {
		compatible = "rockchip,rk3588-i2c\0rockchip,rk3399-i2c";
		reg = <0x00 0xfeac0000 0x00 0x1000>;
		clocks = <0x1f 0x86 0x1f 0x7e>;
		clock-names = "i2c\0pclk";
		interrupts = <0x00 0x141 0x04 0x00>;
		pinctrl-0 = <0xa9>;
		pinctrl-names = "default";
		#address-cells = <0x01>;
		#size-cells = <0x00>;
		status = "disabled";
	};

	i2c@fead0000 {
		compatible = "rockchip,rk3588-i2c\0rockchip,rk3399-i2c";
		reg = <0x00 0xfead0000 0x00 0x1000>;
		clocks = <0x1f 0x87 0x1f 0x7f>;
		clock-names = "i2c\0pclk";
		interrupts = <0x00 0x142 0x04 0x00>;
		pinctrl-0 = <0xaa>;
		pinctrl-names = "default";
		#address-cells = <0x01>;
		#size-cells = <0x00>;
		status = "okay";
	};

	timer@feae0000 {
		compatible = "rockchip,rk3588-timer\0rockchip,rk3288-timer";
		reg = <0x00 0xfeae0000 0x00 0x20>;
		interrupts = <0x00 0x121 0x04 0x00>;
		clocks = <0x1f 0x54 0x1f 0x57>;
		clock-names = "pclk\0timer";
	};

	watchdog@feaf0000 {
		compatible = "rockchip,rk3588-wdt\0snps,dw-wdt";
		reg = <0x00 0xfeaf0000 0x00 0x100>;
		clocks = <0x1f 0x64 0x1f 0x63>;
		clock-names = "tclk\0pclk";
		interrupts = <0x00 0x13b 0x04 0x00>;
	};

	spi@feb00000 {
		compatible = "rockchip,rk3588-spi\0rockchip,rk3066-spi";
		reg = <0x00 0xfeb00000 0x00 0x1000>;
		interrupts = <0x00 0x146 0x04 0x00>;
		clocks = <0x1f 0x97 0x1f 0x92>;
		clock-names = "spiclk\0apb_pclk";
		dmas = <0x2d 0x0e 0x2d 0x0f>;
		dma-names = "tx\0rx";
		num-cs = <0x02>;
		pinctrl-0 = <0xab 0xac 0xad>;
		pinctrl-names = "default";
		#address-cells = <0x01>;
		#size-cells = <0x00>;
		status = "disabled";
	};

	spi@feb10000 {
		compatible = "rockchip,rk3588-spi\0rockchip,rk3066-spi";
		reg = <0x00 0xfeb10000 0x00 0x1000>;
		interrupts = <0x00 0x147 0x04 0x00>;
		clocks = <0x1f 0x98 0x1f 0x93>;
		clock-names = "spiclk\0apb_pclk";
		dmas = <0x2d 0x10 0x2d 0x11>;
		dma-names = "tx\0rx";
		num-cs = <0x02>;
		pinctrl-0 = <0xae 0xaf 0xb0>;
		pinctrl-names = "default";
		#address-cells = <0x01>;
		#size-cells = <0x00>;
		status = "disabled";
	};

	spi@feb20000 {
		compatible = "rockchip,rk3588-spi\0rockchip,rk3066-spi";
		reg = <0x00 0xfeb20000 0x00 0x1000>;
		interrupts = <0x00 0x148 0x04 0x00>;
		clocks = <0x1f 0x99 0x1f 0x94>;
		clock-names = "spiclk\0apb_pclk";
		dmas = <0x9d 0x0f 0x9d 0x10>;
		dma-names = "tx\0rx";
		num-cs = <0x01>;
		pinctrl-0 = <0xb1 0xb2>;
		pinctrl-names = "default";
		#address-cells = <0x01>;
		#size-cells = <0x00>;
		status = "okay";
		assigned-clocks = <0x1f 0x99>;
		assigned-clock-rates = <0xbebc200>;

		pmic@0 {
			compatible = "rockchip,rk806";
			reg = <0x00>;
			interrupt-parent = <0x84>;
			interrupts = <0x07 0x08>;
			pinctrl-names = "default";
			pinctrl-0 = <0xb3 0xb4 0xb5 0xb6>;
			spi-max-frequency = <0xf4240>;
			system-power-controller;
			vcc1-supply = <0x2c>;
			vcc2-supply = <0x2c>;
			vcc3-supply = <0x2c>;
			vcc4-supply = <0x2c>;
			vcc5-supply = <0x2c>;
			vcc6-supply = <0x2c>;
			vcc7-supply = <0x2c>;
			vcc8-supply = <0x2c>;
			vcc9-supply = <0x2c>;
			vcc10-supply = <0x2c>;
			vcc11-supply = <0xb7>;
			vcc12-supply = <0x2c>;
			vcc13-supply = <0xb8>;
			vcc14-supply = <0xb8>;
			vcca-supply = <0x2c>;
			gpio-controller;
			#gpio-cells = <0x02>;

			dvs1-null-pins {
				pins = "gpio_pwrctrl1";
				function = "pin_fun0";
				phandle = <0xb4>;
			};

			dvs2-null-pins {
				pins = "gpio_pwrctrl2";
				function = "pin_fun0";
				phandle = <0xb5>;
			};

			dvs3-null-pins {
				pins = "gpio_pwrctrl3";
				function = "pin_fun0";
				phandle = <0xb6>;
			};

			regulators {

				dcdc-reg1 {
					regulator-name = "vdd_gpu_s0";
					regulator-boot-on;
					regulator-min-microvolt = <0x86470>;
					regulator-max-microvolt = <0xe7ef0>;
					regulator-ramp-delay = <0x30d4>;
					regulator-enable-ramp-delay = <0x190>;

					regulator-state-mem {
						regulator-off-in-suspend;
					};
				};

				dcdc-reg2 {
					regulator-name = "vdd_cpu_lit_s0";
					regulator-always-on;
					regulator-boot-on;
					regulator-min-microvolt = <0x86470>;
					regulator-max-microvolt = <0xe7ef0>;
					regulator-ramp-delay = <0x30d4>;
					phandle = <0x0e>;

					regulator-state-mem {
						regulator-off-in-suspend;
					};
				};

				dcdc-reg3 {
					regulator-name = "vdd_log_s0";
					regulator-always-on;
					regulator-boot-on;
					regulator-min-microvolt = <0xa4cb8>;
					regulator-max-microvolt = <0xb71b0>;
					regulator-ramp-delay = <0x30d4>;

					regulator-state-mem {
						regulator-off-in-suspend;
						regulator-suspend-microvolt = <0xb71b0>;
					};
				};

				dcdc-reg4 {
					regulator-name = "vdd_vdenc_s0";
					regulator-always-on;
					regulator-boot-on;
					regulator-min-microvolt = <0x86470>;
					regulator-max-microvolt = <0xe7ef0>;
					regulator-ramp-delay = <0x30d4>;

					regulator-state-mem {
						regulator-off-in-suspend;
					};
				};

				dcdc-reg5 {
					regulator-name = "vdd_ddr_s0";
					regulator-always-on;
					regulator-boot-on;
					regulator-min-microvolt = <0xa4cb8>;
					regulator-max-microvolt = <0xdbba0>;
					regulator-ramp-delay = <0x30d4>;

					regulator-state-mem {
						regulator-off-in-suspend;
						regulator-suspend-microvolt = <0xcf850>;
					};
				};

				dcdc-reg6 {
					regulator-name = "vdd2_ddr_s3";
					regulator-always-on;
					regulator-boot-on;

					regulator-state-mem {
						regulator-on-in-suspend;
					};
				};

				dcdc-reg7 {
					regulator-name = "vdd_2v0_pldo_s3";
					regulator-always-on;
					regulator-boot-on;
					regulator-min-microvolt = <0x1e8480>;
					regulator-max-microvolt = <0x1e8480>;
					regulator-ramp-delay = <0x30d4>;
					phandle = <0xb7>;

					regulator-state-mem {
						regulator-on-in-suspend;
						regulator-suspend-microvolt = <0x1e8480>;
					};
				};

				dcdc-reg8 {
					regulator-name = "vcc_3v3_s3";
					regulator-always-on;
					regulator-boot-on;
					regulator-min-microvolt = <0x325aa0>;
					regulator-max-microvolt = <0x325aa0>;

					regulator-state-mem {
						regulator-on-in-suspend;
						regulator-suspend-microvolt = <0x325aa0>;
					};
				};

				dcdc-reg9 {
					regulator-name = "vddq_ddr_s0";
					regulator-always-on;
					regulator-boot-on;

					regulator-state-mem {
						regulator-off-in-suspend;
					};
				};

				dcdc-reg10 {
					regulator-name = "vcc_1v8_s3";
					regulator-always-on;
					regulator-boot-on;
					regulator-min-microvolt = <0x1b7740>;
					regulator-max-microvolt = <0x1b7740>;

					regulator-state-mem {
						regulator-on-in-suspend;
						regulator-suspend-microvolt = <0x1b7740>;
					};
				};

				pldo-reg1 {
					regulator-name = "avcc_1v8_s0";
					regulator-always-on;
					regulator-boot-on;
					regulator-min-microvolt = <0x1b7740>;
					regulator-max-microvolt = <0x1b7740>;
					phandle = <0xd9>;

					regulator-state-mem {
						regulator-off-in-suspend;
					};
				};

				pldo-reg2 {
					regulator-name = "vcc_1v8_s0";
					regulator-always-on;
					regulator-boot-on;
					regulator-min-microvolt = <0x1b7740>;
					regulator-max-microvolt = <0x1b7740>;

					regulator-state-mem {
						regulator-off-in-suspend;
						regulator-suspend-microvolt = <0x1b7740>;
					};
				};

				pldo-reg3 {
					regulator-name = "avdd_1v2_s0";
					regulator-always-on;
					regulator-boot-on;
					regulator-min-microvolt = <0x124f80>;
					regulator-max-microvolt = <0x124f80>;

					regulator-state-mem {
						regulator-off-in-suspend;
					};
				};

				pldo-reg4 {
					regulator-name = "vcc_3v3_s0";
					regulator-always-on;
					regulator-boot-on;
					regulator-min-microvolt = <0x325aa0>;
					regulator-max-microvolt = <0x325aa0>;
					regulator-ramp-delay = <0x30d4>;
					phandle = <0x85>;

					regulator-state-mem {
						regulator-off-in-suspend;
					};
				};

				pldo-reg5 {
					regulator-name = "vccio_sd_s0";
					regulator-always-on;
					regulator-boot-on;
					regulator-min-microvolt = <0x1b7740>;
					regulator-max-microvolt = <0x325aa0>;
					regulator-ramp-delay = <0x30d4>;
					phandle = <0x86>;

					regulator-state-mem {
						regulator-off-in-suspend;
					};
				};

				pldo-reg6 {
					regulator-name = "pldo6_s3";
					regulator-always-on;
					regulator-boot-on;
					regulator-min-microvolt = <0x1b7740>;
					regulator-max-microvolt = <0x1b7740>;

					regulator-state-mem {
						regulator-on-in-suspend;
						regulator-suspend-microvolt = <0x1b7740>;
					};
				};

				nldo-reg1 {
					regulator-name = "vdd_0v75_s3";
					regulator-always-on;
					regulator-boot-on;
					regulator-min-microvolt = <0xb71b0>;
					regulator-max-microvolt = <0xb71b0>;

					regulator-state-mem {
						regulator-on-in-suspend;
						regulator-suspend-microvolt = <0xb71b0>;
					};
				};

				nldo-reg2 {
					regulator-name = "vdd_ddr_pll_s0";
					regulator-always-on;
					regulator-boot-on;
					regulator-min-microvolt = <0xcf850>;
					regulator-max-microvolt = <0xcf850>;

					regulator-state-mem {
						regulator-off-in-suspend;
						regulator-suspend-microvolt = <0xcf850>;
					};
				};

				nldo-reg3 {
					regulator-name = "avdd_0v75_s0";
					regulator-always-on;
					regulator-boot-on;
					regulator-min-microvolt = <0xb71b0>;
					regulator-max-microvolt = <0xb71b0>;

					regulator-state-mem {
						regulator-off-in-suspend;
					};
				};

				nldo-reg4 {
					regulator-name = "vdd_0v85_s0";
					regulator-always-on;
					regulator-boot-on;
					regulator-min-microvolt = <0xcf850>;
					regulator-max-microvolt = <0xcf850>;

					regulator-state-mem {
						regulator-off-in-suspend;
					};
				};

				nldo-reg5 {
					regulator-name = "vdd_0v75_s0";
					regulator-always-on;
					regulator-boot-on;
					regulator-min-microvolt = <0xb71b0>;
					regulator-max-microvolt = <0xb71b0>;

					regulator-state-mem {
						regulator-off-in-suspend;
					};
				};
			};
		};
	};

	spi@feb30000 {
		compatible = "rockchip,rk3588-spi\0rockchip,rk3066-spi";
		reg = <0x00 0xfeb30000 0x00 0x1000>;
		interrupts = <0x00 0x149 0x04 0x00>;
		clocks = <0x1f 0x9a 0x1f 0x95>;
		clock-names = "spiclk\0apb_pclk";
		dmas = <0x9d 0x11 0x9d 0x12>;
		dma-names = "tx\0rx";
		num-cs = <0x02>;
		pinctrl-0 = <0xb9 0xba 0xbb>;
		pinctrl-names = "default";
		#address-cells = <0x01>;
		#size-cells = <0x00>;
		status = "disabled";
	};

	serial@feb40000 {
		compatible = "rockchip,rk3588-uart\0snps,dw-apb-uart";
		reg = <0x00 0xfeb40000 0x00 0x100>;
		interrupts = <0x00 0x14c 0x04 0x00>;
		clocks = <0x1f 0xab 0x1f 0x9f>;
		clock-names = "baudclk\0apb_pclk";
		dmas = <0x2d 0x08 0x2d 0x09>;
		dma-names = "tx\0rx";
		pinctrl-0 = <0xbc>;
		pinctrl-names = "default";
		reg-io-width = <0x04>;
		reg-shift = <0x02>;
		status = "disabled";
	};

	serial@feb50000 {
		compatible = "rockchip,rk3588-uart\0snps,dw-apb-uart";
		reg = <0x00 0xfeb50000 0x00 0x100>;
		interrupts = <0x00 0x14d 0x04 0x00>;
		clocks = <0x1f 0xaf 0x1f 0xa0>;
		clock-names = "baudclk\0apb_pclk";
		dmas = <0x2d 0x0a 0x2d 0x0b>;
		dma-names = "tx\0rx";
		pinctrl-0 = <0xbd>;
		pinctrl-names = "default";
		reg-io-width = <0x04>;
		reg-shift = <0x02>;
		status = "okay";
	};

	serial@feb60000 {
		compatible = "rockchip,rk3588-uart\0snps,dw-apb-uart";
		reg = <0x00 0xfeb60000 0x00 0x100>;
		interrupts = <0x00 0x14e 0x04 0x00>;
		clocks = <0x1f 0xb3 0x1f 0xa1>;
		clock-names = "baudclk\0apb_pclk";
		dmas = <0x2d 0x0c 0x2d 0x0d>;
		dma-names = "tx\0rx";
		pinctrl-0 = <0xbe>;
		pinctrl-names = "default";
		reg-io-width = <0x04>;
		reg-shift = <0x02>;
		status = "disabled";
	};

	serial@feb70000 {
		compatible = "rockchip,rk3588-uart\0snps,dw-apb-uart";
		reg = <0x00 0xfeb70000 0x00 0x100>;
		interrupts = <0x00 0x14f 0x04 0x00>;
		clocks = <0x1f 0xb7 0x1f 0xa2>;
		clock-names = "baudclk\0apb_pclk";
		dmas = <0x9d 0x09 0x9d 0x0a>;
		dma-names = "tx\0rx";
		pinctrl-0 = <0xbf>;
		pinctrl-names = "default";
		reg-io-width = <0x04>;
		reg-shift = <0x02>;
		status = "disabled";
	};

	serial@feb80000 {
		compatible = "rockchip,rk3588-uart\0snps,dw-apb-uart";
		reg = <0x00 0xfeb80000 0x00 0x100>;
		interrupts = <0x00 0x150 0x04 0x00>;
		clocks = <0x1f 0xbb 0x1f 0xa3>;
		clock-names = "baudclk\0apb_pclk";
		dmas = <0x9d 0x0b 0x9d 0x0c>;
		dma-names = "tx\0rx";
		pinctrl-0 = <0xc0>;
		pinctrl-names = "default";
		reg-io-width = <0x04>;
		reg-shift = <0x02>;
		status = "disabled";
	};

	serial@feb90000 {
		compatible = "rockchip,rk3588-uart\0snps,dw-apb-uart";
		reg = <0x00 0xfeb90000 0x00 0x100>;
		interrupts = <0x00 0x151 0x04 0x00>;
		clocks = <0x1f 0xbf 0x1f 0xa4>;
		clock-names = "baudclk\0apb_pclk";
		dmas = <0x9d 0x0d 0x9d 0x0e>;
		dma-names = "tx\0rx";
		pinctrl-0 = <0xc1>;
		pinctrl-names = "default";
		reg-io-width = <0x04>;
		reg-shift = <0x02>;
		status = "disabled";
	};

	serial@feba0000 {
		compatible = "rockchip,rk3588-uart\0snps,dw-apb-uart";
		reg = <0x00 0xfeba0000 0x00 0x100>;
		interrupts = <0x00 0x152 0x04 0x00>;
		clocks = <0x1f 0xc3 0x1f 0xa5>;
		clock-names = "baudclk\0apb_pclk";
		dmas = <0x6c 0x07 0x6c 0x08>;
		dma-names = "tx\0rx";
		pinctrl-0 = <0xc2>;
		pinctrl-names = "default";
		reg-io-width = <0x04>;
		reg-shift = <0x02>;
		status = "disabled";
	};

	serial@febb0000 {
		compatible = "rockchip,rk3588-uart\0snps,dw-apb-uart";
		reg = <0x00 0xfebb0000 0x00 0x100>;
		interrupts = <0x00 0x153 0x04 0x00>;
		clocks = <0x1f 0xc7 0x1f 0xa6>;
		clock-names = "baudclk\0apb_pclk";
		dmas = <0x6c 0x09 0x6c 0x0a>;
		dma-names = "tx\0rx";
		pinctrl-0 = <0xc3>;
		pinctrl-names = "default";
		reg-io-width = <0x04>;
		reg-shift = <0x02>;
		status = "disabled";
	};

	serial@febc0000 {
		compatible = "rockchip,rk3588-uart\0snps,dw-apb-uart";
		reg = <0x00 0xfebc0000 0x00 0x100>;
		interrupts = <0x00 0x154 0x04 0x00>;
		clocks = <0x1f 0xcb 0x1f 0xa7>;
		clock-names = "baudclk\0apb_pclk";
		dmas = <0x6c 0x0b 0x6c 0x0c>;
		dma-names = "tx\0rx";
		pinctrl-0 = <0xc4>;
		pinctrl-names = "default";
		reg-io-width = <0x04>;
		reg-shift = <0x02>;
		status = "disabled";
	};

	pwm@febd0000 {
		compatible = "rockchip,rk3588-pwm\0rockchip,rk3328-pwm";
		reg = <0x00 0xfebd0000 0x00 0x10>;
		clocks = <0x1f 0x4c 0x1f 0x4b>;
		clock-names = "pwm\0pclk";
		pinctrl-0 = <0xc5>;
		pinctrl-names = "default";
		#pwm-cells = <0x03>;
		status = "disabled";
	};

	pwm@febd0010 {
		compatible = "rockchip,rk3588-pwm\0rockchip,rk3328-pwm";
		reg = <0x00 0xfebd0010 0x00 0x10>;
		clocks = <0x1f 0x4c 0x1f 0x4b>;
		clock-names = "pwm\0pclk";
		pinctrl-0 = <0xc6>;
		pinctrl-names = "default";
		#pwm-cells = <0x03>;
		status = "disabled";
	};

	pwm@febd0020 {
		compatible = "rockchip,rk3588-pwm\0rockchip,rk3328-pwm";
		reg = <0x00 0xfebd0020 0x00 0x10>;
		clocks = <0x1f 0x4c 0x1f 0x4b>;
		clock-names = "pwm\0pclk";
		pinctrl-0 = <0xc7>;
		pinctrl-names = "default";
		#pwm-cells = <0x03>;
		status = "disabled";
	};

	pwm@febd0030 {
		compatible = "rockchip,rk3588-pwm\0rockchip,rk3328-pwm";
		reg = <0x00 0xfebd0030 0x00 0x10>;
		clocks = <0x1f 0x4c 0x1f 0x4b>;
		clock-names = "pwm\0pclk";
		pinctrl-0 = <0xc8>;
		pinctrl-names = "default";
		#pwm-cells = <0x03>;
		status = "disabled";
	};

	pwm@febe0000 {
		compatible = "rockchip,rk3588-pwm\0rockchip,rk3328-pwm";
		reg = <0x00 0xfebe0000 0x00 0x10>;
		clocks = <0x1f 0x4f 0x1f 0x4e>;
		clock-names = "pwm\0pclk";
		pinctrl-0 = <0xc9>;
		pinctrl-names = "default";
		#pwm-cells = <0x03>;
		status = "disabled";
	};

	pwm@febe0010 {
		compatible = "rockchip,rk3588-pwm\0rockchip,rk3328-pwm";
		reg = <0x00 0xfebe0010 0x00 0x10>;
		clocks = <0x1f 0x4f 0x1f 0x4e>;
		clock-names = "pwm\0pclk";
		pinctrl-0 = <0xca>;
		pinctrl-names = "default";
		#pwm-cells = <0x03>;
		status = "disabled";
	};

	pwm@febe0020 {
		compatible = "rockchip,rk3588-pwm\0rockchip,rk3328-pwm";
		reg = <0x00 0xfebe0020 0x00 0x10>;
		clocks = <0x1f 0x4f 0x1f 0x4e>;
		clock-names = "pwm\0pclk";
		pinctrl-0 = <0xcb>;
		pinctrl-names = "default";
		#pwm-cells = <0x03>;
		status = "disabled";
	};

	pwm@febe0030 {
		compatible = "rockchip,rk3588-pwm\0rockchip,rk3328-pwm";
		reg = <0x00 0xfebe0030 0x00 0x10>;
		clocks = <0x1f 0x4f 0x1f 0x4e>;
		clock-names = "pwm\0pclk";
		pinctrl-0 = <0xcc>;
		pinctrl-names = "default";
		#pwm-cells = <0x03>;
		status = "disabled";
	};

	pwm@febf0000 {
		compatible = "rockchip,rk3588-pwm\0rockchip,rk3328-pwm";
		reg = <0x00 0xfebf0000 0x00 0x10>;
		clocks = <0x1f 0x52 0x1f 0x51>;
		clock-names = "pwm\0pclk";
		pinctrl-0 = <0xcd>;
		pinctrl-names = "default";
		#pwm-cells = <0x03>;
		status = "disabled";
	};

	pwm@febf0010 {
		compatible = "rockchip,rk3588-pwm\0rockchip,rk3328-pwm";
		reg = <0x00 0xfebf0010 0x00 0x10>;
		clocks = <0x1f 0x52 0x1f 0x51>;
		clock-names = "pwm\0pclk";
		pinctrl-0 = <0xce>;
		pinctrl-names = "default";
		#pwm-cells = <0x03>;
		status = "disabled";
	};

	pwm@febf0020 {
		compatible = "rockchip,rk3588-pwm\0rockchip,rk3328-pwm";
		reg = <0x00 0xfebf0020 0x00 0x10>;
		clocks = <0x1f 0x52 0x1f 0x51>;
		clock-names = "pwm\0pclk";
		pinctrl-0 = <0xcf>;
		pinctrl-names = "default";
		#pwm-cells = <0x03>;
		status = "disabled";
	};

	pwm@febf0030 {
		compatible = "rockchip,rk3588-pwm\0rockchip,rk3328-pwm";
		reg = <0x00 0xfebf0030 0x00 0x10>;
		clocks = <0x1f 0x52 0x1f 0x51>;
		clock-names = "pwm\0pclk";
		pinctrl-0 = <0xd0>;
		pinctrl-names = "default";
		#pwm-cells = <0x03>;
		status = "disabled";
	};

	thermal-zones {

		package-thermal {
			polling-delay-passive = <0x00>;
			polling-delay = <0x00>;
			thermal-sensors = <0xd1 0x00>;

			trips {

				package-crit {
					temperature = <0x1c138>;
					hysteresis = <0x00>;
					type = "critical";
				};
			};
		};

		bigcore0-thermal {
			polling-delay-passive = <0x64>;
			polling-delay = <0x00>;
			thermal-sensors = <0xd1 0x01>;

			trips {

				bigcore0-alert {
					temperature = <0x14c08>;
					hysteresis = <0x7d0>;
					type = "passive";
					phandle = <0xd2>;
				};

				bigcore0-crit {
					temperature = <0x1c138>;
					hysteresis = <0x00>;
					type = "critical";
				};
			};

			cooling-maps {

				map0 {
					trip = <0xd2>;
					cooling-device = <0x06 0xffffffff 0xffffffff 0x07 0xffffffff 0xffffffff>;
				};
			};
		};

		bigcore2-thermal {
			polling-delay-passive = <0x64>;
			polling-delay = <0x00>;
			thermal-sensors = <0xd1 0x02>;

			trips {

				bigcore2-alert {
					temperature = <0x14c08>;
					hysteresis = <0x7d0>;
					type = "passive";
					phandle = <0xd3>;
				};

				bigcore2-crit {
					temperature = <0x1c138>;
					hysteresis = <0x00>;
					type = "critical";
				};
			};

			cooling-maps {

				map0 {
					trip = <0xd3>;
					cooling-device = <0x08 0xffffffff 0xffffffff 0x09 0xffffffff 0xffffffff>;
				};
			};
		};

		littlecore-thermal {
			polling-delay-passive = <0x64>;
			polling-delay = <0x00>;
			thermal-sensors = <0xd1 0x03>;

			trips {

				littlecore-alert {
					temperature = <0x14c08>;
					hysteresis = <0x7d0>;
					type = "passive";
					phandle = <0xd4>;
				};

				littlecore-crit {
					temperature = <0x1c138>;
					hysteresis = <0x00>;
					type = "critical";
				};
			};

			cooling-maps {

				map0 {
					trip = <0xd4>;
					cooling-device = <0x02 0xffffffff 0xffffffff 0x03 0xffffffff 0xffffffff 0x04 0xffffffff 0xffffffff 0x05 0xffffffff 0xffffffff>;
				};
			};
		};

		center-thermal {
			polling-delay-passive = <0x00>;
			polling-delay = <0x00>;
			thermal-sensors = <0xd1 0x04>;

			trips {

				center-crit {
					temperature = <0x1c138>;
					hysteresis = <0x00>;
					type = "critical";
				};
			};
		};

		gpu-thermal {
			polling-delay-passive = <0x64>;
			polling-delay = <0x00>;
			thermal-sensors = <0xd1 0x05>;

			trips {

				gpu-alert {
					temperature = <0x14c08>;
					hysteresis = <0x7d0>;
					type = "passive";
					phandle = <0xd5>;
				};

				gpu-crit {
					temperature = <0x1c138>;
					hysteresis = <0x00>;
					type = "critical";
				};
			};

			cooling-maps {

				map0 {
					trip = <0xd5>;
					cooling-device = <0xd6 0xffffffff 0xffffffff>;
				};
			};
		};

		npu-thermal {
			polling-delay-passive = <0x00>;
			polling-delay = <0x00>;
			thermal-sensors = <0xd1 0x06>;

			trips {

				npu-crit {
					temperature = <0x1c138>;
					hysteresis = <0x00>;
					type = "critical";
				};
			};
		};
	};

	tsadc@fec00000 {
		compatible = "rockchip,rk3588-tsadc";
		reg = <0x00 0xfec00000 0x00 0x400>;
		interrupts = <0x00 0x18d 0x04 0x00>;
		clocks = <0x1f 0x9e 0x1f 0x9d>;
		clock-names = "tsadc\0apb_pclk";
		assigned-clocks = <0x1f 0x9e>;
		assigned-clock-rates = <0x1e8480>;
		resets = <0x1f 0x56 0x1f 0x57>;
		reset-names = "tsadc-apb\0tsadc";
		rockchip,hw-tshut-temp = <0x1d4c0>;
		rockchip,hw-tshut-mode = <0x00>;
		rockchip,hw-tshut-polarity = <0x00>;
		pinctrl-0 = <0xd7>;
		pinctrl-1 = <0xd8>;
		pinctrl-names = "default\0sleep";
		#thermal-sensor-cells = <0x01>;
		status = "okay";
		phandle = <0xd1>;
	};

	adc@fec10000 {
		compatible = "rockchip,rk3588-saradc";
		reg = <0x00 0xfec10000 0x00 0x10000>;
		interrupts = <0x00 0x18e 0x04 0x00>;
		#io-channel-cells = <0x01>;
		clocks = <0x1f 0x91 0x1f 0x90>;
		clock-names = "saradc\0apb_pclk";
		resets = <0x1f 0x55>;
		reset-names = "saradc-apb";
		status = "okay";
		vref-supply = <0xd9>;
	};

	i2c@fec80000 {
		compatible = "rockchip,rk3588-i2c\0rockchip,rk3399-i2c";
		reg = <0x00 0xfec80000 0x00 0x1000>;
		clocks = <0x1f 0x88 0x1f 0x80>;
		clock-names = "i2c\0pclk";
		interrupts = <0x00 0x143 0x04 0x00>;
		pinctrl-0 = <0xda>;
		pinctrl-names = "default";
		#address-cells = <0x01>;
		#size-cells = <0x00>;
		status = "disabled";
	};

	i2c@fec90000 {
		compatible = "rockchip,rk3588-i2c\0rockchip,rk3399-i2c";
		reg = <0x00 0xfec90000 0x00 0x1000>;
		clocks = <0x1f 0x89 0x1f 0x81>;
		clock-names = "i2c\0pclk";
		interrupts = <0x00 0x144 0x04 0x00>;
		pinctrl-0 = <0xdb>;
		pinctrl-names = "default";
		#address-cells = <0x01>;
		#size-cells = <0x00>;
		status = "okay";

		audio-codec@11 {
			compatible = "everest,es8316";
			reg = <0x11>;
			clocks = <0x1f 0x31>;
			clock-names = "mclk";
			assigned-clocks = <0x1f 0x31>;
			assigned-clock-rates = <0xbb8000>;
			#sound-dai-cells = <0x00>;

			port {

				endpoint {
					remote-endpoint = <0xdc>;
					phandle = <0x92>;
				};
			};
		};
	};

	i2c@feca0000 {
		compatible = "rockchip,rk3588-i2c\0rockchip,rk3399-i2c";
		reg = <0x00 0xfeca0000 0x00 0x1000>;
		clocks = <0x1f 0x8a 0x1f 0x82>;
		clock-names = "i2c\0pclk";
		interrupts = <0x00 0x145 0x04 0x00>;
		pinctrl-0 = <0xdd>;
		pinctrl-names = "default";
		#address-cells = <0x01>;
		#size-cells = <0x00>;
		status = "disabled";
	};

	spi@fecb0000 {
		compatible = "rockchip,rk3588-spi\0rockchip,rk3066-spi";
		reg = <0x00 0xfecb0000 0x00 0x1000>;
		interrupts = <0x00 0x14a 0x04 0x00>;
		clocks = <0x1f 0x9b 0x1f 0x96>;
		clock-names = "spiclk\0apb_pclk";
		dmas = <0x6c 0x0d 0x6c 0x0e>;
		dma-names = "tx\0rx";
		num-cs = <0x02>;
		pinctrl-0 = <0xde 0xdf 0xe0>;
		pinctrl-names = "default";
		#address-cells = <0x01>;
		#size-cells = <0x00>;
		status = "disabled";
	};

	efuse@fecc0000 {
		compatible = "rockchip,rk3588-otp";
		reg = <0x00 0xfecc0000 0x00 0x400>;
		clocks = <0x1f 0x8c 0x1f 0x8b 0x1f 0x8f 0x1f 0x8d>;
		clock-names = "otp\0apb_pclk\0phy\0arb";
		resets = <0x1f 0xa7 0x1f 0xa6 0x1f 0xa8>;
		reset-names = "otp\0apb\0arb";
		#address-cells = <0x01>;
		#size-cells = <0x01>;

		cpu-code@2 {
			reg = <0x02 0x02>;
		};

		id@7 {
			reg = <0x07 0x10>;
		};

		cpu-leakage@17 {
			reg = <0x17 0x01>;
		};

		cpu-leakage@18 {
			reg = <0x18 0x01>;
		};

		cpu-leakage@19 {
			reg = <0x19 0x01>;
		};

		log-leakage@1a {
			reg = <0x1a 0x01>;
		};

		gpu-leakage@1b {
			reg = <0x1b 0x01>;
		};

		cpu-version@1c {
			reg = <0x1c 0x01>;
			bits = <0x03 0x03>;
		};

		npu-leakage@28 {
			reg = <0x28 0x01>;
		};

		codec-leakage@29 {
			reg = <0x29 0x01>;
		};
	};

	dma-controller@fed10000 {
		compatible = "arm,pl330\0arm,primecell";
		reg = <0x00 0xfed10000 0x00 0x4000>;
		interrupts = <0x00 0x5a 0x04 0x00 0x00 0x5b 0x04 0x00>;
		arm,pl330-periph-burst;
		clocks = <0x1f 0x70>;
		clock-names = "apb_pclk";
		#dma-cells = <0x01>;
		phandle = <0x6c>;
	};

	phy@fed60000 {
		compatible = "rockchip,rk3588-hdptx-phy";
		reg = <0x00 0xfed60000 0x00 0x2000>;
		clocks = <0x1f 0x2a0 0x1f 0x254>;
		clock-names = "ref\0apb";
		#phy-cells = <0x00>;
		resets = <0x1f 0x223 0x1f 0x21a 0x1f 0x263 0x1f 0x264 0x1f 0x265 0x1f 0x221 0x1f 0x222>;
		reset-names = "phy\0apb\0init\0cmn\0lane\0ropll\0lcpll";
		rockchip,grf = <0xe1>;
		status = "disabled";
	};

	phy@fed80000 {
		compatible = "rockchip,rk3588-usbdp-phy";
		reg = <0x00 0xfed80000 0x00 0x10000>;
		#phy-cells = <0x01>;
		clocks = <0x1f 0x2a1 0x1f 0x26c 0x1f 0x256 0xe2>;
		clock-names = "refclk\0immortal\0pclk\0utmi";
		resets = <0x1f 0x0b 0x1f 0x0c 0x1f 0x0d 0x1f 0x0e 0x1f 0x217>;
		reset-names = "init\0cmn\0lane\0pcs_apb\0pma_apb";
		rockchip,u2phy-grf = <0xe3>;
		rockchip,usb-grf = <0xe4>;
		rockchip,usbdpphy-grf = <0xe5>;
		rockchip,vo-grf = <0xe6>;
		status = "okay";
		rockchip,dp-lane-mux = <0x02 0x03>;
		phandle = <0x23>;
	};

	phy@fee00000 {
		compatible = "rockchip,rk3588-naneng-combphy";
		reg = <0x00 0xfee00000 0x00 0x100>;
		clocks = <0x1f 0x2a8 0x1f 0x176 0x1f 0x157>;
		clock-names = "ref\0apb\0pipe";
		assigned-clocks = <0x1f 0x2a8>;
		assigned-clock-rates = <0x5f5e100>;
		#phy-cells = <0x01>;
		resets = <0x1f 0x23c 0x1f 0x243>;
		reset-names = "phy\0apb";
		rockchip,pipe-grf = <0x2a>;
		rockchip,pipe-phy-grf = <0xe7>;
		status = "okay";
		phandle = <0x71>;
	};

	phy@fee20000 {
		compatible = "rockchip,rk3588-naneng-combphy";
		reg = <0x00 0xfee20000 0x00 0x100>;
		clocks = <0x1f 0x2aa 0x1f 0x178 0x1f 0x157>;
		clock-names = "ref\0apb\0pipe";
		assigned-clocks = <0x1f 0x2aa>;
		assigned-clock-rates = <0x5f5e100>;
		#phy-cells = <0x01>;
		resets = <0x1f 0x23e 0x1f 0x245>;
		reset-names = "phy\0apb";
		rockchip,pipe-grf = <0x2a>;
		rockchip,pipe-phy-grf = <0xe8>;
		status = "okay";
		phandle = <0x28>;
	};

	sram@ff001000 {
		compatible = "mmio-sram";
		reg = <0x00 0xff001000 0x00 0xef000>;
		ranges = <0x00 0x00 0xff001000 0xef000>;
		#address-cells = <0x01>;
		#size-cells = <0x01>;
	};

	pinctrl {
		compatible = "rockchip,rk3588-pinctrl";
		ranges;
		rockchip,grf = <0xe9>;
		#address-cells = <0x02>;
		#size-cells = <0x02>;
		phandle = <0xea>;

		gpio@fd8a0000 {
			compatible = "rockchip,gpio-bank";
			reg = <0x00 0xfd8a0000 0x00 0x100>;
			interrupts = <0x00 0x115 0x04 0x00>;
			clocks = <0x1f 0x271 0x1f 0x272>;
			gpio-controller;
			gpio-ranges = <0xea 0x00 0x00 0x20>;
			interrupt-controller;
			#gpio-cells = <0x02>;
			#interrupt-cells = <0x02>;
			phandle = <0x84>;
		};

		gpio@fec20000 {
			compatible = "rockchip,gpio-bank";
			reg = <0x00 0xfec20000 0x00 0x100>;
			interrupts = <0x00 0x116 0x04 0x00>;
			clocks = <0x1f 0x73 0x1f 0x74>;
			gpio-controller;
			gpio-ranges = <0xea 0x00 0x20 0x20>;
			interrupt-controller;
			#gpio-cells = <0x02>;
			#interrupt-cells = <0x02>;
		};

		gpio@fec30000 {
			compatible = "rockchip,gpio-bank";
			reg = <0x00 0xfec30000 0x00 0x100>;
			interrupts = <0x00 0x117 0x04 0x00>;
			clocks = <0x1f 0x75 0x1f 0x76>;
			gpio-controller;
			gpio-ranges = <0xea 0x00 0x40 0x20>;
			interrupt-controller;
			#gpio-cells = <0x02>;
			#interrupt-cells = <0x02>;
		};

		gpio@fec40000 {
			compatible = "rockchip,gpio-bank";
			reg = <0x00 0xfec40000 0x00 0x100>;
			interrupts = <0x00 0x118 0x04 0x00>;
			clocks = <0x1f 0x77 0x1f 0x78>;
			gpio-controller;
			gpio-ranges = <0xea 0x00 0x60 0x20>;
			interrupt-controller;
			#gpio-cells = <0x02>;
			#interrupt-cells = <0x02>;
			phandle = <0x73>;
		};

		gpio@fec50000 {
			compatible = "rockchip,gpio-bank";
			reg = <0x00 0xfec50000 0x00 0x100>;
			interrupts = <0x00 0x119 0x04 0x00>;
			clocks = <0x1f 0x79 0x1f 0x7a>;
			gpio-controller;
			gpio-ranges = <0xea 0x00 0x80 0x20>;
			interrupt-controller;
			#gpio-cells = <0x02>;
			#interrupt-cells = <0x02>;
			phandle = <0xf7>;
		};

		pcfg-pull-up {
			bias-pull-up;
			phandle = <0xef>;
		};

		pcfg-pull-down {
			bias-pull-down;
			phandle = <0xed>;
		};

		pcfg-pull-none {
			bias-disable;
			phandle = <0xeb>;
		};

		pcfg-pull-none-drv-level-2 {
			bias-disable;
			drive-strength = <0x02>;
			phandle = <0xf1>;
		};

		pcfg-pull-up-drv-level-1 {
			bias-pull-up;
			drive-strength = <0x01>;
			phandle = <0xf0>;
		};

		pcfg-pull-up-drv-level-2 {
			bias-pull-up;
			drive-strength = <0x02>;
			phandle = <0xec>;
		};

		pcfg-pull-none-smt {
			bias-disable;
			input-schmitt-enable;
			phandle = <0xee>;
		};

		auddsm {
		};

		bt1120 {
		};

		can0 {
		};

		can1 {
		};

		can2 {
		};

		cif {
		};

		clk32k {
		};

		cpu {
		};

		ddrphych0 {
		};

		ddrphych1 {
		};

		ddrphych2 {
		};

		ddrphych3 {
		};

		dp0 {
		};

		dp1 {
		};

		emmc {

			emmc-rstnout {
				rockchip,pins = <0x02 0x03 0x01 0xeb>;
				phandle = <0x88>;
			};

			emmc-bus8 {
				rockchip,pins = <0x02 0x18 0x01 0xec 0x02 0x19 0x01 0xec 0x02 0x1a 0x01 0xec 0x02 0x1b 0x01 0xec 0x02 0x1c 0x01 0xec 0x02 0x1d 0x01 0xec 0x02 0x1e 0x01 0xec 0x02 0x1f 0x01 0xec>;
				phandle = <0x89>;
			};

			emmc-clk {
				rockchip,pins = <0x02 0x01 0x01 0xec>;
				phandle = <0x8a>;
			};

			emmc-cmd {
				rockchip,pins = <0x02 0x00 0x01 0xec>;
				phandle = <0x8b>;
			};

			emmc-data-strobe {
				rockchip,pins = <0x02 0x02 0x01 0xed>;
				phandle = <0x8c>;
			};
		};

		eth1 {
		};

		fspi {

			fspim0-pins {
				rockchip,pins = <0x02 0x00 0x02 0xec 0x02 0x1e 0x02 0xec 0x02 0x18 0x02 0xec 0x02 0x19 0x02 0xec 0x02 0x1a 0x02 0xec 0x02 0x1b 0x02 0xec>;
				phandle = <0x7f>;
			};
		};

		gmac1 {

			gmac1-miim {
				rockchip,pins = <0x03 0x12 0x01 0xeb 0x03 0x13 0x01 0xeb>;
				phandle = <0x79>;
			};

			gmac1-rx-bus2 {
				rockchip,pins = <0x03 0x07 0x01 0xeb 0x03 0x08 0x01 0xeb 0x03 0x09 0x01 0xeb>;
				phandle = <0x7b>;
			};

			gmac1-tx-bus2 {
				rockchip,pins = <0x03 0x0b 0x01 0xeb 0x03 0x0c 0x01 0xeb 0x03 0x0d 0x01 0xeb>;
				phandle = <0x7a>;
			};

			gmac1-rgmii-clk {
				rockchip,pins = <0x03 0x05 0x01 0xeb 0x03 0x04 0x01 0xeb>;
				phandle = <0x7c>;
			};

			gmac1-rgmii-bus {
				rockchip,pins = <0x03 0x02 0x01 0xeb 0x03 0x03 0x01 0xeb 0x03 0x00 0x01 0xeb 0x03 0x01 0x01 0xeb>;
				phandle = <0x7d>;
			};
		};

		gpu {
		};

		hdmi {
		};

		i2c0 {

			i2c0m2-xfer {
				rockchip,pins = <0x00 0x19 0x03 0xee 0x00 0x1a 0x03 0xee>;
				phandle = <0x2b>;
			};
		};

		i2c1 {

			i2c1m0-xfer {
				rockchip,pins = <0x00 0x0d 0x09 0xee 0x00 0x0e 0x09 0xee>;
				phandle = <0xa6>;
			};
		};

		i2c2 {

			i2c2m0-xfer {
				rockchip,pins = <0x00 0x0f 0x09 0xee 0x00 0x10 0x09 0xee>;
				phandle = <0xa7>;
			};
		};

		i2c3 {

			i2c3m0-xfer {
				rockchip,pins = <0x01 0x11 0x09 0xee 0x01 0x10 0x09 0xee>;
				phandle = <0xa8>;
			};
		};

		i2c4 {

			i2c4m0-xfer {
				rockchip,pins = <0x03 0x06 0x09 0xee 0x03 0x05 0x09 0xee>;
				phandle = <0xa9>;
			};
		};

		i2c5 {

			i2c5m2-xfer {
				rockchip,pins = <0x04 0x06 0x09 0xee 0x04 0x07 0x09 0xee>;
				phandle = <0xaa>;
			};
		};

		i2c6 {

			i2c6m0-xfer {
				rockchip,pins = <0x00 0x18 0x09 0xee 0x00 0x17 0x09 0xee>;
				phandle = <0xda>;
			};
		};

		i2c7 {

			i2c7m0-xfer {
				rockchip,pins = <0x01 0x18 0x09 0xee 0x01 0x19 0x09 0xee>;
				phandle = <0xdb>;
			};
		};

		i2c8 {

			i2c8m0-xfer {
				rockchip,pins = <0x04 0x1a 0x09 0xee 0x04 0x1b 0x09 0xee>;
				phandle = <0xdd>;
			};
		};

		i2s0 {

			i2s0-lrck {
				rockchip,pins = <0x01 0x15 0x01 0xeb>;
				phandle = <0x8d>;
			};

			i2s0-mclk {
				rockchip,pins = <0x01 0x12 0x01 0xeb>;
				phandle = <0x8e>;
			};

			i2s0-sclk {
				rockchip,pins = <0x01 0x13 0x01 0xeb>;
				phandle = <0x8f>;
			};

			i2s0-sdi0 {
				rockchip,pins = <0x01 0x1c 0x02 0xeb>;
				phandle = <0x90>;
			};

			i2s0-sdo0 {
				rockchip,pins = <0x01 0x17 0x01 0xeb>;
				phandle = <0x91>;
			};
		};

		i2s1 {

			i2s1m0-lrck {
				rockchip,pins = <0x04 0x02 0x03 0xeb>;
				phandle = <0x93>;
			};

			i2s1m0-sclk {
				rockchip,pins = <0x04 0x01 0x03 0xeb>;
				phandle = <0x94>;
			};

			i2s1m0-sdi0 {
				rockchip,pins = <0x04 0x05 0x03 0xeb>;
				phandle = <0x95>;
			};

			i2s1m0-sdi1 {
				rockchip,pins = <0x04 0x06 0x03 0xeb>;
				phandle = <0x96>;
			};

			i2s1m0-sdi2 {
				rockchip,pins = <0x04 0x07 0x03 0xeb>;
				phandle = <0x97>;
			};

			i2s1m0-sdi3 {
				rockchip,pins = <0x04 0x08 0x03 0xeb>;
				phandle = <0x98>;
			};

			i2s1m0-sdo0 {
				rockchip,pins = <0x04 0x09 0x03 0xeb>;
				phandle = <0x99>;
			};

			i2s1m0-sdo1 {
				rockchip,pins = <0x04 0x0a 0x03 0xeb>;
				phandle = <0x9a>;
			};

			i2s1m0-sdo2 {
				rockchip,pins = <0x04 0x0b 0x03 0xeb>;
				phandle = <0x9b>;
			};

			i2s1m0-sdo3 {
				rockchip,pins = <0x04 0x0c 0x03 0xeb>;
				phandle = <0x9c>;
			};
		};

		i2s2 {

			i2s2m1-lrck {
				rockchip,pins = <0x03 0x0e 0x03 0xeb>;
				phandle = <0x9e>;
			};

			i2s2m1-sclk {
				rockchip,pins = <0x03 0x0d 0x03 0xeb>;
				phandle = <0x9f>;
			};

			i2s2m1-sdi {
				rockchip,pins = <0x03 0x0a 0x03 0xeb>;
				phandle = <0xa0>;
			};

			i2s2m1-sdo {
				rockchip,pins = <0x03 0x0b 0x03 0xeb>;
				phandle = <0xa1>;
			};
		};

		i2s3 {

			i2s3-lrck {
				rockchip,pins = <0x03 0x02 0x03 0xeb>;
				phandle = <0xa2>;
			};

			i2s3-sclk {
				rockchip,pins = <0x03 0x01 0x03 0xeb>;
				phandle = <0xa3>;
			};

			i2s3-sdi {
				rockchip,pins = <0x03 0x04 0x03 0xeb>;
				phandle = <0xa4>;
			};

			i2s3-sdo {
				rockchip,pins = <0x03 0x03 0x03 0xeb>;
				phandle = <0xa5>;
			};
		};

		jtag {
		};

		litcpu {
		};

		mcu {
		};

		mipi {
		};

		npu {
		};

		pcie20x1 {

			pcie20x1m0-pins {
				rockchip,pins = <0x03 0x17 0x04 0xeb 0x03 0x19 0x04 0xeb 0x03 0x18 0x04 0xeb>;
				phandle = <0x72>;
			};
		};

		pcie30phy {
		};

		pcie30x1 {
		};

		pcie30x2 {
		};

		pcie30x4 {
		};

		pdm0 {
		};

		pdm1 {
		};

		pmic {

			pmic-pins {
				rockchip,pins = <0x00 0x07 0x00 0xef 0x00 0x02 0x01 0xeb 0x00 0x03 0x01 0xeb 0x00 0x11 0x01 0xeb 0x00 0x12 0x01 0xeb 0x00 0x13 0x01 0xeb 0x00 0x1e 0x01 0xeb>;
				phandle = <0xb3>;
			};
		};

		pmu {
		};

		pwm0 {

			pwm0m0-pins {
				rockchip,pins = <0x00 0x0f 0x03 0xeb>;
				phandle = <0x2f>;
			};
		};

		pwm1 {

			pwm1m0-pins {
				rockchip,pins = <0x00 0x10 0x03 0xeb>;
				phandle = <0x30>;
			};
		};

		pwm2 {

			pwm2m0-pins {
				rockchip,pins = <0x00 0x14 0x03 0xeb>;
				phandle = <0x31>;
			};
		};

		pwm3 {

			pwm3m1-pins {
				rockchip,pins = <0x03 0x0a 0x0b 0xeb>;
				phandle = <0x32>;
			};
		};

		pwm4 {

			pwm4m0-pins {
				rockchip,pins = <0x00 0x15 0x0b 0xeb>;
				phandle = <0xc5>;
			};
		};

		pwm5 {

			pwm5m0-pins {
				rockchip,pins = <0x00 0x09 0x03 0xeb>;
				phandle = <0xc6>;
			};
		};

		pwm6 {

			pwm6m0-pins {
				rockchip,pins = <0x00 0x17 0x0b 0xeb>;
				phandle = <0xc7>;
			};
		};

		pwm7 {

			pwm7m0-pins {
				rockchip,pins = <0x00 0x18 0x0b 0xeb>;
				phandle = <0xc8>;
			};
		};

		pwm8 {

			pwm8m0-pins {
				rockchip,pins = <0x03 0x07 0x0b 0xeb>;
				phandle = <0xc9>;
			};
		};

		pwm9 {

			pwm9m0-pins {
				rockchip,pins = <0x03 0x08 0x0b 0xeb>;
				phandle = <0xca>;
			};
		};

		pwm10 {

			pwm10m0-pins {
				rockchip,pins = <0x03 0x00 0x0b 0xeb>;
				phandle = <0xcb>;
			};
		};

		pwm11 {

			pwm11m0-pins {
				rockchip,pins = <0x03 0x01 0x0b 0xeb>;
				phandle = <0xcc>;
			};
		};

		pwm12 {

			pwm12m0-pins {
				rockchip,pins = <0x03 0x0d 0x0b 0xeb>;
				phandle = <0xcd>;
			};
		};

		pwm13 {

			pwm13m0-pins {
				rockchip,pins = <0x03 0x0e 0x0b 0xeb>;
				phandle = <0xce>;
			};
		};

		pwm14 {

			pwm14m0-pins {
				rockchip,pins = <0x03 0x12 0x0b 0xeb>;
				phandle = <0xcf>;
			};
		};

		pwm15 {

			pwm15m0-pins {
				rockchip,pins = <0x03 0x13 0x0b 0xeb>;
				phandle = <0xd0>;
			};
		};

		refclk {
		};

		sata {
		};

		sata0 {
		};

		sata1 {
		};

		sata2 {
		};

		sdio {

			sdiom1-pins {
				rockchip,pins = <0x03 0x05 0x02 0xeb 0x03 0x04 0x02 0xef 0x03 0x00 0x02 0xef 0x03 0x01 0x02 0xef 0x03 0x02 0x02 0xef 0x03 0x03 0x02 0xef>;
				phandle = <0x87>;
			};
		};

		sdmmc {

			sdmmc-bus4 {
				rockchip,pins = <0x04 0x18 0x01 0xec 0x04 0x19 0x01 0xec 0x04 0x1a 0x01 0xec 0x04 0x1b 0x01 0xec>;
				phandle = <0x83>;
			};

			sdmmc-clk {
				rockchip,pins = <0x04 0x1d 0x01 0xec>;
				phandle = <0x80>;
			};

			sdmmc-cmd {
				rockchip,pins = <0x04 0x1c 0x01 0xec>;
				phandle = <0x81>;
			};

			sdmmc-det {
				rockchip,pins = <0x00 0x04 0x01 0xef>;
				phandle = <0x82>;
			};
		};

		spdif0 {
		};

		spdif1 {
		};

		spi0 {

			spi0m0-pins {
				rockchip,pins = <0x00 0x16 0x08 0xf0 0x00 0x17 0x08 0xf0 0x00 0x10 0x08 0xf0>;
				phandle = <0xad>;
			};

			spi0m0-cs0 {
				rockchip,pins = <0x00 0x19 0x08 0xf0>;
				phandle = <0xab>;
			};

			spi0m0-cs1 {
				rockchip,pins = <0x00 0x0f 0x08 0xf0>;
				phandle = <0xac>;
			};
		};

		spi1 {

			spi1m1-pins {
				rockchip,pins = <0x03 0x11 0x08 0xf0 0x03 0x10 0x08 0xf0 0x03 0x0f 0x08 0xf0>;
				phandle = <0xb0>;
			};

			spi1m1-cs0 {
				rockchip,pins = <0x03 0x12 0x08 0xf0>;
				phandle = <0xae>;
			};

			spi1m1-cs1 {
				rockchip,pins = <0x03 0x13 0x08 0xf0>;
				phandle = <0xaf>;
			};
		};

		spi2 {

			spi2m2-pins {
				rockchip,pins = <0x00 0x05 0x01 0xf0 0x00 0x0b 0x01 0xf0 0x00 0x06 0x01 0xf0>;
				phandle = <0xb2>;
			};

			spi2m2-cs0 {
				rockchip,pins = <0x00 0x09 0x01 0xf0>;
				phandle = <0xb1>;
			};
		};

		spi3 {

			spi3m1-pins {
				rockchip,pins = <0x04 0x0f 0x08 0xf0 0x04 0x0d 0x08 0xf0 0x04 0x0e 0x08 0xf0>;
				phandle = <0xbb>;
			};

			spi3m1-cs0 {
				rockchip,pins = <0x04 0x10 0x08 0xf0>;
				phandle = <0xb9>;
			};

			spi3m1-cs1 {
				rockchip,pins = <0x04 0x11 0x08 0xf0>;
				phandle = <0xba>;
			};
		};

		spi4 {

			spi4m0-pins {
				rockchip,pins = <0x01 0x12 0x08 0xf0 0x01 0x10 0x08 0xf0 0x01 0x11 0x08 0xf0>;
				phandle = <0xe0>;
			};

			spi4m0-cs0 {
				rockchip,pins = <0x01 0x13 0x08 0xf0>;
				phandle = <0xde>;
			};

			spi4m0-cs1 {
				rockchip,pins = <0x01 0x14 0x08 0xf0>;
				phandle = <0xdf>;
			};
		};

		tsadc {

			tsadc-shut-org {
				rockchip,pins = <0x00 0x01 0x01 0xeb>;
				phandle = <0xd7>;
			};
		};

		uart0 {

			uart0m1-xfer {
				rockchip,pins = <0x00 0x08 0x04 0xef 0x00 0x09 0x04 0xef>;
				phandle = <0x2e>;
			};
		};

		uart1 {

			uart1m1-xfer {
				rockchip,pins = <0x01 0x0f 0x0a 0xef 0x01 0x0e 0x0a 0xef>;
				phandle = <0xbc>;
			};
		};

		uart2 {

			uart2m0-xfer {
				rockchip,pins = <0x00 0x0e 0x0a 0xef 0x00 0x0d 0x0a 0xef>;
				phandle = <0xbd>;
			};
		};

		uart3 {

			uart3m1-xfer {
				rockchip,pins = <0x03 0x0e 0x0a 0xef 0x03 0x0d 0x0a 0xef>;
				phandle = <0xbe>;
			};
		};

		uart4 {

			uart4m1-xfer {
				rockchip,pins = <0x03 0x18 0x0a 0xef 0x03 0x19 0x0a 0xef>;
				phandle = <0xbf>;
			};
		};

		uart5 {

			uart5m1-xfer {
				rockchip,pins = <0x03 0x15 0x0a 0xef 0x03 0x14 0x0a 0xef>;
				phandle = <0xc0>;
			};
		};

		uart6 {

			uart6m1-xfer {
				rockchip,pins = <0x01 0x00 0x0a 0xef 0x01 0x01 0x0a 0xef>;
				phandle = <0xc1>;
			};
		};

		uart7 {

			uart7m1-xfer {
				rockchip,pins = <0x03 0x11 0x0a 0xef 0x03 0x10 0x0a 0xef>;
				phandle = <0xc2>;
			};
		};

		uart8 {

			uart8m1-xfer {
				rockchip,pins = <0x03 0x03 0x0a 0xef 0x03 0x02 0x0a 0xef>;
				phandle = <0xc3>;
			};
		};

		uart9 {

			uart9m1-xfer {
				rockchip,pins = <0x04 0x0d 0x0a 0xef 0x04 0x0c 0x0a 0xef>;
				phandle = <0xc4>;
			};
		};

		vop {
		};

		bt656 {
		};

		gpio-func {

			tsadc-gpio-func {
				rockchip,pins = <0x00 0x01 0x00 0xeb>;
				phandle = <0xd8>;
			};
		};

		leds {

			io-led {
				rockchip,pins = <0x03 0x1d 0x00 0xeb>;
				phandle = <0xf3>;
			};
		};

		pcie {

			pow-en {
				rockchip,pins = <0x00 0x15 0x00 0xeb>;
				phandle = <0xf6>;
			};
		};

		power {

			vcc-5v0-en {
				rockchip,pins = <0x04 0x03 0x00 0xeb>;
				phandle = <0xfa>;
			};
		};

		rtl8211f {

			rtl8211f-rst {
				rockchip,pins = <0x03 0x0f 0x00 0xeb>;
				phandle = <0x7e>;
			};
		};

		usb {

			vcc5v0-host-en {
				rockchip,pins = <0x04 0x0d 0x00 0xeb>;
				phandle = <0xf8>;
			};
		};
	};

	opp-table-cluster0 {
		compatible = "operating-points-v2";
		opp-shared;
		phandle = <0x0d>;

		opp-1008000000 {
			opp-hz = <0x00 0x3c14dc00>;
			opp-microvolt = <0xa4cb8 0xa4cb8 0xe7ef0>;
			clock-latency-ns = <0x9c40>;
		};

		opp-1200000000 {
			opp-hz = <0x00 0x47868c00>;
			opp-microvolt = <0xadf34 0xadf34 0xe7ef0>;
			clock-latency-ns = <0x9c40>;
		};

		opp-1416000000 {
			opp-hz = <0x00 0x54667200>;
			opp-microvolt = <0xba284 0xba284 0xe7ef0>;
			clock-latency-ns = <0x9c40>;
			opp-suspend;
		};

		opp-1608000000 {
			opp-hz = <0x00 0x5fd82200>;
			opp-microvolt = <0xcf850 0xcf850 0xe7ef0>;
			clock-latency-ns = <0x9c40>;
		};

		opp-1800000000 {
			opp-hz = <0x00 0x6b49d200>;
			opp-microvolt = <0xe7ef0 0xe7ef0 0xe7ef0>;
			clock-latency-ns = <0x9c40>;
		};
	};

	opp-table-cluster1 {
		compatible = "operating-points-v2";
		opp-shared;
		phandle = <0x13>;

		opp-1200000000 {
			opp-hz = <0x00 0x47868c00>;
			opp-microvolt = <0xa4cb8 0xa4cb8 0xf4240>;
			clock-latency-ns = <0x9c40>;
		};

		opp-1416000000 {
			opp-hz = <0x00 0x54667200>;
			opp-microvolt = <0xb1008 0xb1008 0xf4240>;
			clock-latency-ns = <0x9c40>;
		};

		opp-1608000000 {
			opp-hz = <0x00 0x5fd82200>;
			opp-microvolt = <0xba284 0xba284 0xf4240>;
			clock-latency-ns = <0x9c40>;
		};

		opp-1800000000 {
			opp-hz = <0x00 0x6b49d200>;
			opp-microvolt = <0xcf850 0xcf850 0xf4240>;
			clock-latency-ns = <0x9c40>;
		};

		opp-2016000000 {
			opp-hz = <0x00 0x7829b800>;
			opp-microvolt = <0xe1d48 0xe1d48 0xf4240>;
			clock-latency-ns = <0x9c40>;
		};

		opp-2208000000 {
			opp-hz = <0x00 0x839b6800>;
			opp-microvolt = <0xf116c 0xf116c 0xf4240>;
			clock-latency-ns = <0x9c40>;
		};

		opp-2400000000 {
			opp-hz = <0x00 0x8f0d1800>;
			opp-microvolt = <0xf4240 0xf4240 0xf4240>;
			clock-latency-ns = <0x9c40>;
		};
	};

	opp-table-cluster2 {
		compatible = "operating-points-v2";
		opp-shared;
		phandle = <0x17>;

		opp-1200000000 {
			opp-hz = <0x00 0x47868c00>;
			opp-microvolt = <0xa4cb8 0xa4cb8 0xf4240>;
			clock-latency-ns = <0x9c40>;
		};

		opp-1416000000 {
			opp-hz = <0x00 0x54667200>;
			opp-microvolt = <0xb1008 0xb1008 0xf4240>;
			clock-latency-ns = <0x9c40>;
		};

		opp-1608000000 {
			opp-hz = <0x00 0x5fd82200>;
			opp-microvolt = <0xba284 0xba284 0xf4240>;
			clock-latency-ns = <0x9c40>;
		};

		opp-1800000000 {
			opp-hz = <0x00 0x6b49d200>;
			opp-microvolt = <0xcf850 0xcf850 0xf4240>;
			clock-latency-ns = <0x9c40>;
		};

		opp-2016000000 {
			opp-hz = <0x00 0x7829b800>;
			opp-microvolt = <0xe1d48 0xe1d48 0xf4240>;
			clock-latency-ns = <0x9c40>;
		};

		opp-2208000000 {
			opp-hz = <0x00 0x839b6800>;
			opp-microvolt = <0xf116c 0xf116c 0xf4240>;
			clock-latency-ns = <0x9c40>;
		};

		opp-2400000000 {
			opp-hz = <0x00 0x8f0d1800>;
			opp-microvolt = <0xf4240 0xf4240 0xf4240>;
			clock-latency-ns = <0x9c40>;
		};
	};

	opp-table {
		compatible = "operating-points-v2";
		phandle = <0x21>;

		opp-300000000 {
			opp-hz = <0x00 0x11e1a300>;
			opp-microvolt = <0xa4cb8 0xa4cb8 0xcf850>;
		};

		opp-400000000 {
			opp-hz = <0x00 0x17d78400>;
			opp-microvolt = <0xa4cb8 0xa4cb8 0xcf850>;
		};

		opp-500000000 {
			opp-hz = <0x00 0x1dcd6500>;
			opp-microvolt = <0xa4cb8 0xa4cb8 0xcf850>;
		};

		opp-600000000 {
			opp-hz = <0x00 0x23c34600>;
			opp-microvolt = <0xa4cb8 0xa4cb8 0xcf850>;
		};

		opp-700000000 {
			opp-hz = <0x00 0x29b92700>;
			opp-microvolt = <0xaae60 0xaae60 0xcf850>;
		};

		opp-800000000 {
			opp-hz = <0x00 0x2faf0800>;
			opp-microvolt = <0xb71b0 0xb71b0 0xcf850>;
		};

		opp-900000000 {
			opp-hz = <0x00 0x35a4e900>;
			opp-microvolt = <0xc3500 0xc3500 0xcf850>;
		};

		opp-1000000000 {
			opp-hz = <0x00 0x3b9aca00>;
			opp-microvolt = <0xcf850 0xcf850 0xcf850>;
		};
	};

	analog-sound {
		compatible = "audio-graph-card";
		label = "rk3588-es8316";
		widgets = "Microphone\0Mic Jack\0Headphone\0Headphones";
		routing = "MIC2\0Mic Jack\0Headphones\0HPOL\0Headphones\0HPOR";
		dais = <0xf2>;
	};

	chosen {
		stdout-path = "serial2:1500000n8";
	};

	leds {
		compatible = "gpio-leds";
		pinctrl-names = "default";
		pinctrl-0 = <0xf3>;

		io-led {
			color = <0x03>;
			function = "status";
			gpios = <0x73 0x1d 0x00>;
			linux,default-trigger = "heartbeat";
		};
	};

	pwm-fan {
		compatible = "pwm-fan";
		cooling-levels = <0x00 0x5f 0x91 0xc3 0xff>;
		fan-supply = <0xf4>;
		pwms = <0xf5 0x00 0xc350 0x00>;
		#cooling-cells = <0x02>;
	};

	vcc12v-dcin-regulator {
		compatible = "regulator-fixed";
		regulator-name = "vcc12v_dcin";
		regulator-always-on;
		regulator-boot-on;
		regulator-min-microvolt = <0xb71b00>;
		regulator-max-microvolt = <0xb71b00>;
		phandle = <0xf9>;
	};

	vcc3v3-wf-regulator {
		compatible = "regulator-fixed";
		regulator-name = "vcc3v3_wf";
		regulator-min-microvolt = <0x325aa0>;
		regulator-max-microvolt = <0x325aa0>;
		enable-active-high;
		gpio = <0x84 0x15 0x00>;
		pinctrl-0 = <0xf6>;
		pinctrl-names = "default";
		vin-supply = <0x2c>;
		phandle = <0x74>;
	};

	vcc5v0-host-regulator {
		compatible = "regulator-fixed";
		regulator-name = "vcc5v0_host";
		regulator-boot-on;
		regulator-always-on;
		regulator-min-microvolt = <0x4c4b40>;
		regulator-max-microvolt = <0x4c4b40>;
		enable-active-high;
		gpio = <0xf7 0x0d 0x00>;
		pinctrl-names = "default";
		pinctrl-0 = <0xf8>;
		vin-supply = <0x2c>;
		phandle = <0x29>;
	};

	vcc5v0-sys-regulator {
		compatible = "regulator-fixed";
		regulator-name = "vcc5v0_sys";
		regulator-always-on;
		regulator-boot-on;
		regulator-min-microvolt = <0x4c4b40>;
		regulator-max-microvolt = <0x4c4b40>;
		vin-supply = <0xf9>;
		phandle = <0x2c>;
	};

	vcc-5v0-regulator {
		compatible = "regulator-fixed";
		regulator-name = "vcc_5v0";
		regulator-min-microvolt = <0x4c4b40>;
		regulator-max-microvolt = <0x4c4b40>;
		regulator-boot-on;
		regulator-always-on;
		enable-active-high;
		gpio = <0xf7 0x03 0x00>;
		pinctrl-names = "default";
		pinctrl-0 = <0xfa>;
		vin-supply = <0x2c>;
		phandle = <0xf4>;
	};

	vcc-1v1-nldo-s3-regulator {
		compatible = "regulator-fixed";
		regulator-name = "vcc_1v1_nldo_s3";
		regulator-always-on;
		regulator-boot-on;
		regulator-min-microvolt = <0x10c8e0>;
		regulator-max-microvolt = <0x10c8e0>;
		vin-supply = <0x2c>;
		phandle = <0xb8>;
	};
};
