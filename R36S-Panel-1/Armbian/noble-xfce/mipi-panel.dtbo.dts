/dts-v1/;

/ {

	fragment@0 {
		target-path = "/dsi@ff450000/panel@0";

		__overlay__ {
			compatible = "rocknix,generic-dsi";
			panel_description = "G size=52,70 delays=20,150,20,120,20 format=rgb888 lanes=4 flags=0xe03\0M clock=29000 horizontal=640,80,20,80 vertical=480,20,4,12  default=1\0M clock=29000 horizontal=640,80,20,80 vertical=480,20,4,12 \0M clock=29000 horizontal=640,80,20,80 vertical=480,20,4,12 \0I seq=e0abba # orig_cmd=0x39 \0I seq=e1baab # orig_cmd=0x39 \0I seq=b1100147ff # orig_cmd=0x39 \0I seq=b20c0804505014 # orig_cmd=0x39 \0I seq=b35612e0 # orig_cmd=0x39 \0I seq=b4333004 # orig_cmd=0x39 \0I seq=b6b0000010001000 # orig_cmd=0x39 \0I seq=b80512294948 # orig_cmd=0x39 \0I seq=b97f635245423439243e3d3c59464d3e3d3022007f635245423439243e3d3c59464d3e3d302200 # orig_cmd=0x39 \0I seq=c03210123422222222900490040f0000c1 # orig_cmd=0x39 \0I seq=c1129f8e89900490045440 # orig_cmd=0x39 \0I seq=c2770908890811223344871800 # orig_cmd=0x39 \0I seq=c3884a24241e1f120c0e10040624240202020202020202 # orig_cmd=0x39 \0I seq=c4090b24241e1f130d0f11050724240202020202020202 # orig_cmd=0x39 \0I seq=c64655 # orig_cmd=0x39 \0I seq=c8120031423416 # orig_cmd=0x39 \0I seq=ca1843 # orig_cmd=0x39 \0I seq=cd0e64642c166b06b3 # orig_cmd=0x39 \0I seq=d2e32b3808 # orig_cmd=0x39 \0I seq=d40001000e04440810000000 # orig_cmd=0x39 \0I seq=e68009ffffffffffff # orig_cmd=0x39 \0I seq=f012032000ff # orig_cmd=0x39 \0I seq=f303 # orig_cmd=0x15 \0I seq=11 wait=200 # orig_cmd=0x5 \0I seq=29 wait=20 # orig_cmd=0x5 \0#END";
		};
	};
};
